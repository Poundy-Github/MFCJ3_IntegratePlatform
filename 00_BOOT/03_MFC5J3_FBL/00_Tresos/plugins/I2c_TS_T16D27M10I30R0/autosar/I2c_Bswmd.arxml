<?xml version="1.0" encoding="UTF-8"?>
<!--
/*******************************************************************************
**                                                                            **
** Copyright (C) Infineon Technologies (2019)                                 **
**                                                                            **
** All rights reserved.                                                       **
**                                                                            **
** This document contains proprietary information belonging to Infineon       **
** Technologies. Passing on and copying of this document, and communication   **
** of its contents is not permitted without prior written authorization.      **
**                                                                            **
********************************************************************************
**                                                                            **
**  FILENAME  : I2c_Bswmd.arxml                                               **
**                                                                            **
**  VERSION   : 1.30.0_10.0.0                                                  **
**                                                                            **
**  DATE      : 2019-10-10                                                    **
**                                                                            **
**  VARIANT   : Variant PB                                                    **
**                                                                            **
**  PLATFORM  : Infineon AURIX2G                                              **
**                                                                            **
**  AUTHOR    : DL-AUTOSAR-Engineering                                        **
**                                                                            **
**  VENDOR    : Infineon Technologies                                         **
**                                                                            **
**  DESCRIPTION  : Basic Software Module Description for I2c driver           **
**                                                                            **
**                                                                            **
**  SPECIFICATION(S) : Specification of I2C Driver,                           **
**                     AUTOSAR Release 4.2.2                                  **
**                                                                            **
**  MAY BE CHANGED BY USER : no                                               **
**                                                                            **
*******************************************************************************/
[!//
/*****************************************************************************
**                                                                            **
** Copyright (C) Infineon Technologies (2019)                                 **
**                                                                            **
** All rights reserved.                                                       **
**                                                                            **
** This document contains proprietary information belonging to Infineon       **
** Technologies. Passing on and copying of this document, and communication   **
** of its contents is not permitted without prior written authorization.      **
**                                                                            **
********************************************************************************
**                                                                            **
**  FILENAME  : I2c_Bswmd.arxml                                               **
**                                                                            **
**  VERSION   : 1.30.0_10.0.0                                                 **
**                                                                            **
**  DATE, TIME: [!"$date"!], [!"$time"!]    !!!IGNORE-LINE!!!                     **
**                                                                            **
**  GENERATOR : Build [!"$buildnr"!]    !!!IGNORE-LINE!!!                       **
**                                                                            **
**  BSW MODULE DECRIPTION : i2c.bmd                                           **
**                                                                            **
**  VARIANT   : Variant PB                                                    **
**                                                                            **
**  PLATFORM  : Infineon AURIX2G                                              **
**                                                                            **
**  AUTHOR    : DL-AUTOSAR-Engineering                                        **
**                                                                            **
**  VENDOR    : Infineon Technologies                                         **
**                                                                            **
**  SPECIFICATION(S) : Specification of I2C Driver,                           **
**                     AUTOSAR Release 4.2.2                                  **
**                                                                            **
**  MAY BE CHANGED BY USER [yes/no]: No                                       **
**                                                                            **
*******************************************************************************/
-->

<AUTOSAR xmlns="http://autosar.org/schema/r4.0" xmlns:xsi="http://www.w3.org/2001/XMLSchema-instance" xsi:schemaLocation="http://autosar.org/schema/r4.0 AUTOSAR_4-2-2.xsd">
[!AUTOSPACING!][!//
[!NOCODE!][!//
  [!SELECT "as:modconf('I2c')[1]"!][!//
    [!VAR "I2c_VersionInfo_check"="I2cGeneral/I2cVersionInfoApi"!][!//
  [!ENDSELECT!][!//
  [!IF "ecu:has('Tasking.Version') and ecu:has('Tasking.Compiler.Options') and ecu:has('Tasking.Linker.Options')"!][!//
    [!VAR "TaskingCompilerOption" = "ecu:get('Tasking.Compiler.Options')"!][!//
    [!VAR "TaskingLinkerOption"   = "ecu:get('Tasking.Linker.Options')"!][!//
    [!VAR "TaskingVersion"        = "ecu:get('Tasking.Version')"!][!//
  [!ELSE!]
    [!ERROR!] Tasking Options not available in Property File[!ENDERROR!][!//
  [!ENDIF!]

  [!IF "ecu:has('Tasking_v6_3r1.Version') and ecu:has('Tasking_v6_3r1.Compiler.Options') and ecu:has('Tasking_v6_3r1.Linker.Options')"!][!//
    [!VAR "Tasking6_3r1CompilerOption" = "ecu:get('Tasking_v6_3r1.Compiler.Options')"!][!//
    [!VAR "Tasking6_3r1LinkerOption"   = "ecu:get('Tasking_v6_3r1.Linker.Options')"!][!//
    [!VAR "Tasking6_3r1Version"        = "ecu:get('Tasking_v6_3r1.Version')"!][!//
    [!VAR "IsTasking6_3r1VersionAvailable"        = "'YES'"!][!//
  [!ELSE!]
    [!VAR "IsTasking6_3r1VersionAvailable"        = "'NO'"!][!//
  [!ENDIF!]

  [!IF "ecu:has('Gnuc.Version') and ecu:has('Gnuc.Compiler.Options') and ecu:has('Gnuc.Linker.Options')"!][!//
    [!VAR "GnucCompilerOption" = "ecu:get('Gnuc.Compiler.Options')"!][!//
    [!VAR "GnucLinkerOption"   = "ecu:get('Gnuc.Linker.Options')"!][!//
    [!VAR "GnucVersion"        = "ecu:get('Gnuc.Version')"!][!//
  [!ELSE!]
    [!ERROR!] GNUC Options not available in Property File[!ENDERROR!][!//
  [!ENDIF!]
  [!IF "ecu:has('Ghs.Version') and ecu:has('Ghs.Compiler.Options') and ecu:has('Ghs.Linker.Options')"!][!//
    [!VAR "GhsCompilerOption" = "ecu:get('Ghs.Compiler.Options')"!][!//
    [!VAR "GhsLinkerOption"   = "ecu:get('Ghs.Linker.Options')"!][!//
    [!VAR "GhsVersion"        = "ecu:get('Ghs.Version')"!][!//
  [!ELSE!]
    [!ERROR!] GHS Options not available in Property File[!ENDERROR!][!//
  [!ENDIF!]
  [!IF "ecu:has('Dcc.Version') and ecu:has('Dcc.Compiler.Options') and ecu:has('Dcc.Linker.Options')"!][!//
    [!VAR "DccCompilerOption" = "ecu:get('Dcc.Compiler.Options')"!][!//
    [!VAR "DccLinkerOption"   = "ecu:get('Dcc.Linker.Options')"!][!//
    [!VAR "DccVersion"        = "ecu:get('Dcc.Version')"!][!//
  [!ELSE!]
    [!ERROR!] DCC Options not available in Property File[!ENDERROR!][!//
  [!ENDIF!]
[!ENDNOCODE!][!//
<AR-PACKAGES>
  <AR-PACKAGE>
    <SHORT-NAME>AURIX2G_I2c</SHORT-NAME>
    <AR-PACKAGES>
      <AR-PACKAGE>
        <SHORT-NAME>BswModuleDescriptions</SHORT-NAME>
        <CATEGORY>STANDARD</CATEGORY>
        <ELEMENTS>
          <BSW-MODULE-DESCRIPTION>
            <SHORT-NAME>I2c</SHORT-NAME>
            <LONG-NAME>
              <L-4 L="EN">Inter Integrated Circuit Driver</L-4>
            </LONG-NAME>
            <CATEGORY>BSW_MODULE</CATEGORY>
            <MODULE-ID>255</MODULE-ID>
            <PROVIDED-ENTRYS>
              <BSW-MODULE-ENTRY-REF-CONDITIONAL>
                <BSW-MODULE-ENTRY-REF DEST="BSW-MODULE-ENTRY">/AURIX2G_I2c/BswModuleEntrys/I2c_Init</BSW-MODULE-ENTRY-REF>
              </BSW-MODULE-ENTRY-REF-CONDITIONAL>
              <BSW-MODULE-ENTRY-REF-CONDITIONAL>
                <BSW-MODULE-ENTRY-REF DEST="BSW-MODULE-ENTRY">/AURIX2G_I2c/BswModuleEntrys/I2c_DeInit</BSW-MODULE-ENTRY-REF>
              </BSW-MODULE-ENTRY-REF-CONDITIONAL>
              <BSW-MODULE-ENTRY-REF-CONDITIONAL>
                <BSW-MODULE-ENTRY-REF DEST="BSW-MODULE-ENTRY">/AURIX2G_I2c/BswModuleEntrys/I2c_SyncRead</BSW-MODULE-ENTRY-REF>
              </BSW-MODULE-ENTRY-REF-CONDITIONAL>
              <BSW-MODULE-ENTRY-REF-CONDITIONAL>
                <BSW-MODULE-ENTRY-REF DEST="BSW-MODULE-ENTRY">/AURIX2G_I2c/BswModuleEntrys/I2c_AsyncRead</BSW-MODULE-ENTRY-REF>
              </BSW-MODULE-ENTRY-REF-CONDITIONAL>
              <BSW-MODULE-ENTRY-REF-CONDITIONAL>
                <BSW-MODULE-ENTRY-REF DEST="BSW-MODULE-ENTRY">/AURIX2G_I2c/BswModuleEntrys/I2c_SyncWrite</BSW-MODULE-ENTRY-REF>
              </BSW-MODULE-ENTRY-REF-CONDITIONAL>
              <BSW-MODULE-ENTRY-REF-CONDITIONAL>
                <BSW-MODULE-ENTRY-REF DEST="BSW-MODULE-ENTRY">/AURIX2G_I2c/BswModuleEntrys/I2c_AsyncWrite</BSW-MODULE-ENTRY-REF>
              </BSW-MODULE-ENTRY-REF-CONDITIONAL>
              <BSW-MODULE-ENTRY-REF-CONDITIONAL>
                <BSW-MODULE-ENTRY-REF DEST="BSW-MODULE-ENTRY">/AURIX2G_I2c/BswModuleEntrys/I2c_GetStatus</BSW-MODULE-ENTRY-REF>
              </BSW-MODULE-ENTRY-REF-CONDITIONAL>
              [!IF "$I2c_VersionInfo_check = 'true'"!]
              <BSW-MODULE-ENTRY-REF-CONDITIONAL>
                <BSW-MODULE-ENTRY-REF DEST="BSW-MODULE-ENTRY">/AURIX2G_I2c/BswModuleEntrys/I2c_GetVersionInfo</BSW-MODULE-ENTRY-REF>
              </BSW-MODULE-ENTRY-REF-CONDITIONAL>
              [!ENDIF!][!//
              <BSW-MODULE-ENTRY-REF-CONDITIONAL>
                <BSW-MODULE-ENTRY-REF DEST="BSW-MODULE-ENTRY">/AURIX2G_I2c/BswModuleEntrys/I2c_CancelOperation</BSW-MODULE-ENTRY-REF>
              </BSW-MODULE-ENTRY-REF-CONDITIONAL>
              <BSW-MODULE-ENTRY-REF-CONDITIONAL>
                <BSW-MODULE-ENTRY-REF DEST="BSW-MODULE-ENTRY">/AURIX2G_I2c/BswModuleEntrys/I2c_IsrI2cDtr</BSW-MODULE-ENTRY-REF>
              </BSW-MODULE-ENTRY-REF-CONDITIONAL>
              <BSW-MODULE-ENTRY-REF-CONDITIONAL>
                <BSW-MODULE-ENTRY-REF DEST="BSW-MODULE-ENTRY">/AURIX2G_I2c/BswModuleEntrys/I2c_IsrI2cProtocol</BSW-MODULE-ENTRY-REF>
              </BSW-MODULE-ENTRY-REF-CONDITIONAL>
              <BSW-MODULE-ENTRY-REF-CONDITIONAL>
                <BSW-MODULE-ENTRY-REF DEST="BSW-MODULE-ENTRY">/AURIX2G_I2c/BswModuleEntrys/I2c_IsrI2cError</BSW-MODULE-ENTRY-REF>
              </BSW-MODULE-ENTRY-REF-CONDITIONAL>
            </PROVIDED-ENTRYS>
            <BSW-MODULE-DEPENDENCYS>
              <BSW-MODULE-DEPENDENCY>
                <SHORT-NAME>DetDependency</SHORT-NAME>
                <TARGET-MODULE-ID>15</TARGET-MODULE-ID>
                <REQUIRED-ENTRYS>
                  <BSW-MODULE-ENTRY-REF-CONDITIONAL>
                    <BSW-MODULE-ENTRY-REF DEST="BSW-MODULE-ENTRY">/AUTOSAR_Det/BswModuleEntrys/Det_ReportError</BSW-MODULE-ENTRY-REF>
                  </BSW-MODULE-ENTRY-REF-CONDITIONAL>
                </REQUIRED-ENTRYS>
              </BSW-MODULE-DEPENDENCY>
            </BSW-MODULE-DEPENDENCYS>
            <INTERNAL-BEHAVIORS>
              <BSW-INTERNAL-BEHAVIOR>
                <SHORT-NAME>I2cBehavior</SHORT-NAME>
                <ENTITYS>
                  <BSW-CALLED-ENTITY>
                    <SHORT-NAME>I2c_Init</SHORT-NAME>
                    <REENTRANCY-LEVEL>NON-REENTRANT</REENTRANCY-LEVEL>
                    <IMPLEMENTED-ENTRY-REF DEST="BSW-MODULE-ENTRY">/AURIX2G_I2c/BswModuleEntrys/I2c_Init</IMPLEMENTED-ENTRY-REF>
                  </BSW-CALLED-ENTITY>
                  <BSW-CALLED-ENTITY>
                    <SHORT-NAME>I2c_DeInit</SHORT-NAME>
                    <REENTRANCY-LEVEL>NON-REENTRANT</REENTRANCY-LEVEL>
                    <IMPLEMENTED-ENTRY-REF DEST="BSW-MODULE-ENTRY">/AURIX2G_I2c/BswModuleEntrys/I2c_DeInit</IMPLEMENTED-ENTRY-REF>
                  </BSW-CALLED-ENTITY>
                  <BSW-CALLED-ENTITY>
                    <SHORT-NAME>I2c_SyncRead</SHORT-NAME>
                    <REENTRANCY-LEVEL>NON-REENTRANT</REENTRANCY-LEVEL>
                    <IMPLEMENTED-ENTRY-REF DEST="BSW-MODULE-ENTRY">/AURIX2G_I2c/BswModuleEntrys/I2c_SyncRead</IMPLEMENTED-ENTRY-REF>
                  </BSW-CALLED-ENTITY>
                  <BSW-CALLED-ENTITY>
                    <SHORT-NAME>I2c_AsyncRead</SHORT-NAME>
                    <REENTRANCY-LEVEL>NON-REENTRANT</REENTRANCY-LEVEL>
                    <IMPLEMENTED-ENTRY-REF DEST="BSW-MODULE-ENTRY">/AURIX2G_I2c/BswModuleEntrys/I2c_AsyncRead</IMPLEMENTED-ENTRY-REF>
                  </BSW-CALLED-ENTITY>
                  <BSW-CALLED-ENTITY>
                    <SHORT-NAME>I2c_SyncWrite</SHORT-NAME>
                    <REENTRANCY-LEVEL>NON-REENTRANT</REENTRANCY-LEVEL>
                    <IMPLEMENTED-ENTRY-REF DEST="BSW-MODULE-ENTRY">/AURIX2G_I2c/BswModuleEntrys/I2c_SyncWrite</IMPLEMENTED-ENTRY-REF>
                  </BSW-CALLED-ENTITY>
                  <BSW-CALLED-ENTITY>
                    <SHORT-NAME>I2c_AsyncWrite</SHORT-NAME>
                    <REENTRANCY-LEVEL>NON-REENTRANT</REENTRANCY-LEVEL>
                    <IMPLEMENTED-ENTRY-REF DEST="BSW-MODULE-ENTRY">/AURIX2G_I2c/BswModuleEntrys/I2c_AsyncWrite</IMPLEMENTED-ENTRY-REF>
                  </BSW-CALLED-ENTITY>
                  <BSW-INTERRUPT-ENTITY>
                      <SHORT-NAME>I2c_IsrI2cDtr</SHORT-NAME>
                      <REENTRANCY-LEVEL>NON-REENTRANT</REENTRANCY-LEVEL>
                      <IMPLEMENTED-ENTRY-REF DEST="BSW-MODULE-ENTRY">/AURIX2G_I2c/BswModuleEntrys/I2c_IsrI2cDtr</IMPLEMENTED-ENTRY-REF>
                   </BSW-INTERRUPT-ENTITY>
                   <BSW-INTERRUPT-ENTITY>
                      <SHORT-NAME>I2c_IsrI2cProtocol</SHORT-NAME>
                      <REENTRANCY-LEVEL>NON-REENTRANT</REENTRANCY-LEVEL>
                      <IMPLEMENTED-ENTRY-REF DEST="BSW-MODULE-ENTRY">/AURIX2G_I2c/BswModuleEntrys/I2c_IsrI2cProtocol</IMPLEMENTED-ENTRY-REF>
                   </BSW-INTERRUPT-ENTITY>
                   <BSW-INTERRUPT-ENTITY>
                      <SHORT-NAME>I2c_IsrI2cError</SHORT-NAME>
                      <REENTRANCY-LEVEL>NON-REENTRANT</REENTRANCY-LEVEL>
                      <IMPLEMENTED-ENTRY-REF DEST="BSW-MODULE-ENTRY">/AURIX2G_I2c/BswModuleEntrys/I2c_IsrI2cError</IMPLEMENTED-ENTRY-REF>
                   </BSW-INTERRUPT-ENTITY>
                  <BSW-CALLED-ENTITY>
                    <SHORT-NAME>I2c_CancelOperation</SHORT-NAME>
                    <REENTRANCY-LEVEL>NON-REENTRANT</REENTRANCY-LEVEL>
                    <IMPLEMENTED-ENTRY-REF DEST="BSW-MODULE-ENTRY">/AURIX2G_I2c/BswModuleEntrys/I2c_CancelOperation</IMPLEMENTED-ENTRY-REF>
                  </BSW-CALLED-ENTITY>
                  <BSW-CALLED-ENTITY>
                    <SHORT-NAME>I2c_GetStatus</SHORT-NAME>
                    <REENTRANCY-LEVEL>SINGLE-CORE-REENTRANT</REENTRANCY-LEVEL>
                    <IMPLEMENTED-ENTRY-REF DEST="BSW-MODULE-ENTRY">/AURIX2G_I2c/BswModuleEntrys/I2c_GetStatus</IMPLEMENTED-ENTRY-REF>
                  </BSW-CALLED-ENTITY>
[!IF "$I2c_VersionInfo_check = 'true'"!]
                  <BSW-CALLED-ENTITY>
                    <SHORT-NAME>I2c_GetVersionInfo</SHORT-NAME>
                    <REENTRANCY-LEVEL>SINGLE-CORE-REENTRANT</REENTRANCY-LEVEL>
                    <IMPLEMENTED-ENTRY-REF DEST="BSW-MODULE-ENTRY">/AURIX2G_I2c/BswModuleEntrys/I2c_GetVersionInfo</IMPLEMENTED-ENTRY-REF>
                  </BSW-CALLED-ENTITY>
[!ENDIF!][!//
                </ENTITYS>
              </BSW-INTERNAL-BEHAVIOR>
            </INTERNAL-BEHAVIORS>
          </BSW-MODULE-DESCRIPTION>
        </ELEMENTS>
      </AR-PACKAGE>
      <AR-PACKAGE>
        <SHORT-NAME>BswModuleEntrys</SHORT-NAME>
        <CATEGORY>STANDARD</CATEGORY>
        <ELEMENTS>
          <BSW-MODULE-ENTRY>
            <SHORT-NAME>I2c_Init</SHORT-NAME>
            <SERVICE-ID>79</SERVICE-ID>
            <IS-REENTRANT>false</IS-REENTRANT>
            <IS-SYNCHRONOUS>true</IS-SYNCHRONOUS>
            <CALL-TYPE>REGULAR</CALL-TYPE>
            <EXECUTION-CONTEXT>TASK</EXECUTION-CONTEXT>
            <SW-SERVICE-IMPL-POLICY>STANDARD</SW-SERVICE-IMPL-POLICY>
            <ARGUMENTS>
              <SW-SERVICE-ARG>
                <SHORT-NAME>ConfigPtr</SHORT-NAME>
                <CATEGORY>DATA_REFERENCE</CATEGORY>
                <SW-DATA-DEF-PROPS>
                  <SW-DATA-DEF-PROPS-VARIANTS>
                    <SW-DATA-DEF-PROPS-CONDITIONAL>
                      <SW-POINTER-TARGET-PROPS>
                        <TARGET-CATEGORY>TYPE_REFERENCE</TARGET-CATEGORY>
                        <SW-DATA-DEF-PROPS>
                          <SW-DATA-DEF-PROPS-VARIANTS>
                            <SW-DATA-DEF-PROPS-CONDITIONAL>
                              <IMPLEMENTATION-DATA-TYPE-REF DEST = "IMPLEMENTATION-DATA-TYPE">/AURIX2G_I2c/ImplementationDataTypes/I2c_ConfigType</IMPLEMENTATION-DATA-TYPE-REF>
                            </SW-DATA-DEF-PROPS-CONDITIONAL>
                          </SW-DATA-DEF-PROPS-VARIANTS>
                        </SW-DATA-DEF-PROPS>
                      </SW-POINTER-TARGET-PROPS>
                    </SW-DATA-DEF-PROPS-CONDITIONAL>
                  </SW-DATA-DEF-PROPS-VARIANTS>
                </SW-DATA-DEF-PROPS>
              </SW-SERVICE-ARG>
            </ARGUMENTS>
          </BSW-MODULE-ENTRY>
          <BSW-MODULE-ENTRY>
            <SHORT-NAME>I2c_DeInit</SHORT-NAME>
            <SERVICE-ID>80</SERVICE-ID>
            <IS-REENTRANT>false</IS-REENTRANT>
            <IS-SYNCHRONOUS>true</IS-SYNCHRONOUS>
            <CALL-TYPE>REGULAR</CALL-TYPE>
            <EXECUTION-CONTEXT>TASK</EXECUTION-CONTEXT>
            <SW-SERVICE-IMPL-POLICY>STANDARD</SW-SERVICE-IMPL-POLICY>
            <RETURN-TYPE>
              <SHORT-NAME>Return</SHORT-NAME>
              <CATEGORY>TYPE_REFERENCE</CATEGORY>
              <SW-DATA-DEF-PROPS>
                <SW-DATA-DEF-PROPS-VARIANTS>
                  <SW-DATA-DEF-PROPS-CONDITIONAL>
                    <IMPLEMENTATION-DATA-TYPE-REF DEST = "IMPLEMENTATION-DATA-TYPE">/AUTOSAR_Std/ImplementationDataTypes/Std_ReturnType</IMPLEMENTATION-DATA-TYPE-REF>
                  </SW-DATA-DEF-PROPS-CONDITIONAL>
                </SW-DATA-DEF-PROPS-VARIANTS>
              </SW-DATA-DEF-PROPS>
            </RETURN-TYPE>
          </BSW-MODULE-ENTRY>
          <BSW-MODULE-ENTRY>
            <SHORT-NAME>I2c_SyncWrite</SHORT-NAME>
            <SERVICE-ID>81</SERVICE-ID>
            <IS-REENTRANT>false</IS-REENTRANT>
            <IS-SYNCHRONOUS>true</IS-SYNCHRONOUS>
            <CALL-TYPE>REGULAR</CALL-TYPE>
            <EXECUTION-CONTEXT>TASK</EXECUTION-CONTEXT>
            <SW-SERVICE-IMPL-POLICY>STANDARD</SW-SERVICE-IMPL-POLICY>
            <RETURN-TYPE>
              <SHORT-NAME>Return</SHORT-NAME>
              <CATEGORY>TYPE_REFERENCE</CATEGORY>
              <SW-DATA-DEF-PROPS>
                <SW-DATA-DEF-PROPS-VARIANTS>
                  <SW-DATA-DEF-PROPS-CONDITIONAL>
                    <IMPLEMENTATION-DATA-TYPE-REF DEST = "IMPLEMENTATION-DATA-TYPE">/AURIX2G_I2c/ImplementationDataTypes/I2c_ErrorType</IMPLEMENTATION-DATA-TYPE-REF>
                  </SW-DATA-DEF-PROPS-CONDITIONAL>
                </SW-DATA-DEF-PROPS-VARIANTS>
              </SW-DATA-DEF-PROPS>
            </RETURN-TYPE>
            <ARGUMENTS>
              <SW-SERVICE-ARG>
                <SHORT-NAME>ChannelId</SHORT-NAME>
                <CATEGORY>TYPE_REFERENCE</CATEGORY>
                <SW-DATA-DEF-PROPS>
                  <SW-DATA-DEF-PROPS-VARIANTS>
                    <SW-DATA-DEF-PROPS-CONDITIONAL>
                      <IMPLEMENTATION-DATA-TYPE-REF DEST = "IMPLEMENTATION-DATA-TYPE">/AURIX2G_I2c/ImplementationDataTypes/I2c_ChannelType</IMPLEMENTATION-DATA-TYPE-REF>
                    </SW-DATA-DEF-PROPS-CONDITIONAL>
                  </SW-DATA-DEF-PROPS-VARIANTS>
                </SW-DATA-DEF-PROPS>
              </SW-SERVICE-ARG>
              <SW-SERVICE-ARG>
                <SHORT-NAME>DataPtr</SHORT-NAME>
                <CATEGORY>DATA_REFERENCE</CATEGORY>
                <SW-DATA-DEF-PROPS>
                  <SW-DATA-DEF-PROPS-VARIANTS>
                    <SW-DATA-DEF-PROPS-CONDITIONAL>
                    <SW-POINTER-TARGET-PROPS>
                    <TARGET-CATEGORY>TYPE_REFERENCE</TARGET-CATEGORY>
                    <SW-DATA-DEF-PROPS>
                    <SW-DATA-DEF-PROPS-VARIANTS>
                    <SW-DATA-DEF-PROPS-CONDITIONAL>
                      <IMPLEMENTATION-DATA-TYPE-REF DEST = "IMPLEMENTATION-DATA-TYPE">/AURIX2G_I2c/ImplementationDataTypes/I2c_DataType</IMPLEMENTATION-DATA-TYPE-REF>
                    </SW-DATA-DEF-PROPS-CONDITIONAL>
                    </SW-DATA-DEF-PROPS-VARIANTS>
                    </SW-DATA-DEF-PROPS>
                    </SW-POINTER-TARGET-PROPS>
                    </SW-DATA-DEF-PROPS-CONDITIONAL>
                  </SW-DATA-DEF-PROPS-VARIANTS>
                </SW-DATA-DEF-PROPS>
              </SW-SERVICE-ARG>
              <SW-SERVICE-ARG>
                <SHORT-NAME>Size</SHORT-NAME>
                <CATEGORY>TYPE_REFERENCE</CATEGORY>
                <SW-DATA-DEF-PROPS>
                  <SW-DATA-DEF-PROPS-VARIANTS>
                    <SW-DATA-DEF-PROPS-CONDITIONAL>
                      <IMPLEMENTATION-DATA-TYPE-REF DEST = "IMPLEMENTATION-DATA-TYPE">/AURIX2G_I2c/ImplementationDataTypes/I2c_SizeType</IMPLEMENTATION-DATA-TYPE-REF>
                    </SW-DATA-DEF-PROPS-CONDITIONAL>
                  </SW-DATA-DEF-PROPS-VARIANTS>
                </SW-DATA-DEF-PROPS>
              </SW-SERVICE-ARG>
              <SW-SERVICE-ARG>
                <SHORT-NAME>SlaveAddress</SHORT-NAME>
                <CATEGORY>TYPE_REFERENCE</CATEGORY>
                <SW-DATA-DEF-PROPS>
                  <SW-DATA-DEF-PROPS-VARIANTS>
                    <SW-DATA-DEF-PROPS-CONDITIONAL>
                      <IMPLEMENTATION-DATA-TYPE-REF DEST = "IMPLEMENTATION-DATA-TYPE">/AURIX2G_I2c/ImplementationDataTypes/I2c_SlaveAddrType</IMPLEMENTATION-DATA-TYPE-REF>
                    </SW-DATA-DEF-PROPS-CONDITIONAL>
                  </SW-DATA-DEF-PROPS-VARIANTS>
                </SW-DATA-DEF-PROPS>
              </SW-SERVICE-ARG>
            </ARGUMENTS>
          </BSW-MODULE-ENTRY>
          <BSW-MODULE-ENTRY>
            <SHORT-NAME>I2c_AsyncWrite</SHORT-NAME>
            <SERVICE-ID>83</SERVICE-ID>
            <IS-REENTRANT>false</IS-REENTRANT>
            <IS-SYNCHRONOUS>false</IS-SYNCHRONOUS>
            <CALL-TYPE>REGULAR</CALL-TYPE>
            <EXECUTION-CONTEXT>TASK</EXECUTION-CONTEXT>
            <SW-SERVICE-IMPL-POLICY>STANDARD</SW-SERVICE-IMPL-POLICY>
            <RETURN-TYPE>
              <SHORT-NAME>Return</SHORT-NAME>
              <CATEGORY>TYPE_REFERENCE</CATEGORY>
              <SW-DATA-DEF-PROPS>
                <SW-DATA-DEF-PROPS-VARIANTS>
                  <SW-DATA-DEF-PROPS-CONDITIONAL>
                    <IMPLEMENTATION-DATA-TYPE-REF DEST = "IMPLEMENTATION-DATA-TYPE">/AURIX2G_I2c/ImplementationDataTypes/I2c_ErrorType</IMPLEMENTATION-DATA-TYPE-REF>
                  </SW-DATA-DEF-PROPS-CONDITIONAL>
                </SW-DATA-DEF-PROPS-VARIANTS>
              </SW-DATA-DEF-PROPS>
            </RETURN-TYPE>
            <ARGUMENTS>
              <SW-SERVICE-ARG>
                <SHORT-NAME>ChannelId</SHORT-NAME>
                <CATEGORY>TYPE_REFERENCE</CATEGORY>
                <SW-DATA-DEF-PROPS>
                  <SW-DATA-DEF-PROPS-VARIANTS>
                    <SW-DATA-DEF-PROPS-CONDITIONAL>
                      <IMPLEMENTATION-DATA-TYPE-REF DEST = "IMPLEMENTATION-DATA-TYPE">/AURIX2G_I2c/ImplementationDataTypes/I2c_ChannelType</IMPLEMENTATION-DATA-TYPE-REF>
                    </SW-DATA-DEF-PROPS-CONDITIONAL>
                  </SW-DATA-DEF-PROPS-VARIANTS>
                </SW-DATA-DEF-PROPS>
              </SW-SERVICE-ARG>
              <SW-SERVICE-ARG>
                <SHORT-NAME>DataPtr</SHORT-NAME>
                <CATEGORY>DATA_REFERENCE</CATEGORY>
                <SW-DATA-DEF-PROPS>
                  <SW-DATA-DEF-PROPS-VARIANTS>
                    <SW-DATA-DEF-PROPS-CONDITIONAL>
                    <SW-POINTER-TARGET-PROPS>
                    <TARGET-CATEGORY>TYPE_REFERENCE</TARGET-CATEGORY>
                    <SW-DATA-DEF-PROPS>
                    <SW-DATA-DEF-PROPS-VARIANTS>
                    <SW-DATA-DEF-PROPS-CONDITIONAL>
                      <IMPLEMENTATION-DATA-TYPE-REF DEST = "IMPLEMENTATION-DATA-TYPE">/AURIX2G_I2c/ImplementationDataTypes/I2c_DataType</IMPLEMENTATION-DATA-TYPE-REF>
                    </SW-DATA-DEF-PROPS-CONDITIONAL>
                    </SW-DATA-DEF-PROPS-VARIANTS>
                    </SW-DATA-DEF-PROPS>
                    </SW-POINTER-TARGET-PROPS>
                    </SW-DATA-DEF-PROPS-CONDITIONAL>
                  </SW-DATA-DEF-PROPS-VARIANTS>
                </SW-DATA-DEF-PROPS>
              </SW-SERVICE-ARG>
              <SW-SERVICE-ARG>
                <SHORT-NAME>Size</SHORT-NAME>
                <CATEGORY>TYPE_REFERENCE</CATEGORY>
                <SW-DATA-DEF-PROPS>
                  <SW-DATA-DEF-PROPS-VARIANTS>
                    <SW-DATA-DEF-PROPS-CONDITIONAL>
                      <IMPLEMENTATION-DATA-TYPE-REF DEST = "IMPLEMENTATION-DATA-TYPE">/AURIX2G_I2c/ImplementationDataTypes/I2c_SizeType</IMPLEMENTATION-DATA-TYPE-REF>
                    </SW-DATA-DEF-PROPS-CONDITIONAL>
                  </SW-DATA-DEF-PROPS-VARIANTS>
                </SW-DATA-DEF-PROPS>
              </SW-SERVICE-ARG>
              <SW-SERVICE-ARG>
                <SHORT-NAME>SlaveAddress</SHORT-NAME>
                <CATEGORY>TYPE_REFERENCE</CATEGORY>
                <SW-DATA-DEF-PROPS>
                  <SW-DATA-DEF-PROPS-VARIANTS>
                    <SW-DATA-DEF-PROPS-CONDITIONAL>
                      <IMPLEMENTATION-DATA-TYPE-REF DEST = "IMPLEMENTATION-DATA-TYPE">/AURIX2G_I2c/ImplementationDataTypes/I2c_SlaveAddrType</IMPLEMENTATION-DATA-TYPE-REF>
                    </SW-DATA-DEF-PROPS-CONDITIONAL>
                  </SW-DATA-DEF-PROPS-VARIANTS>
                </SW-DATA-DEF-PROPS>
              </SW-SERVICE-ARG>
            </ARGUMENTS>
          </BSW-MODULE-ENTRY>
          <BSW-MODULE-ENTRY>
            <SHORT-NAME>I2c_SyncRead</SHORT-NAME>
            <SERVICE-ID>82</SERVICE-ID>
            <IS-REENTRANT>false</IS-REENTRANT>
            <IS-SYNCHRONOUS>true</IS-SYNCHRONOUS>
            <CALL-TYPE>REGULAR</CALL-TYPE>
            <EXECUTION-CONTEXT>TASK</EXECUTION-CONTEXT>
            <SW-SERVICE-IMPL-POLICY>STANDARD</SW-SERVICE-IMPL-POLICY>
            <RETURN-TYPE>
              <SHORT-NAME>Return</SHORT-NAME>
              <CATEGORY>TYPE_REFERENCE</CATEGORY>
              <SW-DATA-DEF-PROPS>
                <SW-DATA-DEF-PROPS-VARIANTS>
                  <SW-DATA-DEF-PROPS-CONDITIONAL>
                    <IMPLEMENTATION-DATA-TYPE-REF DEST = "IMPLEMENTATION-DATA-TYPE">/AURIX2G_I2c/ImplementationDataTypes/I2c_ErrorType</IMPLEMENTATION-DATA-TYPE-REF>
                  </SW-DATA-DEF-PROPS-CONDITIONAL>
                </SW-DATA-DEF-PROPS-VARIANTS>
              </SW-DATA-DEF-PROPS>
            </RETURN-TYPE>
            <ARGUMENTS>
              <SW-SERVICE-ARG>
                <SHORT-NAME>ChannelId</SHORT-NAME>
                <CATEGORY>TYPE_REFERENCE</CATEGORY>
                <SW-DATA-DEF-PROPS>
                  <SW-DATA-DEF-PROPS-VARIANTS>
                    <SW-DATA-DEF-PROPS-CONDITIONAL>
                      <IMPLEMENTATION-DATA-TYPE-REF DEST = "IMPLEMENTATION-DATA-TYPE">/AURIX2G_I2c/ImplementationDataTypes/I2c_ChannelType</IMPLEMENTATION-DATA-TYPE-REF>
                    </SW-DATA-DEF-PROPS-CONDITIONAL>
                  </SW-DATA-DEF-PROPS-VARIANTS>
                </SW-DATA-DEF-PROPS>
              </SW-SERVICE-ARG>
              <SW-SERVICE-ARG>
                <SHORT-NAME>DataPtr</SHORT-NAME>
                <CATEGORY>DATA_REFERENCE</CATEGORY>
                <SW-DATA-DEF-PROPS>
                  <SW-DATA-DEF-PROPS-VARIANTS>
                    <SW-DATA-DEF-PROPS-CONDITIONAL>
                    <SW-POINTER-TARGET-PROPS>
                    <TARGET-CATEGORY>TYPE_REFERENCE</TARGET-CATEGORY>
                    <SW-DATA-DEF-PROPS>
                    <SW-DATA-DEF-PROPS-VARIANTS>
                    <SW-DATA-DEF-PROPS-CONDITIONAL>
                      <IMPLEMENTATION-DATA-TYPE-REF DEST = "IMPLEMENTATION-DATA-TYPE">/AURIX2G_I2c/ImplementationDataTypes/I2c_DataType</IMPLEMENTATION-DATA-TYPE-REF>
                    </SW-DATA-DEF-PROPS-CONDITIONAL>
                    </SW-DATA-DEF-PROPS-VARIANTS>
                    </SW-DATA-DEF-PROPS>
                    </SW-POINTER-TARGET-PROPS>
                    </SW-DATA-DEF-PROPS-CONDITIONAL>
                  </SW-DATA-DEF-PROPS-VARIANTS>
                </SW-DATA-DEF-PROPS>
              </SW-SERVICE-ARG>
              <SW-SERVICE-ARG>
                <SHORT-NAME>Size</SHORT-NAME>
                <CATEGORY>TYPE_REFERENCE</CATEGORY>
                <SW-DATA-DEF-PROPS>
                  <SW-DATA-DEF-PROPS-VARIANTS>
                    <SW-DATA-DEF-PROPS-CONDITIONAL>
                      <IMPLEMENTATION-DATA-TYPE-REF DEST = "IMPLEMENTATION-DATA-TYPE">/AURIX2G_I2c/ImplementationDataTypes/I2c_SizeType</IMPLEMENTATION-DATA-TYPE-REF>
                    </SW-DATA-DEF-PROPS-CONDITIONAL>
                  </SW-DATA-DEF-PROPS-VARIANTS>
                </SW-DATA-DEF-PROPS>
              </SW-SERVICE-ARG>
              <SW-SERVICE-ARG>
                <SHORT-NAME>SlaveAddress</SHORT-NAME>
                <CATEGORY>TYPE_REFERENCE</CATEGORY>
                <SW-DATA-DEF-PROPS>
                  <SW-DATA-DEF-PROPS-VARIANTS>
                    <SW-DATA-DEF-PROPS-CONDITIONAL>
                      <IMPLEMENTATION-DATA-TYPE-REF DEST = "IMPLEMENTATION-DATA-TYPE">/AURIX2G_I2c/ImplementationDataTypes/I2c_SlaveAddrType</IMPLEMENTATION-DATA-TYPE-REF>
                    </SW-DATA-DEF-PROPS-CONDITIONAL>
                  </SW-DATA-DEF-PROPS-VARIANTS>
                </SW-DATA-DEF-PROPS>
              </SW-SERVICE-ARG>
            </ARGUMENTS>
          </BSW-MODULE-ENTRY>
          <BSW-MODULE-ENTRY>
            <SHORT-NAME>I2c_AsyncRead</SHORT-NAME>
            <SERVICE-ID>84</SERVICE-ID>
            <IS-REENTRANT>false</IS-REENTRANT>
            <IS-SYNCHRONOUS>false</IS-SYNCHRONOUS>
            <CALL-TYPE>REGULAR</CALL-TYPE>
            <EXECUTION-CONTEXT>TASK</EXECUTION-CONTEXT>
            <SW-SERVICE-IMPL-POLICY>STANDARD</SW-SERVICE-IMPL-POLICY>
            <RETURN-TYPE>
              <SHORT-NAME>Return</SHORT-NAME>
              <CATEGORY>TYPE_REFERENCE</CATEGORY>
              <SW-DATA-DEF-PROPS>
                <SW-DATA-DEF-PROPS-VARIANTS>
                  <SW-DATA-DEF-PROPS-CONDITIONAL>
                    <IMPLEMENTATION-DATA-TYPE-REF DEST = "IMPLEMENTATION-DATA-TYPE">/AURIX2G_I2c/ImplementationDataTypes/I2c_ErrorType</IMPLEMENTATION-DATA-TYPE-REF>
                  </SW-DATA-DEF-PROPS-CONDITIONAL>
                </SW-DATA-DEF-PROPS-VARIANTS>
              </SW-DATA-DEF-PROPS>
            </RETURN-TYPE>
            <ARGUMENTS>
              <SW-SERVICE-ARG>
                <SHORT-NAME>ChannelId</SHORT-NAME>
                <CATEGORY>TYPE_REFERENCE</CATEGORY>
                <SW-DATA-DEF-PROPS>
                  <SW-DATA-DEF-PROPS-VARIANTS>
                    <SW-DATA-DEF-PROPS-CONDITIONAL>
                      <IMPLEMENTATION-DATA-TYPE-REF DEST = "IMPLEMENTATION-DATA-TYPE">/AURIX2G_I2c/ImplementationDataTypes/I2c_ChannelType</IMPLEMENTATION-DATA-TYPE-REF>
                    </SW-DATA-DEF-PROPS-CONDITIONAL>
                  </SW-DATA-DEF-PROPS-VARIANTS>
                </SW-DATA-DEF-PROPS>
              </SW-SERVICE-ARG>
              <SW-SERVICE-ARG>
                <SHORT-NAME>DataPtr</SHORT-NAME>
                <CATEGORY>DATA_REFERENCE</CATEGORY>
                <SW-DATA-DEF-PROPS>
                  <SW-DATA-DEF-PROPS-VARIANTS>
                    <SW-DATA-DEF-PROPS-CONDITIONAL>
                    <SW-POINTER-TARGET-PROPS>
                    <TARGET-CATEGORY>TYPE_REFERENCE</TARGET-CATEGORY>
                    <SW-DATA-DEF-PROPS>
                    <SW-DATA-DEF-PROPS-VARIANTS>
                    <SW-DATA-DEF-PROPS-CONDITIONAL>
                      <IMPLEMENTATION-DATA-TYPE-REF DEST = "IMPLEMENTATION-DATA-TYPE">/AURIX2G_I2c/ImplementationDataTypes/I2c_DataType</IMPLEMENTATION-DATA-TYPE-REF>
                    </SW-DATA-DEF-PROPS-CONDITIONAL>
                    </SW-DATA-DEF-PROPS-VARIANTS>
                    </SW-DATA-DEF-PROPS>
                    </SW-POINTER-TARGET-PROPS>
                    </SW-DATA-DEF-PROPS-CONDITIONAL>
                  </SW-DATA-DEF-PROPS-VARIANTS>
                </SW-DATA-DEF-PROPS>
              </SW-SERVICE-ARG>
              <SW-SERVICE-ARG>
                <SHORT-NAME>Size</SHORT-NAME>
                <CATEGORY>TYPE_REFERENCE</CATEGORY>
                <SW-DATA-DEF-PROPS>
                  <SW-DATA-DEF-PROPS-VARIANTS>
                    <SW-DATA-DEF-PROPS-CONDITIONAL>
                      <IMPLEMENTATION-DATA-TYPE-REF DEST = "IMPLEMENTATION-DATA-TYPE">/AURIX2G_I2c/ImplementationDataTypes/I2c_SizeType</IMPLEMENTATION-DATA-TYPE-REF>
                    </SW-DATA-DEF-PROPS-CONDITIONAL>
                  </SW-DATA-DEF-PROPS-VARIANTS>
                </SW-DATA-DEF-PROPS>
              </SW-SERVICE-ARG>
              <SW-SERVICE-ARG>
                <SHORT-NAME>SlaveAddress</SHORT-NAME>
                <CATEGORY>TYPE_REFERENCE</CATEGORY>
                <SW-DATA-DEF-PROPS>
                  <SW-DATA-DEF-PROPS-VARIANTS>
                    <SW-DATA-DEF-PROPS-CONDITIONAL>
                      <IMPLEMENTATION-DATA-TYPE-REF DEST = "IMPLEMENTATION-DATA-TYPE">/AURIX2G_I2c/ImplementationDataTypes/I2c_SlaveAddrType</IMPLEMENTATION-DATA-TYPE-REF>
                    </SW-DATA-DEF-PROPS-CONDITIONAL>
                  </SW-DATA-DEF-PROPS-VARIANTS>
                </SW-DATA-DEF-PROPS>
              </SW-SERVICE-ARG>
            </ARGUMENTS>
          </BSW-MODULE-ENTRY>
          <BSW-MODULE-ENTRY>
            <SHORT-NAME>I2c_GetStatus</SHORT-NAME>
            <SERVICE-ID>85</SERVICE-ID>
            <IS-REENTRANT>true</IS-REENTRANT>
            <IS-SYNCHRONOUS>true</IS-SYNCHRONOUS>
            <CALL-TYPE>REGULAR</CALL-TYPE>
            <EXECUTION-CONTEXT>TASK</EXECUTION-CONTEXT>
            <SW-SERVICE-IMPL-POLICY>STANDARD</SW-SERVICE-IMPL-POLICY>
            <RETURN-TYPE>
              <SHORT-NAME>Return</SHORT-NAME>
              <CATEGORY>TYPE_REFERENCE</CATEGORY>
              <SW-DATA-DEF-PROPS>
                <SW-DATA-DEF-PROPS-VARIANTS>
                  <SW-DATA-DEF-PROPS-CONDITIONAL>
                    <IMPLEMENTATION-DATA-TYPE-REF DEST = "IMPLEMENTATION-DATA-TYPE">/AURIX2G_I2c/ImplementationDataTypes/I2c_ChannelStatusType</IMPLEMENTATION-DATA-TYPE-REF>
                  </SW-DATA-DEF-PROPS-CONDITIONAL>
                </SW-DATA-DEF-PROPS-VARIANTS>
              </SW-DATA-DEF-PROPS>
            </RETURN-TYPE>
            <ARGUMENTS>
              <SW-SERVICE-ARG>
                <SHORT-NAME>ChannelId</SHORT-NAME>
                <CATEGORY>TYPE_REFERENCE</CATEGORY>
                <SW-DATA-DEF-PROPS>
                  <SW-DATA-DEF-PROPS-VARIANTS>
                    <SW-DATA-DEF-PROPS-CONDITIONAL>
                      <IMPLEMENTATION-DATA-TYPE-REF DEST = "IMPLEMENTATION-DATA-TYPE">/AURIX2G_I2c/ImplementationDataTypes/I2c_ChannelType</IMPLEMENTATION-DATA-TYPE-REF>
                    </SW-DATA-DEF-PROPS-CONDITIONAL>
                  </SW-DATA-DEF-PROPS-VARIANTS>
                </SW-DATA-DEF-PROPS>
              </SW-SERVICE-ARG>
            </ARGUMENTS>
          </BSW-MODULE-ENTRY>
          <BSW-MODULE-ENTRY>
            <SHORT-NAME>I2c_CancelOperation</SHORT-NAME>
            <SERVICE-ID>86</SERVICE-ID>
            <IS-REENTRANT>false</IS-REENTRANT>
            <IS-SYNCHRONOUS>true</IS-SYNCHRONOUS>
            <CALL-TYPE>REGULAR</CALL-TYPE>
            <EXECUTION-CONTEXT>TASK</EXECUTION-CONTEXT>
            <SW-SERVICE-IMPL-POLICY>STANDARD</SW-SERVICE-IMPL-POLICY>
            <RETURN-TYPE>
              <SHORT-NAME>Return</SHORT-NAME>
              <CATEGORY>TYPE_REFERENCE</CATEGORY>
              <SW-DATA-DEF-PROPS>
                <SW-DATA-DEF-PROPS-VARIANTS>
                  <SW-DATA-DEF-PROPS-CONDITIONAL>
                    <IMPLEMENTATION-DATA-TYPE-REF DEST = "IMPLEMENTATION-DATA-TYPE">/AUTOSAR_Std/ImplementationDataTypes/Std_ReturnType</IMPLEMENTATION-DATA-TYPE-REF>
                  </SW-DATA-DEF-PROPS-CONDITIONAL>
                </SW-DATA-DEF-PROPS-VARIANTS>
              </SW-DATA-DEF-PROPS>
            </RETURN-TYPE>
            <ARGUMENTS>
              <SW-SERVICE-ARG>
                <SHORT-NAME>ChannelId</SHORT-NAME>
                <CATEGORY>TYPE_REFERENCE</CATEGORY>
                <SW-DATA-DEF-PROPS>
                  <SW-DATA-DEF-PROPS-VARIANTS>
                    <SW-DATA-DEF-PROPS-CONDITIONAL>
                      <IMPLEMENTATION-DATA-TYPE-REF DEST = "IMPLEMENTATION-DATA-TYPE">/AURIX2G_I2c/ImplementationDataTypes/I2c_ChannelType</IMPLEMENTATION-DATA-TYPE-REF>
                    </SW-DATA-DEF-PROPS-CONDITIONAL>
                  </SW-DATA-DEF-PROPS-VARIANTS>
                </SW-DATA-DEF-PROPS>
              </SW-SERVICE-ARG>
              <SW-SERVICE-ARG>
              <SHORT-NAME>TransmittedDataSize</SHORT-NAME>
              <CATEGORY>DATA_REFERENCE</CATEGORY>
              <SW-DATA-DEF-PROPS>
                <SW-DATA-DEF-PROPS-VARIANTS>
                  <SW-DATA-DEF-PROPS-CONDITIONAL>
                    <SW-POINTER-TARGET-PROPS>
                      <TARGET-CATEGORY>TYPE_REFERENCE</TARGET-CATEGORY>
                      <SW-DATA-DEF-PROPS>
                        <SW-DATA-DEF-PROPS-VARIANTS>
                          <SW-DATA-DEF-PROPS-CONDITIONAL>
                            <IMPLEMENTATION-DATA-TYPE-REF DEST = "IMPLEMENTATION-DATA-TYPE">/AURIX2G_I2c/ImplementationDataTypes/I2c_SizeType</IMPLEMENTATION-DATA-TYPE-REF>
                          </SW-DATA-DEF-PROPS-CONDITIONAL>
                        </SW-DATA-DEF-PROPS-VARIANTS>
                      </SW-DATA-DEF-PROPS>
                    </SW-POINTER-TARGET-PROPS>
                  </SW-DATA-DEF-PROPS-CONDITIONAL>
                </SW-DATA-DEF-PROPS-VARIANTS>
                </SW-DATA-DEF-PROPS>
                </SW-SERVICE-ARG>
            </ARGUMENTS>
          </BSW-MODULE-ENTRY>
[!IF "$I2c_VersionInfo_check = 'true'"!]
          <BSW-MODULE-ENTRY>
            <SHORT-NAME>I2c_GetVersionInfo</SHORT-NAME>
            <SERVICE-ID>87</SERVICE-ID>
            <IS-REENTRANT>true</IS-REENTRANT>
            <IS-SYNCHRONOUS>true</IS-SYNCHRONOUS>
            <CALL-TYPE>REGULAR</CALL-TYPE>
            <EXECUTION-CONTEXT>TASK</EXECUTION-CONTEXT>
            <SW-SERVICE-IMPL-POLICY>MACRO</SW-SERVICE-IMPL-POLICY>
            <ARGUMENTS>
              <SW-SERVICE-ARG>
                <SHORT-NAME>VersioninfoPtr</SHORT-NAME>
                <CATEGORY>DATA_REFERENCE</CATEGORY>
                <SW-DATA-DEF-PROPS>
                  <SW-DATA-DEF-PROPS-VARIANTS>
                    <SW-DATA-DEF-PROPS-CONDITIONAL>
                      <SW-POINTER-TARGET-PROPS>
                        <TARGET-CATEGORY>TYPE_REFERENCE</TARGET-CATEGORY>
                        <SW-DATA-DEF-PROPS>
                          <SW-DATA-DEF-PROPS-VARIANTS>
                            <SW-DATA-DEF-PROPS-CONDITIONAL>
                              <IMPLEMENTATION-DATA-TYPE-REF DEST = "IMPLEMENTATION-DATA-TYPE">/AUTOSAR_Std/ImplementationDataTypes/Std_VersionInfoType</IMPLEMENTATION-DATA-TYPE-REF>
                            </SW-DATA-DEF-PROPS-CONDITIONAL>
                          </SW-DATA-DEF-PROPS-VARIANTS>
                        </SW-DATA-DEF-PROPS>
                      </SW-POINTER-TARGET-PROPS>
                    </SW-DATA-DEF-PROPS-CONDITIONAL>
                  </SW-DATA-DEF-PROPS-VARIANTS>
                </SW-DATA-DEF-PROPS>
              </SW-SERVICE-ARG>
            </ARGUMENTS>
          </BSW-MODULE-ENTRY>
[!ENDIF!][!//
          <BSW-MODULE-ENTRY>
            <SHORT-NAME>I2c_IsrI2cDtr</SHORT-NAME>
            <IS-REENTRANT>false</IS-REENTRANT>
            <IS-SYNCHRONOUS>true</IS-SYNCHRONOUS>
            <CALL-TYPE>INTERRUPT</CALL-TYPE>
            <EXECUTION-CONTEXT>INTERRUPT-CAT-1</EXECUTION-CONTEXT>
            <SW-SERVICE-IMPL-POLICY>STANDARD</SW-SERVICE-IMPL-POLICY>
            <ARGUMENTS>
              <SW-SERVICE-ARG>
                <SHORT-NAME>HwUnit</SHORT-NAME>
                <CATEGORY>TYPE_REFERENCE</CATEGORY>
                <SW-DATA-DEF-PROPS>
                  <SW-DATA-DEF-PROPS-VARIANTS>
                    <SW-DATA-DEF-PROPS-CONDITIONAL>
                      <IMPLEMENTATION-DATA-TYPE-REF DEST="IMPLEMENTATION-DATA-TYPE">/AUTOSAR_Platform/ImplementationDataTypes/uint8</IMPLEMENTATION-DATA-TYPE-REF>
                    </SW-DATA-DEF-PROPS-CONDITIONAL>
                  </SW-DATA-DEF-PROPS-VARIANTS>
                </SW-DATA-DEF-PROPS>
              </SW-SERVICE-ARG>
            </ARGUMENTS>
          </BSW-MODULE-ENTRY>
          <BSW-MODULE-ENTRY>
            <SHORT-NAME>I2c_IsrI2cProtocol</SHORT-NAME>
            <IS-REENTRANT>false</IS-REENTRANT>
            <IS-SYNCHRONOUS>true</IS-SYNCHRONOUS>
            <CALL-TYPE>INTERRUPT</CALL-TYPE>
            <EXECUTION-CONTEXT>INTERRUPT-CAT-1</EXECUTION-CONTEXT>
            <SW-SERVICE-IMPL-POLICY>STANDARD</SW-SERVICE-IMPL-POLICY>
            <ARGUMENTS>
              <SW-SERVICE-ARG>
                <SHORT-NAME>HwUnit</SHORT-NAME>
                <CATEGORY>TYPE_REFERENCE</CATEGORY>
                <SW-DATA-DEF-PROPS>
                  <SW-DATA-DEF-PROPS-VARIANTS>
                    <SW-DATA-DEF-PROPS-CONDITIONAL>
                      <IMPLEMENTATION-DATA-TYPE-REF DEST="IMPLEMENTATION-DATA-TYPE">/AUTOSAR_Platform/ImplementationDataTypes/uint8</IMPLEMENTATION-DATA-TYPE-REF>
                    </SW-DATA-DEF-PROPS-CONDITIONAL>
                  </SW-DATA-DEF-PROPS-VARIANTS>
                </SW-DATA-DEF-PROPS>
              </SW-SERVICE-ARG>
            </ARGUMENTS>
          </BSW-MODULE-ENTRY>
          <BSW-MODULE-ENTRY>
            <SHORT-NAME>I2c_IsrI2cError</SHORT-NAME>
            <IS-REENTRANT>false</IS-REENTRANT>
            <IS-SYNCHRONOUS>true</IS-SYNCHRONOUS>
            <CALL-TYPE>INTERRUPT</CALL-TYPE>
            <EXECUTION-CONTEXT>INTERRUPT-CAT-1</EXECUTION-CONTEXT>
            <SW-SERVICE-IMPL-POLICY>STANDARD</SW-SERVICE-IMPL-POLICY>
            <ARGUMENTS>
              <SW-SERVICE-ARG>
                <SHORT-NAME>HwUnit</SHORT-NAME>
                <CATEGORY>TYPE_REFERENCE</CATEGORY>
                <SW-DATA-DEF-PROPS>
                  <SW-DATA-DEF-PROPS-VARIANTS>
                    <SW-DATA-DEF-PROPS-CONDITIONAL>
                      <IMPLEMENTATION-DATA-TYPE-REF DEST="IMPLEMENTATION-DATA-TYPE">/AUTOSAR_Platform/ImplementationDataTypes/uint8</IMPLEMENTATION-DATA-TYPE-REF>
                    </SW-DATA-DEF-PROPS-CONDITIONAL>
                  </SW-DATA-DEF-PROPS-VARIANTS>
                </SW-DATA-DEF-PROPS>
              </SW-SERVICE-ARG>
            </ARGUMENTS>
          </BSW-MODULE-ENTRY>
        </ELEMENTS>
      </AR-PACKAGE>
      <AR-PACKAGE>
        <SHORT-NAME>Implementations</SHORT-NAME>
        <ELEMENTS>
          <BSW-IMPLEMENTATION>
            <SHORT-NAME>I2c</SHORT-NAME>
            <CODE-DESCRIPTORS>
              <CODE>
                <SHORT-NAME>Files</SHORT-NAME>
                <ARTIFACT-DESCRIPTORS>
                  <AUTOSAR-ENGINEERING-OBJECT>
                    <SHORT-LABEL>ssc::src::I2c.c</SHORT-LABEL>
                    <CATEGORY>SWSRC</CATEGORY>
                  </AUTOSAR-ENGINEERING-OBJECT>
                  <AUTOSAR-ENGINEERING-OBJECT>
                    <SHORT-LABEL>ssc::inc::I2c.h</SHORT-LABEL>
                    <CATEGORY>SWHDR</CATEGORY>
                  </AUTOSAR-ENGINEERING-OBJECT>
                </ARTIFACT-DESCRIPTORS>
              </CODE>
            </CODE-DESCRIPTORS>
            <COMPILERS>
              <COMPILER>
                  <SHORT-NAME>TASKING_6_2r2_COMPILE</SHORT-NAME>
                  <NAME>TASKING_6_2r2</NAME>
                <OPTIONS>"[!"$TaskingCompilerOption"!]"</OPTIONS>
                <VENDOR>Altium</VENDOR>
                <VERSION>[!"$TaskingVersion"!]</VERSION>
              </COMPILER>
                [!IF "$IsTasking6_3r1VersionAvailable = 'YES'"!][!//
                <COMPILER>
                  <SHORT-NAME>TASKING_6_3r1_COMPILE</SHORT-NAME>
                  <NAME>TASKING_6_3r1</NAME>
                  <OPTIONS>"[!"$Tasking6_3r1CompilerOption"!]"</OPTIONS>
                  <VENDOR>Altium</VENDOR>
                  <VERSION>[!"$Tasking6_3r1Version"!]</VERSION>
                </COMPILER>
                [!ENDIF!]
              <COMPILER>
                <SHORT-NAME>GNU_COMPILE</SHORT-NAME>
                <NAME>GNU</NAME>
                <OPTIONS>"[!"$GnucCompilerOption"!]"</OPTIONS>
                <VENDOR>Hightec</VENDOR>
                <VERSION>[!"$GnucVersion"!]</VERSION>
              </COMPILER>
              <COMPILER>
                <SHORT-NAME>DIAB_COMPILE</SHORT-NAME>
                <NAME>DIAB</NAME>
                <OPTIONS>"[!"$DccCompilerOption"!]"</OPTIONS>
                <VENDOR>Windriver</VENDOR>
                <VERSION>[!"$DccVersion"!]</VERSION>
              </COMPILER>
              <COMPILER>
                <SHORT-NAME>GHS_COMPILE</SHORT-NAME>
                <NAME>GHS</NAME>
                <OPTIONS>"[!"$GhsCompilerOption"!]"</OPTIONS>
                <VENDOR>GreenHills</VENDOR>
                <VERSION>[!"$GhsVersion"!]</VERSION>
              </COMPILER>
            </COMPILERS>
            <GENERATED-ARTIFACTS>
              <DEPENDENCY-ON-ARTIFACT>
                <SHORT-NAME>I2c_PBcfg_c</SHORT-NAME>
                <ARTIFACT-DESCRIPTOR>
                  <SHORT-LABEL>generate::src::I2c_PBcfg.c</SHORT-LABEL>
                  <CATEGORY>SWTEMPLATE</CATEGORY>
                </ARTIFACT-DESCRIPTOR>
                <USAGES>
                  <USAGE>EXECUTE</USAGE>
                </USAGES>
              </DEPENDENCY-ON-ARTIFACT>
              <DEPENDENCY-ON-ARTIFACT>
                <SHORT-NAME>I2c_PBcfg_h</SHORT-NAME>
                <ARTIFACT-DESCRIPTOR>
                  <SHORT-LABEL>generate::inc::I2c_PBcfg.h</SHORT-LABEL>
                  <CATEGORY>SWTEMPLATE</CATEGORY>
                </ARTIFACT-DESCRIPTOR>
                <USAGES>
                  <USAGE>COMPILE</USAGE>
                </USAGES>
              </DEPENDENCY-ON-ARTIFACT>
              <DEPENDENCY-ON-ARTIFACT>
                <SHORT-NAME>I2c_Cfg_h</SHORT-NAME>
                <ARTIFACT-DESCRIPTOR>
                  <SHORT-LABEL>generate::inc::I2c_Cfg.h</SHORT-LABEL>
                  <CATEGORY>SWTEMPLATE</CATEGORY>
                </ARTIFACT-DESCRIPTOR>
                <USAGES>
                  <USAGE>COMPILE</USAGE>
                </USAGES>
              </DEPENDENCY-ON-ARTIFACT>
              <DEPENDENCY-ON-ARTIFACT>
                <SHORT-NAME>I2c_xdm</SHORT-NAME>
                <ARTIFACT-DESCRIPTOR>
                  <SHORT-LABEL>config::I2c.xdm</SHORT-LABEL>
                  <CATEGORY>SWTOOL</CATEGORY>
                </ARTIFACT-DESCRIPTOR>
                <USAGES>
                  <USAGE>CODEGENERATION</USAGE>
                </USAGES>
              </DEPENDENCY-ON-ARTIFACT>
              <DEPENDENCY-ON-ARTIFACT>
                <SHORT-NAME>I2c_bmd</SHORT-NAME>
                <ARTIFACT-DESCRIPTOR>
                  <SHORT-LABEL>autosar::I2c.bmd</SHORT-LABEL>
                  <CATEGORY>SWTOOL</CATEGORY>
                </ARTIFACT-DESCRIPTOR>
                <USAGES>
                  <USAGE>CODEGENERATION</USAGE>
                </USAGES>
              </DEPENDENCY-ON-ARTIFACT>
            </GENERATED-ARTIFACTS>
            <LINKERS>
              <LINKER>
                  <SHORT-NAME>TASKING_6_2r2_LINK</SHORT-NAME>
                  <NAME>TASKING_6_2r2</NAME>
                <OPTIONS>"[!"$TaskingLinkerOption"!]"</OPTIONS>
                <VENDOR>Altium</VENDOR>
                <VERSION>[!"$TaskingVersion"!]</VERSION>
              </LINKER>
                [!IF "$IsTasking6_3r1VersionAvailable = 'YES'"!][!//
                <LINKER>
                  <SHORT-NAME>TASKING_6_3r1_LINK</SHORT-NAME>
                  <NAME>TASKING_6_3r1</NAME>
                  <OPTIONS>"[!"$Tasking6_3r1LinkerOption"!]"</OPTIONS>
                  <VENDOR>Altium</VENDOR>
                  <VERSION>[!"$Tasking6_3r1Version"!]</VERSION>
                </LINKER>
                [!ENDIF!]
              <LINKER>
                <SHORT-NAME>GNU_LINK</SHORT-NAME>
                <NAME>GNU</NAME>
                <OPTIONS>"[!"$GnucLinkerOption"!]"</OPTIONS>
                <VENDOR>Hightec</VENDOR>
                <VERSION>[!"$GnucVersion"!]</VERSION>
              </LINKER>
              <LINKER>
                <SHORT-NAME>DIAB_LINK</SHORT-NAME>
                <NAME>DIAB</NAME>
                <OPTIONS>"[!"$DccLinkerOption"!]"</OPTIONS>
                <VENDOR>Windriver</VENDOR>
                <VERSION>[!"$DccVersion"!]</VERSION>
              </LINKER>
              <LINKER>
                <SHORT-NAME>GHS_LINK</SHORT-NAME>
                <NAME>GHS</NAME>
                <OPTIONS>"[!"$GhsLinkerOption"!]"</OPTIONS>
                <VENDOR>GreenHills</VENDOR>
                <VERSION>[!"$GhsVersion"!]</VERSION>
              </LINKER>
            </LINKERS>
            <PROGRAMMING-LANGUAGE>C</PROGRAMMING-LANGUAGE>
            <RESOURCE-CONSUMPTION>
              <SHORT-NAME>ResourceConsumption</SHORT-NAME>
              <MEMORY-SECTIONS>
                <MEMORY-SECTION>
                  <SHORT-NAME>VAR_CLEARED_QM_LOCAL_8</SHORT-NAME>
                  <ALIGNMENT>8</ALIGNMENT>
                  <SIZE>2</SIZE>
                  <SW-ADDRMETHOD-REF DEST="SW-ADDR-METHOD">/AUTOSAR_MemMap/SwAddrMethods/VAR</SW-ADDRMETHOD-REF>
                </MEMORY-SECTION>
                <MEMORY-SECTION>
                  <SHORT-NAME>VAR_CLEARED_QM_LOCAL_32</SHORT-NAME>
                  <ALIGNMENT>32</ALIGNMENT>
                  <SIZE>10</SIZE>
                  <SW-ADDRMETHOD-REF DEST="SW-ADDR-METHOD">/AUTOSAR_MemMap/SwAddrMethods/VAR</SW-ADDRMETHOD-REF>
                </MEMORY-SECTION>
                <MEMORY-SECTION>
                  <SHORT-NAME>VAR_CLEARED_QM_LOCAL_UNSPECIFIED</SHORT-NAME>
                  <ALIGNMENT>UNSPECIFIED</ALIGNMENT>
                  <SIZE>10</SIZE>
                  <SW-ADDRMETHOD-REF DEST="SW-ADDR-METHOD">/AUTOSAR_MemMap/SwAddrMethods/VAR</SW-ADDRMETHOD-REF>
                </MEMORY-SECTION>
                <MEMORY-SECTION>
                  <SHORT-NAME>CONST_QM_LOCAL_32</SHORT-NAME>
                  <ALIGNMENT>32</ALIGNMENT>
                  <SIZE>10</SIZE>
                  <SW-ADDRMETHOD-REF DEST="SW-ADDR-METHOD">/AUTOSAR_MemMap/SwAddrMethods/CONST</SW-ADDRMETHOD-REF>
                </MEMORY-SECTION>
                <MEMORY-SECTION>
                  <SHORT-NAME>CONFIG_DATA_QM_LOCAL_UNSPECIFIED</SHORT-NAME>
                  <ALIGNMENT>UNSPECIFIED</ALIGNMENT>
                  <SIZE>20</SIZE>
                  <SW-ADDRMETHOD-REF DEST="SW-ADDR-METHOD">/AUTOSAR_MemMap/SwAddrMethods/CONFIG_DATA</SW-ADDRMETHOD-REF>
                </MEMORY-SECTION>
                <MEMORY-SECTION>
                  <SHORT-NAME>CODE_QM_LOCAL</SHORT-NAME>
                  <ALIGNMENT>UNSPECIFIED</ALIGNMENT>
                  <SIZE>20</SIZE>
                  <SW-ADDRMETHOD-REF DEST="SW-ADDR-METHOD">/AUTOSAR_MemMap/SwAddrMethods/CODE</SW-ADDRMETHOD-REF>
                </MEMORY-SECTION>
              </MEMORY-SECTIONS>
              <SECTION-NAME-PREFIXS>
                <SECTION-NAME-PREFIX>
                  <SHORT-NAME>I2C</SHORT-NAME>
                  <SYMBOL>I2C</SYMBOL>
                </SECTION-NAME-PREFIX>
              </SECTION-NAME-PREFIXS>
            </RESOURCE-CONSUMPTION>
            <SW-VERSION>10.30.1</SW-VERSION>
            <VENDOR-ID>17</VENDOR-ID>
            <AR-RELEASE-VERSION>4.2.2</AR-RELEASE-VERSION>
            <BEHAVIOR-REF DEST="BSW-INTERNAL-BEHAVIOR">/AURIX2G_I2c/BswModuleDescriptions/I2c/I2cBehavior</BEHAVIOR-REF>
            <VENDOR-SPECIFIC-MODULE-DEF-REFS>
              <VENDOR-SPECIFIC-MODULE-DEF-REF DEST="ECUC-MODULE-DEF">/AURIX2G/EcucDefs/I2c</VENDOR-SPECIFIC-MODULE-DEF-REF>
            </VENDOR-SPECIFIC-MODULE-DEF-REFS>
          </BSW-IMPLEMENTATION>
        </ELEMENTS>
      </AR-PACKAGE>
      <AR-PACKAGE>
        <SHORT-NAME>ImplementationDataTypes</SHORT-NAME>
        <CATEGORY>STANDARD</CATEGORY>
        <ELEMENTS>
          <IMPLEMENTATION-DATA-TYPE>
            <SHORT-NAME>I2c_ChannelType</SHORT-NAME>
            <CATEGORY>TYPE_REFERENCE</CATEGORY>
            <SW-DATA-DEF-PROPS>
              <SW-DATA-DEF-PROPS-VARIANTS>
                <SW-DATA-DEF-PROPS-CONDITIONAL>
                  <IMPLEMENTATION-DATA-TYPE-REF DEST="IMPLEMENTATION-DATA-TYPE">/AUTOSAR_Platform/ImplementationDataTypes/uint8</IMPLEMENTATION-DATA-TYPE-REF>
                </SW-DATA-DEF-PROPS-CONDITIONAL>
              </SW-DATA-DEF-PROPS-VARIANTS>
            </SW-DATA-DEF-PROPS>
            <TYPE-EMITTER>BSW</TYPE-EMITTER>
          </IMPLEMENTATION-DATA-TYPE>
          <IMPLEMENTATION-DATA-TYPE>
            <SHORT-NAME>I2c_SizeType</SHORT-NAME>
            <CATEGORY>TYPE_REFERENCE</CATEGORY>
            <SW-DATA-DEF-PROPS>
              <SW-DATA-DEF-PROPS-VARIANTS>
                <SW-DATA-DEF-PROPS-CONDITIONAL>
                  <IMPLEMENTATION-DATA-TYPE-REF DEST="IMPLEMENTATION-DATA-TYPE">/AUTOSAR_Platform/ImplementationDataTypes/uint16</IMPLEMENTATION-DATA-TYPE-REF>
                </SW-DATA-DEF-PROPS-CONDITIONAL>
              </SW-DATA-DEF-PROPS-VARIANTS>
            </SW-DATA-DEF-PROPS>
            <TYPE-EMITTER>BSW</TYPE-EMITTER>
          </IMPLEMENTATION-DATA-TYPE>
          <IMPLEMENTATION-DATA-TYPE>
            <SHORT-NAME>I2c_DataType</SHORT-NAME>
            <CATEGORY>TYPE_REFERENCE</CATEGORY>
            <SW-DATA-DEF-PROPS>
              <SW-DATA-DEF-PROPS-VARIANTS>
                <SW-DATA-DEF-PROPS-CONDITIONAL>
                  <IMPLEMENTATION-DATA-TYPE-REF DEST="IMPLEMENTATION-DATA-TYPE">/AUTOSAR_Platform/ImplementationDataTypes/uint8</IMPLEMENTATION-DATA-TYPE-REF>
                </SW-DATA-DEF-PROPS-CONDITIONAL>
              </SW-DATA-DEF-PROPS-VARIANTS>
            </SW-DATA-DEF-PROPS>
            <TYPE-EMITTER>BSW</TYPE-EMITTER>
          </IMPLEMENTATION-DATA-TYPE>
          <IMPLEMENTATION-DATA-TYPE>
            <SHORT-NAME>I2c_SlaveAddrType</SHORT-NAME>
            <CATEGORY>TYPE_REFERENCE</CATEGORY>
            <SW-DATA-DEF-PROPS>
              <SW-DATA-DEF-PROPS-VARIANTS>
                <SW-DATA-DEF-PROPS-CONDITIONAL>
                  <IMPLEMENTATION-DATA-TYPE-REF DEST="IMPLEMENTATION-DATA-TYPE">/AUTOSAR_Platform/ImplementationDataTypes/uint16</IMPLEMENTATION-DATA-TYPE-REF>
                </SW-DATA-DEF-PROPS-CONDITIONAL>
              </SW-DATA-DEF-PROPS-VARIANTS>
            </SW-DATA-DEF-PROPS>
            <TYPE-EMITTER>BSW</TYPE-EMITTER>
          </IMPLEMENTATION-DATA-TYPE>
          <IMPLEMENTATION-DATA-TYPE>
            <SHORT-NAME>I2c_ChannelStatusType</SHORT-NAME>
            <CATEGORY>TYPE_REFERENCE</CATEGORY>
            <SW-DATA-DEF-PROPS>
              <SW-DATA-DEF-PROPS-VARIANTS>
                <SW-DATA-DEF-PROPS-CONDITIONAL>
                  <COMPU-METHOD-REF DEST="COMPU-METHOD">/AURIX2G_I2c/CompuMethods/I2c_ChannelStatusType</COMPU-METHOD-REF>
                  <IMPLEMENTATION-DATA-TYPE-REF DEST="IMPLEMENTATION-DATA-TYPE">/AUTOSAR_Platform/ImplementationDataTypes/sint32</IMPLEMENTATION-DATA-TYPE-REF>
                  <SW-IMPL-POLICY>STANDARD</SW-IMPL-POLICY>
                  <ADDITIONAL-NATIVE-TYPE-QUALIFIER>enum</ADDITIONAL-NATIVE-TYPE-QUALIFIER>
                </SW-DATA-DEF-PROPS-CONDITIONAL>
              </SW-DATA-DEF-PROPS-VARIANTS>
            </SW-DATA-DEF-PROPS>
            <TYPE-EMITTER>BSW</TYPE-EMITTER>
          </IMPLEMENTATION-DATA-TYPE>
          <IMPLEMENTATION-DATA-TYPE>
            <SHORT-NAME>I2c_AddressingModeType</SHORT-NAME>
            <CATEGORY>TYPE_REFERENCE</CATEGORY>
            <SW-DATA-DEF-PROPS>
              <SW-DATA-DEF-PROPS-VARIANTS>
                <SW-DATA-DEF-PROPS-CONDITIONAL>
                  <COMPU-METHOD-REF DEST="COMPU-METHOD">/AURIX2G_I2c/CompuMethods/I2c_AddressingModeType</COMPU-METHOD-REF>
                  <IMPLEMENTATION-DATA-TYPE-REF DEST="IMPLEMENTATION-DATA-TYPE">/AUTOSAR_Platform/ImplementationDataTypes/sint32</IMPLEMENTATION-DATA-TYPE-REF>
                  <SW-IMPL-POLICY>STANDARD</SW-IMPL-POLICY>
                    <ADDITIONAL-NATIVE-TYPE-QUALIFIER>enum</ADDITIONAL-NATIVE-TYPE-QUALIFIER>
                </SW-DATA-DEF-PROPS-CONDITIONAL>
              </SW-DATA-DEF-PROPS-VARIANTS>
            </SW-DATA-DEF-PROPS>
            <TYPE-EMITTER>BSW</TYPE-EMITTER>
          </IMPLEMENTATION-DATA-TYPE>
          <IMPLEMENTATION-DATA-TYPE>
            <SHORT-NAME>I2c_ConfigType</SHORT-NAME>
            <CATEGORY>STRUCTURE</CATEGORY>
            <SUB-ELEMENTS>
              <IMPLEMENTATION-DATA-TYPE-ELEMENT>
                <SHORT-NAME>I2c_ChannelConfigType</SHORT-NAME>
                <CATEGORY>TYPE_REFERENCE</CATEGORY>
                <SW-DATA-DEF-PROPS>
                  <SW-DATA-DEF-PROPS-VARIANTS>
                    <SW-DATA-DEF-PROPS-CONDITIONAL>
                      <IMPLEMENTATION-DATA-TYPE-REF DEST="IMPLEMENTATION-DATA-TYPE">/AURIX2G_I2c/ImplementationDataTypes/I2c_ChannelConfigType</IMPLEMENTATION-DATA-TYPE-REF>
                    </SW-DATA-DEF-PROPS-CONDITIONAL>
                  </SW-DATA-DEF-PROPS-VARIANTS>
                </SW-DATA-DEF-PROPS>
              </IMPLEMENTATION-DATA-TYPE-ELEMENT>
              <IMPLEMENTATION-DATA-TYPE-ELEMENT>
                <SHORT-NAME>I2c_MaxChannels</SHORT-NAME>
                <CATEGORY>TYPE_REFERENCE</CATEGORY>
                <SW-DATA-DEF-PROPS>
                  <SW-DATA-DEF-PROPS-VARIANTS>
                    <SW-DATA-DEF-PROPS-CONDITIONAL>
                      <IMPLEMENTATION-DATA-TYPE-REF DEST="IMPLEMENTATION-DATA-TYPE">/AUTOSAR_Platform/ImplementationDataTypes/uint8</IMPLEMENTATION-DATA-TYPE-REF>
                    </SW-DATA-DEF-PROPS-CONDITIONAL>
                  </SW-DATA-DEF-PROPS-VARIANTS>
                </SW-DATA-DEF-PROPS>
              </IMPLEMENTATION-DATA-TYPE-ELEMENT>
            </SUB-ELEMENTS>
            <TYPE-EMITTER>BSW</TYPE-EMITTER>
          </IMPLEMENTATION-DATA-TYPE>
          <IMPLEMENTATION-DATA-TYPE>
            <SHORT-NAME>I2c_ChannelConfigType</SHORT-NAME>
            <CATEGORY>STRUCTURE</CATEGORY>
            <SUB-ELEMENTS>
              <IMPLEMENTATION-DATA-TYPE-ELEMENT>
                <SHORT-NAME>HwUnit</SHORT-NAME>
                <CATEGORY>TYPE_REFERENCE</CATEGORY>
                <SW-DATA-DEF-PROPS>
                  <SW-DATA-DEF-PROPS-VARIANTS>
                    <SW-DATA-DEF-PROPS-CONDITIONAL>
                      <IMPLEMENTATION-DATA-TYPE-REF DEST="IMPLEMENTATION-DATA-TYPE">/AUTOSAR_Platform/ImplementationDataTypes/uint8</IMPLEMENTATION-DATA-TYPE-REF>
                    </SW-DATA-DEF-PROPS-CONDITIONAL>
                  </SW-DATA-DEF-PROPS-VARIANTS>
                </SW-DATA-DEF-PROPS>
              </IMPLEMENTATION-DATA-TYPE-ELEMENT>
              <IMPLEMENTATION-DATA-TYPE-ELEMENT>
                <SHORT-NAME>AdddressCfgValue</SHORT-NAME>
                <CATEGORY>TYPE_REFERENCE</CATEGORY>
                <SW-DATA-DEF-PROPS>
                  <SW-DATA-DEF-PROPS-VARIANTS>
                    <SW-DATA-DEF-PROPS-CONDITIONAL>
                      <IMPLEMENTATION-DATA-TYPE-REF DEST="IMPLEMENTATION-DATA-TYPE">/AUTOSAR_Platform/ImplementationDataTypes/uint32</IMPLEMENTATION-DATA-TYPE-REF>
                    </SW-DATA-DEF-PROPS-CONDITIONAL>
                  </SW-DATA-DEF-PROPS-VARIANTS>
                </SW-DATA-DEF-PROPS>
              </IMPLEMENTATION-DATA-TYPE-ELEMENT>
              <IMPLEMENTATION-DATA-TYPE-ELEMENT>
                <SHORT-NAME>FracDividerCfgValue</SHORT-NAME>
                <CATEGORY>TYPE_REFERENCE</CATEGORY>
                <SW-DATA-DEF-PROPS>
                  <SW-DATA-DEF-PROPS-VARIANTS>
                    <SW-DATA-DEF-PROPS-CONDITIONAL>
                      <IMPLEMENTATION-DATA-TYPE-REF DEST="IMPLEMENTATION-DATA-TYPE">/AUTOSAR_Platform/ImplementationDataTypes/uint32</IMPLEMENTATION-DATA-TYPE-REF>
                    </SW-DATA-DEF-PROPS-CONDITIONAL>
                  </SW-DATA-DEF-PROPS-VARIANTS>
                </SW-DATA-DEF-PROPS>
              </IMPLEMENTATION-DATA-TYPE-ELEMENT>
              <IMPLEMENTATION-DATA-TYPE-ELEMENT>
                <SHORT-NAME>FracDividerHighCfgValue</SHORT-NAME>
                <CATEGORY>TYPE_REFERENCE</CATEGORY>
                <SW-DATA-DEF-PROPS>
                  <SW-DATA-DEF-PROPS-VARIANTS>
                    <SW-DATA-DEF-PROPS-CONDITIONAL>
                      <IMPLEMENTATION-DATA-TYPE-REF DEST="IMPLEMENTATION-DATA-TYPE">/AUTOSAR_Platform/ImplementationDataTypes/uint32</IMPLEMENTATION-DATA-TYPE-REF>
                    </SW-DATA-DEF-PROPS-CONDITIONAL>
                  </SW-DATA-DEF-PROPS-VARIANTS>
                </SW-DATA-DEF-PROPS>
              </IMPLEMENTATION-DATA-TYPE-ELEMENT>
              <IMPLEMENTATION-DATA-TYPE-ELEMENT>
                <SHORT-NAME>TimingCfgvalue</SHORT-NAME>
                <CATEGORY>TYPE_REFERENCE</CATEGORY>
                <SW-DATA-DEF-PROPS>
                  <SW-DATA-DEF-PROPS-VARIANTS>
                    <SW-DATA-DEF-PROPS-CONDITIONAL>
                      <IMPLEMENTATION-DATA-TYPE-REF DEST="IMPLEMENTATION-DATA-TYPE">/AUTOSAR_Platform/ImplementationDataTypes/uint32</IMPLEMENTATION-DATA-TYPE-REF>
                    </SW-DATA-DEF-PROPS-CONDITIONAL>
                  </SW-DATA-DEF-PROPS-VARIANTS>
                </SW-DATA-DEF-PROPS>
              </IMPLEMENTATION-DATA-TYPE-ELEMENT>
              <IMPLEMENTATION-DATA-TYPE-ELEMENT>
                <SHORT-NAME>FIFOCfgValue</SHORT-NAME>
                <CATEGORY>TYPE_REFERENCE</CATEGORY>
                <SW-DATA-DEF-PROPS>
                  <SW-DATA-DEF-PROPS-VARIANTS>
                    <SW-DATA-DEF-PROPS-CONDITIONAL>
                      <IMPLEMENTATION-DATA-TYPE-REF DEST="IMPLEMENTATION-DATA-TYPE">/AUTOSAR_Platform/ImplementationDataTypes/uint32</IMPLEMENTATION-DATA-TYPE-REF>
                    </SW-DATA-DEF-PROPS-CONDITIONAL>
                  </SW-DATA-DEF-PROPS-VARIANTS>
                </SW-DATA-DEF-PROPS>
              </IMPLEMENTATION-DATA-TYPE-ELEMENT>
              <IMPLEMENTATION-DATA-TYPE-ELEMENT>
                <SHORT-NAME>PortPinCfgvalue</SHORT-NAME>
                <CATEGORY>TYPE_REFERENCE</CATEGORY>
                <SW-DATA-DEF-PROPS>
                  <SW-DATA-DEF-PROPS-VARIANTS>
                    <SW-DATA-DEF-PROPS-CONDITIONAL>
                      <IMPLEMENTATION-DATA-TYPE-REF DEST="IMPLEMENTATION-DATA-TYPE">/AUTOSAR_Platform/ImplementationDataTypes/uint8</IMPLEMENTATION-DATA-TYPE-REF>
                    </SW-DATA-DEF-PROPS-CONDITIONAL>
                  </SW-DATA-DEF-PROPS-VARIANTS>
                </SW-DATA-DEF-PROPS>
              </IMPLEMENTATION-DATA-TYPE-ELEMENT>
              <IMPLEMENTATION-DATA-TYPE-ELEMENT>
                <SHORT-NAME>HWClkSetting</SHORT-NAME>
                <CATEGORY>TYPE_REFERENCE</CATEGORY>
                <SW-DATA-DEF-PROPS>
                  <SW-DATA-DEF-PROPS-VARIANTS>
                    <SW-DATA-DEF-PROPS-CONDITIONAL>
                      <IMPLEMENTATION-DATA-TYPE-REF DEST="IMPLEMENTATION-DATA-TYPE">/AUTOSAR_Platform/ImplementationDataTypes/uint32</IMPLEMENTATION-DATA-TYPE-REF>
                    </SW-DATA-DEF-PROPS-CONDITIONAL>
                  </SW-DATA-DEF-PROPS-VARIANTS>
                </SW-DATA-DEF-PROPS>
              </IMPLEMENTATION-DATA-TYPE-ELEMENT>
              <IMPLEMENTATION-DATA-TYPE-ELEMENT>
                <SHORT-NAME>AddressingMode</SHORT-NAME>
                <CATEGORY>TYPE_REFERENCE</CATEGORY>
                <SW-DATA-DEF-PROPS>
                  <SW-DATA-DEF-PROPS-VARIANTS>
                    <SW-DATA-DEF-PROPS-CONDITIONAL>
                      <IMPLEMENTATION-DATA-TYPE-REF DEST="IMPLEMENTATION-DATA-TYPE">/AURIX2G_I2c/ImplementationDataTypes/I2c_AddressingModeType</IMPLEMENTATION-DATA-TYPE-REF>
                    </SW-DATA-DEF-PROPS-CONDITIONAL>
                  </SW-DATA-DEF-PROPS-VARIANTS>
                </SW-DATA-DEF-PROPS>
              </IMPLEMENTATION-DATA-TYPE-ELEMENT>
              <IMPLEMENTATION-DATA-TYPE-ELEMENT>
                <SHORT-NAME>I2c_Notif</SHORT-NAME>
                <CATEGORY>TYPE_REFERENCE</CATEGORY>
                <SW-DATA-DEF-PROPS>
                  <SW-DATA-DEF-PROPS-VARIANTS>
                    <SW-DATA-DEF-PROPS-CONDITIONAL>
                      <IMPLEMENTATION-DATA-TYPE-REF DEST="IMPLEMENTATION-DATA-TYPE">/AURIX2G_I2c/ImplementationDataTypes/I2c_NotifType</IMPLEMENTATION-DATA-TYPE-REF>
                    </SW-DATA-DEF-PROPS-CONDITIONAL>
                  </SW-DATA-DEF-PROPS-VARIANTS>
                </SW-DATA-DEF-PROPS>
              </IMPLEMENTATION-DATA-TYPE-ELEMENT>
              <IMPLEMENTATION-DATA-TYPE-ELEMENT>
                <SHORT-NAME>TxTimeOutCount</SHORT-NAME>
                <CATEGORY>TYPE_REFERENCE</CATEGORY>
                <SW-DATA-DEF-PROPS>
                  <SW-DATA-DEF-PROPS-VARIANTS>
                    <SW-DATA-DEF-PROPS-CONDITIONAL>
                      <IMPLEMENTATION-DATA-TYPE-REF DEST="IMPLEMENTATION-DATA-TYPE">/AUTOSAR_Platform/ImplementationDataTypes/uint32</IMPLEMENTATION-DATA-TYPE-REF>
                    </SW-DATA-DEF-PROPS-CONDITIONAL>
                  </SW-DATA-DEF-PROPS-VARIANTS>
                </SW-DATA-DEF-PROPS>
              </IMPLEMENTATION-DATA-TYPE-ELEMENT>
              <IMPLEMENTATION-DATA-TYPE-ELEMENT>
                <SHORT-NAME>RxTimeOutCount</SHORT-NAME>
                <CATEGORY>TYPE_REFERENCE</CATEGORY>
                <SW-DATA-DEF-PROPS>
                  <SW-DATA-DEF-PROPS-VARIANTS>
                    <SW-DATA-DEF-PROPS-CONDITIONAL>
                      <IMPLEMENTATION-DATA-TYPE-REF DEST="IMPLEMENTATION-DATA-TYPE">/AUTOSAR_Platform/ImplementationDataTypes/uint32</IMPLEMENTATION-DATA-TYPE-REF>
                    </SW-DATA-DEF-PROPS-CONDITIONAL>
                  </SW-DATA-DEF-PROPS-VARIANTS>
                </SW-DATA-DEF-PROPS>
              </IMPLEMENTATION-DATA-TYPE-ELEMENT>
            </SUB-ELEMENTS>
            <TYPE-EMITTER>BSW</TYPE-EMITTER>
          </IMPLEMENTATION-DATA-TYPE>
          <IMPLEMENTATION-DATA-TYPE>
            <SHORT-NAME>I2c_NotifType</SHORT-NAME>
            <CATEGORY>STRUCTURE</CATEGORY>
            <SUB-ELEMENTS>
              <IMPLEMENTATION-DATA-TYPE-ELEMENT>
                <SHORT-NAME>I2c_NotifFunctionPtrType</SHORT-NAME>
                <CATEGORY>TYPE_REFERENCE</CATEGORY>
                <SW-DATA-DEF-PROPS>
                  <SW-DATA-DEF-PROPS-VARIANTS>
                    <SW-DATA-DEF-PROPS-CONDITIONAL>
                      <IMPLEMENTATION-DATA-TYPE-REF DEST="IMPLEMENTATION-DATA-TYPE">/AURIX2G_I2c/ImplementationDataTypes/I2c_NotifFunctionPtrType</IMPLEMENTATION-DATA-TYPE-REF>
                    </SW-DATA-DEF-PROPS-CONDITIONAL>
                  </SW-DATA-DEF-PROPS-VARIANTS>
                </SW-DATA-DEF-PROPS>
              </IMPLEMENTATION-DATA-TYPE-ELEMENT>
            </SUB-ELEMENTS>
            <TYPE-EMITTER>BSW</TYPE-EMITTER>
          </IMPLEMENTATION-DATA-TYPE>
           <IMPLEMENTATION-DATA-TYPE>
              <SHORT-NAME>I2c_ErrorType</SHORT-NAME>
              <CATEGORY>TYPE_REFERENCE</CATEGORY>
              <SW-DATA-DEF-PROPS>
                <SW-DATA-DEF-PROPS-VARIANTS>
                  <SW-DATA-DEF-PROPS-CONDITIONAL>
                    <COMPU-METHOD-REF DEST="COMPU-METHOD">/AURIX2G_I2c/CompuMethods/I2c_ErrorType</COMPU-METHOD-REF>
                    <IMPLEMENTATION-DATA-TYPE-REF DEST="IMPLEMENTATION-DATA-TYPE">/AUTOSAR_Platform/ImplementationDataTypes/sint32</IMPLEMENTATION-DATA-TYPE-REF>
                    <SW-IMPL-POLICY>STANDARD</SW-IMPL-POLICY>
                    <ADDITIONAL-NATIVE-TYPE-QUALIFIER>enum</ADDITIONAL-NATIVE-TYPE-QUALIFIER>
                  </SW-DATA-DEF-PROPS-CONDITIONAL>
                </SW-DATA-DEF-PROPS-VARIANTS>
              </SW-DATA-DEF-PROPS>
              <TYPE-EMITTER>BSW</TYPE-EMITTER>
            </IMPLEMENTATION-DATA-TYPE>
          <IMPLEMENTATION-DATA-TYPE>
            <SHORT-NAME>I2c_NotifFunctionPtrType</SHORT-NAME>
            <CATEGORY>FUNCTION_REFERENCE</CATEGORY>
            <INTRODUCTION>
              <NOTE SI="This data type is for a function pointer type pointing to the callback-notification function. The referred function should be implemented by user of the driver" NOTE-TYPE="HINT"/>
            </INTRODUCTION>
            <SW-DATA-DEF-PROPS>
              <SW-DATA-DEF-PROPS-VARIANTS>
                <SW-DATA-DEF-PROPS-CONDITIONAL>
                  <SW-POINTER-TARGET-PROPS>
                    <FUNCTION-POINTER-SIGNATURE-REF DEST="BSW-MODULE-ENTRY">/AUTOSAR_Stub/BswModuleEntrys/I2c_NotifFunction</FUNCTION-POINTER-SIGNATURE-REF>
                  </SW-POINTER-TARGET-PROPS>
                </SW-DATA-DEF-PROPS-CONDITIONAL>
              </SW-DATA-DEF-PROPS-VARIANTS>
            </SW-DATA-DEF-PROPS>
           <TYPE-EMITTER>BSW</TYPE-EMITTER>
          </IMPLEMENTATION-DATA-TYPE>
        </ELEMENTS>
      </AR-PACKAGE>
      <AR-PACKAGE>
        <SHORT-NAME>CompuMethods</SHORT-NAME>
        <CATEGORY>STANDARD</CATEGORY>
        <ELEMENTS>
          <COMPU-METHOD>
            <SHORT-NAME>I2c_ErrorType</SHORT-NAME>
            <CATEGORY>TEXTTABLE</CATEGORY>
            <COMPU-INTERNAL-TO-PHYS>
              <COMPU-SCALES>
                <COMPU-SCALE>
                  <LOWER-LIMIT INTERVAL-TYPE="CLOSED">0</LOWER-LIMIT>
                  <UPPER-LIMIT INTERVAL-TYPE="CLOSED">0</UPPER-LIMIT>
                  <COMPU-CONST>
                    <VT>I2C_NO_ERR</VT>
                  </COMPU-CONST>
                </COMPU-SCALE>
                <COMPU-SCALE>
                  <LOWER-LIMIT INTERVAL-TYPE="CLOSED">1</LOWER-LIMIT>
                  <UPPER-LIMIT INTERVAL-TYPE="CLOSED">1</UPPER-LIMIT>
                  <COMPU-CONST>
                    <VT>I2C_TX_UNDERFLOW</VT>
                  </COMPU-CONST>
                </COMPU-SCALE>
                <COMPU-SCALE>
                  <LOWER-LIMIT INTERVAL-TYPE="CLOSED">2</LOWER-LIMIT>
                  <UPPER-LIMIT INTERVAL-TYPE="CLOSED">2</UPPER-LIMIT>
                  <COMPU-CONST>
                    <VT>I2C_TX_OVERFLOW</VT>
                  </COMPU-CONST>
                </COMPU-SCALE>
                 <COMPU-SCALE>
                  <LOWER-LIMIT INTERVAL-TYPE="CLOSED">3</LOWER-LIMIT>
                  <UPPER-LIMIT INTERVAL-TYPE="CLOSED">3</UPPER-LIMIT>
                  <COMPU-CONST>
                    <VT>I2C_RX_UNDERFLOW</VT>
                  </COMPU-CONST>
                </COMPU-SCALE>
                 <COMPU-SCALE>
                  <LOWER-LIMIT INTERVAL-TYPE="CLOSED">4</LOWER-LIMIT>
                  <UPPER-LIMIT INTERVAL-TYPE="CLOSED">4</UPPER-LIMIT>
                  <COMPU-CONST>
                    <VT>I2C_RX_OVERFLOW</VT>
                  </COMPU-CONST>
                </COMPU-SCALE>
                 <COMPU-SCALE>
                  <LOWER-LIMIT INTERVAL-TYPE="CLOSED">5</LOWER-LIMIT>
                  <UPPER-LIMIT INTERVAL-TYPE="CLOSED">5</UPPER-LIMIT>
                  <COMPU-CONST>
                    <VT>I2C_NO_ACK</VT>
                  </COMPU-CONST>
                </COMPU-SCALE>
                 <COMPU-SCALE>
                  <LOWER-LIMIT INTERVAL-TYPE="CLOSED">6</LOWER-LIMIT>
                  <UPPER-LIMIT INTERVAL-TYPE="CLOSED">6</UPPER-LIMIT>
                  <COMPU-CONST>
                    <VT>I2C_ARBITRATION_LOST</VT>
                  </COMPU-CONST>
                </COMPU-SCALE>
                 <COMPU-SCALE>
                  <LOWER-LIMIT INTERVAL-TYPE="CLOSED">7</LOWER-LIMIT>
                  <UPPER-LIMIT INTERVAL-TYPE="CLOSED">7</UPPER-LIMIT>
                  <COMPU-CONST>
                    <VT>I2C_INVALID_CHANNEL</VT>
                  </COMPU-CONST>
                </COMPU-SCALE>
                 <COMPU-SCALE>
                  <LOWER-LIMIT INTERVAL-TYPE="CLOSED">8</LOWER-LIMIT>
                  <UPPER-LIMIT INTERVAL-TYPE="CLOSED">8</UPPER-LIMIT>
                  <COMPU-CONST>
                    <VT>I2C_INVALID_SIZE</VT>
                  </COMPU-CONST>
                </COMPU-SCALE>
                 <COMPU-SCALE>
                  <LOWER-LIMIT INTERVAL-TYPE="CLOSED">9</LOWER-LIMIT>
                  <UPPER-LIMIT INTERVAL-TYPE="CLOSED">9</UPPER-LIMIT>
                  <COMPU-CONST>
                    <VT>I2C_INVALID_ADDRESS</VT>
                  </COMPU-CONST>
                </COMPU-SCALE>
                 <COMPU-SCALE>
                  <LOWER-LIMIT INTERVAL-TYPE="CLOSED">10</LOWER-LIMIT>
                  <UPPER-LIMIT INTERVAL-TYPE="CLOSED">10</UPPER-LIMIT>
                  <COMPU-CONST>
                    <VT>I2C_NULL_PTR</VT>
                  </COMPU-CONST>
                </COMPU-SCALE>
                 <COMPU-SCALE>
                  <LOWER-LIMIT INTERVAL-TYPE="CLOSED">11</LOWER-LIMIT>
                  <UPPER-LIMIT INTERVAL-TYPE="CLOSED">11</UPPER-LIMIT>
                  <COMPU-CONST>
                    <VT>I2C_IS_UNINIT</VT>
                  </COMPU-CONST>
                </COMPU-SCALE>
                 <COMPU-SCALE>
                  <LOWER-LIMIT INTERVAL-TYPE="CLOSED">12</LOWER-LIMIT>
                  <UPPER-LIMIT INTERVAL-TYPE="CLOSED">12</UPPER-LIMIT>
                  <COMPU-CONST>
                    <VT>I2C_IS_BUSY</VT>
                  </COMPU-CONST>
                </COMPU-SCALE>
                 <COMPU-SCALE>
                  <LOWER-LIMIT INTERVAL-TYPE="CLOSED">13</LOWER-LIMIT>
                  <UPPER-LIMIT INTERVAL-TYPE="CLOSED">13</UPPER-LIMIT>
                  <COMPU-CONST>
                    <VT>I2C_ERR_OTHER</VT>
                  </COMPU-CONST>
                </COMPU-SCALE>
              </COMPU-SCALES>
            </COMPU-INTERNAL-TO-PHYS>
          </COMPU-METHOD>
           <COMPU-METHOD>
            <SHORT-NAME>I2c_ChannelStatusType</SHORT-NAME>
            <CATEGORY>TEXTTABLE</CATEGORY>
            <COMPU-INTERNAL-TO-PHYS>
              <COMPU-SCALES>
                <COMPU-SCALE>
                  <LOWER-LIMIT INTERVAL-TYPE="CLOSED">0</LOWER-LIMIT>
                  <UPPER-LIMIT INTERVAL-TYPE="CLOSED">0</UPPER-LIMIT>
                  <COMPU-CONST>
                    <VT>I2C_UNINIT</VT>
                  </COMPU-CONST>
                </COMPU-SCALE>
                <COMPU-SCALE>
                  <LOWER-LIMIT INTERVAL-TYPE="CLOSED">0</LOWER-LIMIT>
                  <UPPER-LIMIT INTERVAL-TYPE="CLOSED">0</UPPER-LIMIT>
                  <COMPU-CONST>
                    <VT>I2C_IDLE</VT>
                  </COMPU-CONST>
                </COMPU-SCALE>
                <COMPU-SCALE>
                  <LOWER-LIMIT INTERVAL-TYPE="CLOSED">0</LOWER-LIMIT>
                  <UPPER-LIMIT INTERVAL-TYPE="CLOSED">0</UPPER-LIMIT>
                  <COMPU-CONST>
                    <VT>I2C_BUSY</VT>
                  </COMPU-CONST>
                </COMPU-SCALE>
              </COMPU-SCALES>
            </COMPU-INTERNAL-TO-PHYS>
          </COMPU-METHOD>
          <COMPU-METHOD>
            <SHORT-NAME>I2c_AddressingModeType</SHORT-NAME>
            <CATEGORY>TEXTTABLE</CATEGORY>
            <COMPU-INTERNAL-TO-PHYS>
              <COMPU-SCALES>
                <COMPU-SCALE>
                  <LOWER-LIMIT INTERVAL-TYPE="CLOSED">0</LOWER-LIMIT>
                  <UPPER-LIMIT INTERVAL-TYPE="CLOSED">0</UPPER-LIMIT>
                  <COMPU-CONST>
                    <VT>I2C_7_BIT_ADDRESSING</VT>
                  </COMPU-CONST>
                </COMPU-SCALE>
                <COMPU-SCALE>
                  <LOWER-LIMIT INTERVAL-TYPE="CLOSED">1</LOWER-LIMIT>
                  <UPPER-LIMIT INTERVAL-TYPE="CLOSED">1</UPPER-LIMIT>
                  <COMPU-CONST>
                    <VT>I2C_10_BIT_ADDRESSING</VT>
                  </COMPU-CONST>
                </COMPU-SCALE>
              </COMPU-SCALES>
            </COMPU-INTERNAL-TO-PHYS>
          </COMPU-METHOD>
        </ELEMENTS>
      </AR-PACKAGE>
    </AR-PACKAGES>
  </AR-PACKAGE>
</AR-PACKAGES>
</AUTOSAR>
