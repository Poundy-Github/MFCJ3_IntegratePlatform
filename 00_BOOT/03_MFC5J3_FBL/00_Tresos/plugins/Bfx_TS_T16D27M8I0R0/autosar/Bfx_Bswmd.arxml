AUTOSAR XML (schema 4-2-2)
# Copyright (C) Infineon Technologies (2019)
# All rights reserved.
package /AUTOSAR_Bfx/BswModuleDescriptions
  bsw module description Bfx: category=BSW_MODULE, module-id=205  # Bfx Library
    provided-entrys:
      Bfx_SetBit_u8u8
      Bfx_SetBit_u16u8
      Bfx_SetBit_u32u8
      Bfx_ClrBit_u8u8
      Bfx_ClrBit_u16u8
      Bfx_ClrBit_u32u8
      Bfx_GetBit_u8u8_u8
      Bfx_GetBit_u16u8_u8
      Bfx_GetBit_u32u8_u8
      Bfx_SetBits_u8u8u8u8
      Bfx_SetBits_u16u8u8u8
      Bfx_SetBits_u32u8u8u8
      Bfx_GetBits_u8u8u8_u8
      Bfx_GetBits_u16u8u8_u16
      Bfx_GetBits_u32u8u8_u32
      Bfx_SetBitMask_u8u8
      Bfx_SetBitMask_u16u16
      Bfx_SetBitMask_u32u32
      Bfx_ClrBitMask_u8u8
      Bfx_ClrBitMask_u16u16
      Bfx_ClrBitMask_u32u32
      Bfx_TstBitMask_u8u8_u8
      Bfx_TstBitMask_u16u16_u8
      Bfx_TstBitMask_u32u32_u8
      Bfx_TstBitLnMask_u8u8_u8
      Bfx_TstBitLnMask_u16u16_u8
      Bfx_TstBitLnMask_u32u32_u8
      Bfx_TstParityEven_u8_u8
      Bfx_TstParityEven_u16_u8
      Bfx_TstParityEven_u32_u8
      Bfx_ToggleBits_u8
      Bfx_ToggleBits_u16
      Bfx_ToggleBits_u32
      Bfx_ToggleBitMask_u8u8
      Bfx_ToggleBitMask_u16u16
      Bfx_ToggleBitMask_u32u32
      Bfx_ShiftBitRt_u8u8
      Bfx_ShiftBitRt_u16u8
      Bfx_ShiftBitRt_u32u8
      Bfx_ShiftBitLt_u8u8
      Bfx_ShiftBitLt_u16u8
      Bfx_ShiftBitLt_u32u8
      Bfx_RotBitRt_u8u8
      Bfx_RotBitRt_u16u8
      Bfx_RotBitRt_u32u8
      Bfx_RotBitLt_u8u8
      Bfx_RotBitLt_u16u8
      Bfx_RotBitLt_u32u8
      Bfx_CopyBit_u8u8u8u8
      Bfx_CopyBit_u16u8u16u8
      Bfx_CopyBit_u32u8u32u8
      Bfx_PutBits_u8u8u8u8
      Bfx_PutBits_u16u8u8u16
      Bfx_PutBits_u32u8u8u32
      Bfx_PutBitsMask_u8u8u8
      Bfx_PutBitsMask_u16u16u16
      Bfx_PutBitsMask_u32u32u32
      Bfx_PutBit_u8u8u8
      Bfx_PutBit_u16u8u8
      Bfx_PutBit_u32u8u8
      Bfx_GetVersionInfo
    bsw internal behavior BfxBehavior
      61 x bsw called entity, all with reentrancy-level=MULTICORE-REENTRANT:
        Bfx_SetBit_u8u8: implemented-entry=Bfx_SetBit_u8u8
        Bfx_SetBit_u16u8: implemented-entry=Bfx_SetBit_u16u8
        Bfx_SetBit_u32u8: implemented-entry=Bfx_SetBit_u32u8
        Bfx_ClrBit_u8u8: implemented-entry=Bfx_ClrBit_u8u8
        Bfx_ClrBit_u16u8: implemented-entry=Bfx_ClrBit_u16u8
        Bfx_ClrBit_u32u8: implemented-entry=Bfx_ClrBit_u32u8
        Bfx_GetBit_u8u8_u8: implemented-entry=Bfx_GetBit_u8u8_u8
        Bfx_GetBit_u16u8_u8: implemented-entry=Bfx_GetBit_u16u8_u8
        Bfx_GetBit_u32u8_u8: implemented-entry=Bfx_GetBit_u32u8_u8
        Bfx_SetBits_u8u8u8u8: implemented-entry=Bfx_SetBits_u8u8u8u8
        Bfx_SetBits_u16u8u8u8: implemented-entry=Bfx_SetBits_u16u8u8u8
        Bfx_SetBits_u32u8u8u8: implemented-entry=Bfx_SetBits_u32u8u8u8
        Bfx_GetBits_u8u8u8_u8: implemented-entry=Bfx_GetBits_u8u8u8_u8
        Bfx_GetBits_u16u8u8_u16: implemented-entry=Bfx_GetBits_u16u8u8_u16
        Bfx_GetBits_u32u8u8_u32: implemented-entry=Bfx_GetBits_u32u8u8_u32
        Bfx_SetBitMask_u8u8: implemented-entry=Bfx_SetBitMask_u8u8
        Bfx_SetBitMask_u16u16: implemented-entry=Bfx_SetBitMask_u16u16
        Bfx_SetBitMask_u32u32: implemented-entry=Bfx_SetBitMask_u32u32
        Bfx_ClrBitMask_u8u8: implemented-entry=Bfx_ClrBitMask_u8u8
        Bfx_ClrBitMask_u16u16: implemented-entry=Bfx_ClrBitMask_u16u16
        Bfx_ClrBitMask_u32u32: implemented-entry=Bfx_ClrBitMask_u32u32
        Bfx_TstBitMask_u8u8_u8: implemented-entry=Bfx_TstBitMask_u8u8_u8
        Bfx_TstBitMask_u16u16_u8: implemented-entry=Bfx_TstBitMask_u16u16_u8
        Bfx_TstBitMask_u32u32_u8: implemented-entry=Bfx_TstBitMask_u32u32_u8
        Bfx_TstBitLnMask_u8u8_u8: implemented-entry=Bfx_TstBitLnMask_u8u8_u8
        Bfx_TstBitLnMask_u16u16_u8: implemented-entry=Bfx_TstBitLnMask_u16u16_u8
        Bfx_TstBitLnMask_u32u32_u8: implemented-entry=Bfx_TstBitLnMask_u32u32_u8
        Bfx_TstParityEven_u8_u8: implemented-entry=Bfx_TstParityEven_u8_u8
        Bfx_TstParityEven_u16_u8: implemented-entry=Bfx_TstParityEven_u16_u8
        Bfx_TstParityEven_u32_u8: implemented-entry=Bfx_TstParityEven_u32_u8
        Bfx_ToggleBits_u8: implemented-entry=Bfx_ToggleBits_u8
        Bfx_ToggleBits_u16: implemented-entry=Bfx_ToggleBits_u16
        Bfx_ToggleBits_u32: implemented-entry=Bfx_ToggleBits_u32
        Bfx_ToggleBitMask_u8u8: implemented-entry=Bfx_ToggleBitMask_u8u8
        Bfx_ToggleBitMask_u16u16: implemented-entry=Bfx_ToggleBitMask_u16u16
        Bfx_ToggleBitMask_u32u32: implemented-entry=Bfx_ToggleBitMask_u32u32
        Bfx_ShiftBitRt_u8u8: implemented-entry=Bfx_ShiftBitRt_u8u8
        Bfx_ShiftBitRt_u16u8: implemented-entry=Bfx_ShiftBitRt_u16u8
        Bfx_ShiftBitRt_u32u8: implemented-entry=Bfx_ShiftBitRt_u32u8
        Bfx_ShiftBitLt_u8u8: implemented-entry=Bfx_ShiftBitLt_u8u8
        Bfx_ShiftBitLt_u16u8: implemented-entry=Bfx_ShiftBitLt_u16u8
        Bfx_ShiftBitLt_u32u8: implemented-entry=Bfx_ShiftBitLt_u32u8
        Bfx_RotBitRt_u8u8: implemented-entry=Bfx_RotBitRt_u8u8
        Bfx_RotBitRt_u16u8: implemented-entry=Bfx_RotBitRt_u16u8
        Bfx_RotBitRt_u32u8: implemented-entry=Bfx_RotBitRt_u32u8
        Bfx_RotBitLt_u8u8: implemented-entry=Bfx_RotBitLt_u8u8
        Bfx_RotBitLt_u16u8: implemented-entry=Bfx_RotBitLt_u16u8
        Bfx_RotBitLt_u32u8: implemented-entry=Bfx_RotBitLt_u32u8
        Bfx_CopyBit_u8u8u8u8: implemented-entry=Bfx_CopyBit_u8u8u8u8
        Bfx_CopyBit_u16u8u16u8: implemented-entry=Bfx_CopyBit_u16u8u16u8
        Bfx_CopyBit_u32u8u32u8: implemented-entry=Bfx_CopyBit_u32u8u32u8
        Bfx_PutBits_u8u8u8u8: implemented-entry=Bfx_PutBits_u8u8u8u8
        Bfx_PutBits_u16u8u8u16: implemented-entry=Bfx_PutBits_u16u8u8u16
        Bfx_PutBits_u32u8u8u32: implemented-entry=Bfx_PutBits_u32u8u8u32
        Bfx_PutBitsMask_u8u8u8: implemented-entry=Bfx_PutBitsMask_u8u8u8
        Bfx_PutBitsMask_u16u16u16: implemented-entry=Bfx_PutBitsMask_u16u16u16
        Bfx_PutBitsMask_u32u32u32: implemented-entry=Bfx_PutBitsMask_u32u32u32
        Bfx_PutBit_u8u8u8: implemented-entry=Bfx_PutBit_u8u8u8
        Bfx_PutBit_u16u8u8: implemented-entry=Bfx_PutBit_u16u8u8
        Bfx_PutBit_u32u8u8: implemented-entry=Bfx_PutBit_u32u8u8
        Bfx_GetVersionInfo: implemented-entry=Bfx_GetVersionInfo
package /AUTOSAR_Bfx/BswModuleEntrys
  61 x bsw module entry, all with is-reentrant=true, is-synchronous=true, call-type=REGULAR, sw-service-impl-policy=STANDARD:
    Bfx_SetBit_u8u8: service-id=1, execution-context=UNSPECIFIED
      sw service arg Data: category=DATA_REFERENCE, sw-pointer-target-props={target-category=TYPE_REFERENCE, implementation-data-type=uint8}
      sw service arg BitPn: implementation-data-type=uint8
    Bfx_SetBit_u16u8: service-id=2, execution-context=UNSPECIFIED
      sw service arg Data: category=DATA_REFERENCE, sw-pointer-target-props={target-category=TYPE_REFERENCE, implementation-data-type=uint16}
      sw service arg BitPn: implementation-data-type=uint8
    Bfx_SetBit_u32u8: service-id=3, execution-context=UNSPECIFIED
      sw service arg Data: category=DATA_REFERENCE, sw-pointer-target-props={target-category=TYPE_REFERENCE, implementation-data-type=uint32}
      sw service arg BitPn: implementation-data-type=uint8
    Bfx_ClrBit_u8u8: service-id=6, execution-context=UNSPECIFIED
      sw service arg Data: category=DATA_REFERENCE, sw-pointer-target-props={target-category=TYPE_REFERENCE, implementation-data-type=uint8}
      sw service arg BitPn: implementation-data-type=uint8
    Bfx_ClrBit_u16u8: service-id=7, execution-context=UNSPECIFIED
      sw service arg Data: category=DATA_REFERENCE, sw-pointer-target-props={target-category=TYPE_REFERENCE, implementation-data-type=uint16}
      sw service arg BitPn: implementation-data-type=uint8
    Bfx_ClrBit_u32u8: service-id=8, execution-context=UNSPECIFIED
      sw service arg Data: category=DATA_REFERENCE, sw-pointer-target-props={target-category=TYPE_REFERENCE, implementation-data-type=uint32}
      sw service arg BitPn: implementation-data-type=uint8
    Bfx_GetBit_u8u8_u8: service-id=10, execution-context=UNSPECIFIED
      return type Return: implementation-data-type=boolean
      sw service arg Data: implementation-data-type=uint8
      sw service arg BitPn: implementation-data-type=uint8
    Bfx_GetBit_u16u8_u8: service-id=11, execution-context=UNSPECIFIED
      return type Return: implementation-data-type=boolean
      sw service arg Data: implementation-data-type=uint16
      sw service arg BitPn: implementation-data-type=uint8
    Bfx_GetBit_u32u8_u8: service-id=12, execution-context=UNSPECIFIED
      return type Return: implementation-data-type=boolean
      sw service arg Data: implementation-data-type=uint32
      sw service arg BitPn: implementation-data-type=uint8
    Bfx_SetBits_u8u8u8u8: service-id=32, execution-context=UNSPECIFIED
      4 x sw service arg:
        Data: category=DATA_REFERENCE, sw-pointer-target-props={target-category=TYPE_REFERENCE, implementation-data-type=uint8}
        BitStartPn: implementation-data-type=uint8
        BitLn: implementation-data-type=uint8
        Status: implementation-data-type=uint8
    Bfx_SetBits_u16u8u8u8: service-id=33, execution-context=UNSPECIFIED
      4 x sw service arg:
        Data: category=DATA_REFERENCE, sw-pointer-target-props={target-category=TYPE_REFERENCE, implementation-data-type=uint16}
        BitStartPn: implementation-data-type=uint8
        BitLn: implementation-data-type=uint8
        Status: implementation-data-type=uint8
    Bfx_SetBits_u32u8u8u8: service-id=34, execution-context=UNSPECIFIED
      4 x sw service arg:
        Data: category=DATA_REFERENCE, sw-pointer-target-props={target-category=TYPE_REFERENCE, implementation-data-type=uint32}
        BitStartPn: implementation-data-type=uint8
        BitLn: implementation-data-type=uint8
        Status: implementation-data-type=uint8
    Bfx_GetBits_u8u8u8_u8: service-id=38, execution-context=UNSPECIFIED
      return type Return: implementation-data-type=uint8
      sw service arg Data: implementation-data-type=uint8
      sw service arg BitStartPn: implementation-data-type=uint8
      sw service arg BitLn: implementation-data-type=uint8
    Bfx_GetBits_u16u8u8_u16: service-id=39, execution-context=UNSPECIFIED
      return type Return: implementation-data-type=uint16
      sw service arg Data: implementation-data-type=uint16
      sw service arg BitStartPn: implementation-data-type=uint8
      sw service arg BitLn: implementation-data-type=uint8
    Bfx_GetBits_u32u8u8_u32: service-id=40, execution-context=UNSPECIFIED
      return type Return: implementation-data-type=uint32
      sw service arg Data: implementation-data-type=uint32
      sw service arg BitStartPn: implementation-data-type=uint8
      sw service arg BitLn: implementation-data-type=uint8
    Bfx_SetBitMask_u8u8: service-id=42, execution-context=UNSPECIFIED
      sw service arg Data: category=DATA_REFERENCE, sw-pointer-target-props={target-category=TYPE_REFERENCE, implementation-data-type=uint8}
      sw service arg Mask: implementation-data-type=uint8
    Bfx_SetBitMask_u16u16: service-id=43, execution-context=UNSPECIFIED
      sw service arg Data: category=DATA_REFERENCE, sw-pointer-target-props={target-category=TYPE_REFERENCE, implementation-data-type=uint16}
      sw service arg Mask: implementation-data-type=uint16
    Bfx_SetBitMask_u32u32: service-id=44, execution-context=UNSPECIFIED
      sw service arg Data: category=DATA_REFERENCE, sw-pointer-target-props={target-category=TYPE_REFERENCE, implementation-data-type=uint32}
      sw service arg Mask: implementation-data-type=uint32
    Bfx_ClrBitMask_u8u8: service-id=48, execution-context=UNSPECIFIED
      sw service arg Data: category=DATA_REFERENCE, sw-pointer-target-props={target-category=TYPE_REFERENCE, implementation-data-type=uint8}
      sw service arg Mask: implementation-data-type=uint8
    Bfx_ClrBitMask_u16u16: service-id=49, execution-context=UNSPECIFIED
      sw service arg Data: category=DATA_REFERENCE, sw-pointer-target-props={target-category=TYPE_REFERENCE, implementation-data-type=uint16}
      sw service arg Mask: implementation-data-type=uint16
    Bfx_ClrBitMask_u32u32: service-id=50, execution-context=UNSPECIFIED
      sw service arg Data: category=DATA_REFERENCE, sw-pointer-target-props={target-category=TYPE_REFERENCE, implementation-data-type=uint32}
      sw service arg Mask: implementation-data-type=uint32
    Bfx_TstBitMask_u8u8_u8: service-id=54, execution-context=UNSPECIFIED
      return type Return: implementation-data-type=boolean
      sw service arg Data: implementation-data-type=uint8
      sw service arg Mask: implementation-data-type=uint8
    Bfx_TstBitMask_u16u16_u8: service-id=55, execution-context=UNSPECIFIED
      return type Return: implementation-data-type=boolean
      sw service arg Data: implementation-data-type=uint16
      sw service arg Mask: implementation-data-type=uint16
    Bfx_TstBitMask_u32u32_u8: service-id=56, execution-context=UNSPECIFIED
      return type Return: implementation-data-type=boolean
      sw service arg Data: implementation-data-type=uint32
      sw service arg Mask: implementation-data-type=uint32
    Bfx_TstBitLnMask_u8u8_u8: service-id=58, execution-context=UNSPECIFIED
      return type Return: implementation-data-type=boolean
      sw service arg Data: implementation-data-type=uint8
      sw service arg Mask: implementation-data-type=uint8
    Bfx_TstBitLnMask_u16u16_u8: service-id=59, execution-context=UNSPECIFIED
      return type Return: implementation-data-type=boolean
      sw service arg Data: implementation-data-type=uint16
      sw service arg Mask: implementation-data-type=uint16
    Bfx_TstBitLnMask_u32u32_u8: service-id=60, execution-context=UNSPECIFIED
      return type Return: implementation-data-type=boolean
      sw service arg Data: implementation-data-type=uint32
      sw service arg Mask: implementation-data-type=uint32
    Bfx_TstParityEven_u8_u8: service-id=64, execution-context=UNSPECIFIED
      return type Return: implementation-data-type=boolean
      sw service arg Data: implementation-data-type=uint8
    Bfx_TstParityEven_u16_u8: service-id=65, execution-context=UNSPECIFIED
      return type Return: implementation-data-type=boolean
      sw service arg Data: implementation-data-type=uint16
    Bfx_TstParityEven_u32_u8: service-id=66, execution-context=UNSPECIFIED
      return type Return: implementation-data-type=boolean
      sw service arg Data: implementation-data-type=uint32
    Bfx_ToggleBits_u8: service-id=70, execution-context=UNSPECIFIED
      sw service arg Data: category=DATA_REFERENCE, sw-pointer-target-props={target-category=TYPE_REFERENCE, implementation-data-type=uint8}
    Bfx_ToggleBits_u16: service-id=71, execution-context=UNSPECIFIED
      sw service arg Data: category=DATA_REFERENCE, sw-pointer-target-props={target-category=TYPE_REFERENCE, implementation-data-type=uint16}
    Bfx_ToggleBits_u32: service-id=72, execution-context=UNSPECIFIED
      sw service arg Data: category=DATA_REFERENCE, sw-pointer-target-props={target-category=TYPE_REFERENCE, implementation-data-type=uint32}
    Bfx_ToggleBitMask_u8u8: service-id=74, execution-context=UNSPECIFIED
      sw service arg Data: category=DATA_REFERENCE, sw-pointer-target-props={target-category=TYPE_REFERENCE, implementation-data-type=uint8}
      sw service arg Mask: implementation-data-type=uint8
    Bfx_ToggleBitMask_u16u16: service-id=75, execution-context=UNSPECIFIED
      sw service arg Data: category=DATA_REFERENCE, sw-pointer-target-props={target-category=TYPE_REFERENCE, implementation-data-type=uint16}
      sw service arg Mask: implementation-data-type=uint16
    Bfx_ToggleBitMask_u32u32: service-id=76, execution-context=UNSPECIFIED
      sw service arg Data: category=DATA_REFERENCE, sw-pointer-target-props={target-category=TYPE_REFERENCE, implementation-data-type=uint32}
      sw service arg Mask: implementation-data-type=uint32
    Bfx_ShiftBitRt_u8u8: service-id=80, execution-context=UNSPECIFIED
      sw service arg Data: category=DATA_REFERENCE, sw-pointer-target-props={target-category=TYPE_REFERENCE, implementation-data-type=uint8}
      sw service arg ShiftCnt: implementation-data-type=uint8
    Bfx_ShiftBitRt_u16u8: service-id=81, execution-context=UNSPECIFIED
      sw service arg Data: category=DATA_REFERENCE, sw-pointer-target-props={target-category=TYPE_REFERENCE, implementation-data-type=uint16}
      sw service arg ShiftCnt: implementation-data-type=uint8
    Bfx_ShiftBitRt_u32u8: service-id=82, execution-context=UNSPECIFIED
      sw service arg Data: category=DATA_REFERENCE, sw-pointer-target-props={target-category=TYPE_REFERENCE, implementation-data-type=uint32}
      sw service arg ShiftCnt: implementation-data-type=uint8
    Bfx_ShiftBitLt_u8u8: service-id=86, execution-context=UNSPECIFIED
      sw service arg Data: category=DATA_REFERENCE, sw-pointer-target-props={target-category=TYPE_REFERENCE, implementation-data-type=uint8}
      sw service arg ShiftCnt: implementation-data-type=uint8
    Bfx_ShiftBitLt_u16u8: service-id=87, execution-context=UNSPECIFIED
      sw service arg Data: category=DATA_REFERENCE, sw-pointer-target-props={target-category=TYPE_REFERENCE, implementation-data-type=uint16}
      sw service arg ShiftCnt: implementation-data-type=uint8
    Bfx_ShiftBitLt_u32u8: service-id=88, execution-context=UNSPECIFIED
      sw service arg Data: category=DATA_REFERENCE, sw-pointer-target-props={target-category=TYPE_REFERENCE, implementation-data-type=uint32}
      sw service arg ShiftCnt: implementation-data-type=uint8
    Bfx_RotBitRt_u8u8: service-id=90, execution-context=UNSPECIFIED
      sw service arg Data: category=DATA_REFERENCE, sw-pointer-target-props={target-category=TYPE_REFERENCE, implementation-data-type=uint8}
      sw service arg ShiftCnt: implementation-data-type=uint8
    Bfx_RotBitRt_u16u8: service-id=91, execution-context=UNSPECIFIED
      sw service arg Data: category=DATA_REFERENCE, sw-pointer-target-props={target-category=TYPE_REFERENCE, implementation-data-type=uint16}
      sw service arg ShiftCnt: implementation-data-type=uint8
    Bfx_RotBitRt_u32u8: service-id=92, execution-context=UNSPECIFIED
      sw service arg Data: category=DATA_REFERENCE, sw-pointer-target-props={target-category=TYPE_REFERENCE, implementation-data-type=uint32}
      sw service arg ShiftCnt: implementation-data-type=uint8
    Bfx_RotBitLt_u8u8: service-id=96, execution-context=UNSPECIFIED
      sw service arg Data: category=DATA_REFERENCE, sw-pointer-target-props={target-category=TYPE_REFERENCE, implementation-data-type=uint8}
      sw service arg ShiftCnt: implementation-data-type=uint8
    Bfx_RotBitLt_u16u8: service-id=97, execution-context=UNSPECIFIED
      sw service arg Data: category=DATA_REFERENCE, sw-pointer-target-props={target-category=TYPE_REFERENCE, implementation-data-type=uint16}
      sw service arg ShiftCnt: implementation-data-type=uint8
    Bfx_RotBitLt_u32u8: service-id=98, execution-context=UNSPECIFIED
      sw service arg Data: category=DATA_REFERENCE, sw-pointer-target-props={target-category=TYPE_REFERENCE, implementation-data-type=uint32}
      sw service arg ShiftCnt: implementation-data-type=uint8
    Bfx_CopyBit_u8u8u8u8: service-id=102, execution-context=UNSPECIFIED
      4 x sw service arg:
        DestinationData: category=DATA_REFERENCE, sw-pointer-target-props={target-category=TYPE_REFERENCE, implementation-data-type=uint8}
        DestinationPosition: implementation-data-type=uint8
        SourceData: implementation-data-type=uint8
        SourcePosition: implementation-data-type=uint8
    Bfx_CopyBit_u16u8u16u8: service-id=103, execution-context=UNSPECIFIED
      4 x sw service arg:
        DestinationData: category=DATA_REFERENCE, sw-pointer-target-props={target-category=TYPE_REFERENCE, implementation-data-type=uint16}
        DestinationPosition: implementation-data-type=uint8
        SourceData: implementation-data-type=uint16
        SourcePosition: implementation-data-type=uint8
    Bfx_CopyBit_u32u8u32u8: service-id=104, execution-context=UNSPECIFIED
      4 x sw service arg:
        DestinationData: category=DATA_REFERENCE, sw-pointer-target-props={target-category=TYPE_REFERENCE, implementation-data-type=uint32}
        DestinationPosition: implementation-data-type=uint8
        SourceData: implementation-data-type=uint32
        SourcePosition: implementation-data-type=uint8
    Bfx_PutBits_u8u8u8u8: service-id=112, execution-context=UNSPECIFIED
      4 x sw service arg:
        Data: category=DATA_REFERENCE, sw-pointer-target-props={target-category=TYPE_REFERENCE, implementation-data-type=uint8}
        BitStartPn: implementation-data-type=uint8
        BitLn: implementation-data-type=uint8
        Pattern: implementation-data-type=uint8
    Bfx_PutBits_u16u8u8u16: service-id=113, execution-context=UNSPECIFIED
      4 x sw service arg:
        Data: category=DATA_REFERENCE, sw-pointer-target-props={target-category=TYPE_REFERENCE, implementation-data-type=uint16}
        BitStartPn: implementation-data-type=uint8
        BitLn: implementation-data-type=uint8
        Pattern: implementation-data-type=uint16
    Bfx_PutBits_u32u8u8u32: service-id=114, execution-context=UNSPECIFIED
      4 x sw service arg:
        Data: category=DATA_REFERENCE, sw-pointer-target-props={target-category=TYPE_REFERENCE, implementation-data-type=uint32}
        BitStartPn: implementation-data-type=uint8
        BitLn: implementation-data-type=uint8
        Pattern: implementation-data-type=uint32
    Bfx_PutBitsMask_u8u8u8: service-id=128, execution-context=UNSPECIFIED
      sw service arg Data: category=DATA_REFERENCE, sw-pointer-target-props={target-category=TYPE_REFERENCE, implementation-data-type=uint8}
      sw service arg Pattern: implementation-data-type=uint8
      sw service arg Mask: implementation-data-type=uint8
    Bfx_PutBitsMask_u16u16u16: service-id=129, execution-context=UNSPECIFIED
      sw service arg Data: category=DATA_REFERENCE, sw-pointer-target-props={target-category=TYPE_REFERENCE, implementation-data-type=uint16}
      sw service arg Pattern: implementation-data-type=uint16
      sw service arg Mask: implementation-data-type=uint16
    Bfx_PutBitsMask_u32u32u32: service-id=130, execution-context=UNSPECIFIED
      sw service arg Data: category=DATA_REFERENCE, sw-pointer-target-props={target-category=TYPE_REFERENCE, implementation-data-type=uint32}
      sw service arg Pattern: implementation-data-type=uint32
      sw service arg Mask: implementation-data-type=uint32
    Bfx_PutBit_u8u8u8: service-id=133, execution-context=UNSPECIFIED
      sw service arg Data: category=DATA_REFERENCE, sw-pointer-target-props={target-category=TYPE_REFERENCE, implementation-data-type=uint8}
      sw service arg BitPn: implementation-data-type=uint8
      sw service arg Status: implementation-data-type=boolean
    Bfx_PutBit_u16u8u8: service-id=134, execution-context=UNSPECIFIED
      sw service arg Data: category=DATA_REFERENCE, sw-pointer-target-props={target-category=TYPE_REFERENCE, implementation-data-type=uint16}
      sw service arg BitPn: implementation-data-type=uint8
      sw service arg Status: implementation-data-type=boolean
    Bfx_PutBit_u32u8u8: service-id=135, execution-context=UNSPECIFIED
      sw service arg Data: category=DATA_REFERENCE, sw-pointer-target-props={target-category=TYPE_REFERENCE, implementation-data-type=uint32}
      sw service arg BitPn: implementation-data-type=uint8
      sw service arg Status: implementation-data-type=boolean
    Bfx_GetVersionInfo: service-id=255, execution-context=TASK
      sw service arg Versioninfo: category=DATA_REFERENCE, sw-pointer-target-props={target-category=TYPE_REFERENCE, implementation-data-type=Std_VersionInfoType}
package /AUTOSAR_Bfx/Implementations
  bsw implementation Bfx: programming-language=C, sw-version=10.30.0, vendor-id=17, ar-release-version=4.2.2, behavior=BfxBehavior
    code-descriptors:
      code Files: artifact-descriptors=[{short-label=ssc::src::Bfx.c, category=SWSRC}, {short-label=ssc::inc::Bfx.h, category=SWHDR}]
    5 x compiler:
      TASKING_6_2r2_COMPILE: name=TASKING_6_2r2, options="--core=tc1.6.2 --iso=99 -O2 --eabi-compliant -AGKpvX --switch=auto --integer-enumeration --default-near-size=0 --fp-model=1 ", vendor=Altium, version=V6.2r2p2
      TASKING_6_3r1_COMPILE: name=TASKING_6_3r1, options="--core=tc1.6.2 --iso=99 --optimize=2 --eabi-compliant --integer-enumeration --default-near-size=0 --fp-model=1 --language --warnings-as-errors --branch-target-align ", vendor=Altium, version=V6.3r1p1
      GNU_COMPILE: name=GNU, options="-DGNU -Wall -std=c99 -c -O2 -mtc162 -meabi -fno-short-enums -ffunction-sections -fdata-sections -fstrict-volatile-bitfields ", vendor=Hightec, version=V4.9.2.0
      DIAB_COMPILE: name=DIAB, options="-tTC162PMF:simple -O -XO -Xsection-split=1 -Xkeep-assembly-file=2 -g3 -Xinline=0 -Xdialect-c99 -ei5388,2273,5387 -ei1824 -Xsmall-data=0 -Xsmall-const=0 ", vendor=Windriver, version=V5.9.6.4
      GHS_COMPILE:
        name=GHS
        options="-gnu99 -g -cpu=tc1v162 --xref=full -tricore_ppccompat_abi -sda=none -roxda -minlib -Ogeneral -Onoprintfuncs -Onounroll -Onotailrecursion -Onoexplodejumps --unsigned_chars -ffunctions -fsingle -no_fused_madd -Oinline_constant_math -no_float_associativity -fno_NaN_cmp_unordered -no_precise_signed_zero -half_precision_type --no_commons --no_vla --gnu_asm -dual_debug --no_short_enum --diag_error 39,549,940,1056,1780,1999 --diag_warning 193,1705,1706,1709,1710,1718,1729,1735,1777,1826,1835,2017 -srec -lnk=-no_append -nostartfiles -map -Mn -Mx -nostdlib "
        vendor=GreenHills
        version=V2018.1.5 R9.15.1
    5 x linker:
      TASKING_6_2r2_LINK: name=TASKING_6_2r2, options="--map-file -OtcXYL --core=mpe:vtc ", vendor=Altium, version=V6.2r2p2
      TASKING_6_3r1_LINK: name=TASKING_6_3r1, options="--map-file -OtcXYL --core=mpe:vtc --warnings-as-errors ", vendor=Altium, version=V6.3r1p1
      GNU_LINK: name=GNU, options="-Wl,--mcpu=tc162 -Wl,--gc-sections -nostartfiles -n ", vendor=Hightec, version=V4.9.2.0
      DIAB_LINK: name=DIAB, options="-tTC162PMF:simple -m6 -Xremove-unused-sections ", vendor=Windriver, version=V5.9.6.4
      GHS_LINK:
        name=GHS
        options="-gnu99 -g -cpu=tc1v162 --xref=full -tricore_ppccompat_abi -sda=none -roxda -minlib -Ogeneral -Onoprintfuncs -Onounroll -Onotailrecursion -Onoexplodejumps --unsigned_chars -ffunctions -fsingle -no_fused_madd -Oinline_constant_math -no_float_associativity -fno_NaN_cmp_unordered -no_precise_signed_zero -half_precision_type --no_commons --no_vla --gnu_asm -dual_debug --no_short_enum --diag_error 39,549,940,1056,1780,1999 --diag_warning 193,1705,1706,1709,1710,1718,1729,1735,1777,1826,1835,2017 -srec -lnk=-no_append -nostartfiles -map -Mn -Mx -nostdlib "
        vendor=GreenHills
        version=V2018.1.5 R9.15.1
    resource consumption ResourceConsumption
      memory section CODE_ASIL_B_GLOBAL: alignment=UNSPECIFIED, sw-addrmethod=CODE
      section name prefix BFX
