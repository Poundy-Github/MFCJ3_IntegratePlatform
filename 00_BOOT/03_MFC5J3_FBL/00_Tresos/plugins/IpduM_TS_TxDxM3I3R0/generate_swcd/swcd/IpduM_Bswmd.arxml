<?xml version="1.0" encoding="ISO-8859-1"?>
[!AUTOSPACING!][!//
<AUTOSAR xmlns="http://autosar.org/schema/r4.0"
  xmlns:xsi="http://www.w3.org/2001/XMLSchema-instance"
  xsi:schemaLocation="http://autosar.org/schema/r4.0 AUTOSAR_4-0-3_STRICT_COMPACT.xsd">
  <AR-PACKAGES>
    <AR-PACKAGE>
      <SHORT-NAME>AUTOSAR_IpduM</SHORT-NAME>
      <AR-PACKAGES>
        <AR-PACKAGE>
          <SHORT-NAME>BswModuleDescriptions</SHORT-NAME>
          <ELEMENTS>
            <BSW-MODULE-DESCRIPTION>
              <SHORT-NAME>IpduM</SHORT-NAME>
              <MODULE-ID>52</MODULE-ID>
              <PROVIDED-ENTRYS>
                <BSW-MODULE-ENTRY-REF-CONDITIONAL>
                  <BSW-MODULE-ENTRY-REF DEST="BSW-MODULE-ENTRY">/AUTOSAR_IpduM/BswModuleEntrys/IpduM_MainFunctionRx</BSW-MODULE-ENTRY-REF>
                </BSW-MODULE-ENTRY-REF-CONDITIONAL>
[!IF "as:modconf('IpduM')[1]/IpduMGeneral/IpduMDedicatedIpduProcessingSupport = 'true'"!][!//
[!LOOP "as:modconf('IpduM')[1]/IpduMGeneral/IpduMRxProcessing/*"!][!//
                <BSW-MODULE-ENTRY-REF-CONDITIONAL>
                  <BSW-MODULE-ENTRY-REF DEST="BSW-MODULE-ENTRY">/AUTOSAR_IpduM/BswModuleEntrys/IpduM_MainFunctionRx_[!"as:name(.)"!]</BSW-MODULE-ENTRY-REF>
                </BSW-MODULE-ENTRY-REF-CONDITIONAL>
[!ENDLOOP!][!//
[!ENDIF!][!//
                <BSW-MODULE-ENTRY-REF-CONDITIONAL>
                  <BSW-MODULE-ENTRY-REF DEST="BSW-MODULE-ENTRY">/AUTOSAR_IpduM/BswModuleEntrys/IpduM_MainFunctionTx</BSW-MODULE-ENTRY-REF>
                </BSW-MODULE-ENTRY-REF-CONDITIONAL>
[!IF "as:modconf('IpduM')[1]/IpduMGeneral/IpduMDedicatedIpduProcessingSupport = 'true'"!][!//
[!LOOP "as:modconf('IpduM')[1]/IpduMGeneral/IpduMTxProcessing/*"!][!//
                <BSW-MODULE-ENTRY-REF-CONDITIONAL>
                  <BSW-MODULE-ENTRY-REF DEST="BSW-MODULE-ENTRY">/AUTOSAR_IpduM/BswModuleEntrys/IpduM_MainFunctionTx_[!"as:name(.)"!]</BSW-MODULE-ENTRY-REF>
                </BSW-MODULE-ENTRY-REF-CONDITIONAL>
[!ENDLOOP!][!//
[!ENDIF!][!//
              </PROVIDED-ENTRYS>
              <INTERNAL-BEHAVIORS>
[!IF "as:modconf('IpduM')[1]/IpduMGeneral/IpduMDedicatedIpduProcessingSupport = 'true'"!][!//
[!VAR "PartitionsRefs"!][!ENDVAR!][!//
[!LOOP "node:order(as:modconf('IpduM')[1]/IpduMGeneral/IpduMRxProcessing/*, 'node:IpduMPartitionRef')"!][!//
  [!VAR "PartitionsRefs"!][!"$PartitionsRefs"!];[!"as:name(as:ref(IpduMPartitionRef))"!]:1:Rx:[!"as:name(.)"!][!ENDVAR!][!//
[!ENDLOOP!][!//
[!LOOP "node:order(as:modconf('IpduM')[1]/IpduMGeneral/IpduMTxProcessing/*, 'node:IpduMPartitionRef')"!][!//
  [!VAR "PartitionsRefs"!][!"$PartitionsRefs"!];[!"as:name(as:ref(IpduMPartitionRef))"!]:1:Tx:[!"as:name(.)"!][!ENDVAR!][!//
[!ENDLOOP!][!//
[!LOOP "node:order(as:modconf('IpduM')[1]/IpduMGeneral/IpduMRxProcessing/*, 'node:IpduMPartitionRef')"!][!//
  [!VAR "PartitionsRefs"!][!"$PartitionsRefs"!];[!"as:name(as:ref(IpduMPartitionRef))"!]:2:Rx:[!"as:name(.)"!]:[!"num:f(IpduMTimeBase)"!][!ENDVAR!][!//
[!ENDLOOP!][!//
[!LOOP "node:order(as:modconf('IpduM')[1]/IpduMGeneral/IpduMTxProcessing/*, 'node:IpduMPartitionRef')"!][!//
  [!VAR "PartitionsRefs"!][!"$PartitionsRefs"!];[!"as:name(as:ref(IpduMPartitionRef))"!]:2:Tx:[!"as:name(.)"!]:[!"num:f(IpduMTimeBase)"!][!ENDVAR!][!//
[!ENDLOOP!][!//
[!VAR "start" = "0"!][!//
[!VAR "lastState"!][!ENDVAR!][!//
[!VAR "lastPartitionRef"!][!ENDVAR!][!//
[!LOOP "text:order(text:split($PartitionsRefs, ';'))"!][!// 
  [!VAR "partitionRef" = "text:split(., ':')[1]"!][!//
  [!VAR "state" = "text:split(., ':')[2]"!][!//
  [!VAR "type" = "text:split(., ':')[3]"!][!//
  [!VAR "MFShortName" = "text:split(., ':')[4]"!][!//
  [!IF "not($lastPartitionRef = $partitionRef)"!][!//
    [!IF "$start = 1"!][!//
                </EVENTS>
                </BSW-INTERNAL-BEHAVIOR>
    [!ELSE!][!//
      [!VAR "start" = "1"!]
    [!ENDIF!][!//
                <BSW-INTERNAL-BEHAVIOR>
                  <SHORT-NAME>InternalBehavior_[!"$partitionRef"!]</SHORT-NAME>
                  <EXCLUSIVE-AREAS>
                    <EXCLUSIVE-AREA>
                      <SHORT-NAME>SCHM_IPDUM_EXCLUSIVE_AREA_0</SHORT-NAME>
                    </EXCLUSIVE-AREA>
                  </EXCLUSIVE-AREAS>
                  <ENTITYS>
  [!ENDIF!][!//
  [!IF "$state = 1"!][!//
                    <BSW-SCHEDULABLE-ENTITY>
                      <SHORT-NAME>IpduM_MainFunction[!"$type"!]_[!"$MFShortName"!]</SHORT-NAME>
                      <CAN-ENTER-EXCLUSIVE-AREA-REFS>
                        <CAN-ENTER-EXCLUSIVE-AREA-REF DEST="EXCLUSIVE-AREA">/AUTOSAR_IpduM/BswModuleDescriptions/IpduM/InternalBehavior_[!"$partitionRef"!]/SCHM_IPDUM_EXCLUSIVE_AREA_0</CAN-ENTER-EXCLUSIVE-AREA-REF>
                      </CAN-ENTER-EXCLUSIVE-AREA-REFS>
                      <MINIMUM-START-INTERVAL>0.0</MINIMUM-START-INTERVAL>
                      <IMPLEMENTED-ENTRY-REF DEST="BSW-MODULE-ENTRY">/AUTOSAR_IpduM/BswModuleEntrys/IpduM_MainFunction[!"$type"!]_[!"$MFShortName"!]</IMPLEMENTED-ENTRY-REF>
                    </BSW-SCHEDULABLE-ENTITY>
  [!ELSE!][!//
    [!VAR "timeBase" = "text:split(., ':')[5]"!][!//
    [!IF "not($lastState = $state)"!][!//
                  </ENTITYS>
                  <EVENTS>
    [!ENDIF!][!//
                    <BSW-TIMING-EVENT>
                      <SHORT-NAME>TimingEvent_MainFunction[!"$type"!]_[!"$MFShortName"!]</SHORT-NAME>
                      <STARTS-ON-EVENT-REF DEST="BSW-SCHEDULABLE-ENTITY">/AUTOSAR_IpduM/BswModuleDescriptions/IpduM/InternalBehavior_[!"$partitionRef"!]/IpduM_MainFunction[!"$type"!]_[!"$MFShortName"!]</STARTS-ON-EVENT-REF>
                      <PERIOD>[!"$timeBase"!]</PERIOD>
                    </BSW-TIMING-EVENT>
  [!ENDIF!][!//
  [!VAR "lastState" = "$state"!][!//
  [!VAR "lastPartitionRef" = "$partitionRef"!][!//
[!ENDLOOP!][!//
[!IF "$start = 1"!][!//
                  </EVENTS>
                </BSW-INTERNAL-BEHAVIOR>
[!ENDIF!][!//
[!ENDIF!][!//
                <BSW-INTERNAL-BEHAVIOR>
                  <SHORT-NAME>InternalBehavior_0</SHORT-NAME>
                  <EXCLUSIVE-AREAS>
                    <EXCLUSIVE-AREA>
                      <SHORT-NAME>SCHM_IPDUM_EXCLUSIVE_AREA_0</SHORT-NAME>
                    </EXCLUSIVE-AREA>
                  </EXCLUSIVE-AREAS>
                  <ENTITYS>
                    <BSW-SCHEDULABLE-ENTITY>
                      <SHORT-NAME>IpduM_MainFunctionRx</SHORT-NAME>
                      <CAN-ENTER-EXCLUSIVE-AREA-REFS>
                        <CAN-ENTER-EXCLUSIVE-AREA-REF DEST="EXCLUSIVE-AREA">/AUTOSAR_IpduM/BswModuleDescriptions/IpduM/InternalBehavior_0/SCHM_IPDUM_EXCLUSIVE_AREA_0</CAN-ENTER-EXCLUSIVE-AREA-REF>
                      </CAN-ENTER-EXCLUSIVE-AREA-REFS>
                      <MINIMUM-START-INTERVAL>0.0</MINIMUM-START-INTERVAL>
                      <IMPLEMENTED-ENTRY-REF DEST="BSW-MODULE-ENTRY">/AUTOSAR_IpduM/BswModuleEntrys/IpduM_MainFunctionRx</IMPLEMENTED-ENTRY-REF>
                    </BSW-SCHEDULABLE-ENTITY>
                    <BSW-SCHEDULABLE-ENTITY>
                      <SHORT-NAME>IpduM_MainFunctionTx</SHORT-NAME>
                      <CAN-ENTER-EXCLUSIVE-AREA-REFS>
                        <CAN-ENTER-EXCLUSIVE-AREA-REF DEST="EXCLUSIVE-AREA">/AUTOSAR_IpduM/BswModuleDescriptions/IpduM/InternalBehavior_0/SCHM_IPDUM_EXCLUSIVE_AREA_0</CAN-ENTER-EXCLUSIVE-AREA-REF>
                      </CAN-ENTER-EXCLUSIVE-AREA-REFS>
                      <MINIMUM-START-INTERVAL>0.0</MINIMUM-START-INTERVAL>
                      <IMPLEMENTED-ENTRY-REF DEST="BSW-MODULE-ENTRY">/AUTOSAR_IpduM/BswModuleEntrys/IpduM_MainFunctionTx</IMPLEMENTED-ENTRY-REF>
                    </BSW-SCHEDULABLE-ENTITY>
                  </ENTITYS>
                  <EVENTS>
                    <BSW-TIMING-EVENT>
                      <SHORT-NAME>TimingEvent_MainFunctionRx</SHORT-NAME>
                      <STARTS-ON-EVENT-REF DEST="BSW-SCHEDULABLE-ENTITY">/AUTOSAR_IpduM/BswModuleDescriptions/IpduM/InternalBehavior_0/IpduM_MainFunctionRx</STARTS-ON-EVENT-REF>
                      <PERIOD>[!"num:f(IpduMGeneral/IpduMRxTimeBase)"!]</PERIOD>
                    </BSW-TIMING-EVENT>
                    <BSW-TIMING-EVENT>
                      <SHORT-NAME>TimingEvent_MainFunctionTx</SHORT-NAME>
                      <STARTS-ON-EVENT-REF DEST="BSW-SCHEDULABLE-ENTITY">/AUTOSAR_IpduM/BswModuleDescriptions/IpduM/InternalBehavior_0/IpduM_MainFunctionTx</STARTS-ON-EVENT-REF>
                      <PERIOD>[!"num:f(IpduMGeneral/IpduMTxTimeBase)"!]</PERIOD>
                    </BSW-TIMING-EVENT>
                  </EVENTS>
                </BSW-INTERNAL-BEHAVIOR>
              </INTERNAL-BEHAVIORS>
            </BSW-MODULE-DESCRIPTION>
          </ELEMENTS>
        </AR-PACKAGE>
        <AR-PACKAGE>
          <SHORT-NAME>BswModuleEntrys</SHORT-NAME>
          <ELEMENTS>
            <BSW-MODULE-ENTRY>
              <SHORT-NAME>IpduM_MainFunctionRx</SHORT-NAME>
              <SERVICE-ID>0x11</SERVICE-ID>
              <IS-REENTRANT>false</IS-REENTRANT>
              <IS-SYNCHRONOUS>true</IS-SYNCHRONOUS>
              <CALL-TYPE>SCHEDULED</CALL-TYPE>
              <EXECUTION-CONTEXT>TASK</EXECUTION-CONTEXT>
              <SW-SERVICE-IMPL-POLICY>STANDARD</SW-SERVICE-IMPL-POLICY>
              <ARGUMENTS>
              </ARGUMENTS>
            </BSW-MODULE-ENTRY>
[!IF "as:modconf('IpduM')[1]/IpduMGeneral/IpduMDedicatedIpduProcessingSupport = 'true'"!][!//
[!LOOP "as:modconf('IpduM')[1]/IpduMGeneral/IpduMRxProcessing/*"!][!//
            <BSW-MODULE-ENTRY>
              <SHORT-NAME>IpduM_MainFunctionRx_[!"as:name(.)"!]</SHORT-NAME>
              <SERVICE-ID>0x11</SERVICE-ID>
              <IS-REENTRANT>false</IS-REENTRANT>
              <IS-SYNCHRONOUS>true</IS-SYNCHRONOUS>
              <CALL-TYPE>SCHEDULED</CALL-TYPE>
              <EXECUTION-CONTEXT>TASK</EXECUTION-CONTEXT>
              <SW-SERVICE-IMPL-POLICY>STANDARD</SW-SERVICE-IMPL-POLICY>
              <ARGUMENTS>
              </ARGUMENTS>
            </BSW-MODULE-ENTRY>
[!ENDLOOP!][!//
[!ENDIF!][!//
            <BSW-MODULE-ENTRY>
              <SHORT-NAME>IpduM_MainFunctionTx</SHORT-NAME>
              <SERVICE-ID>0x12</SERVICE-ID>
              <IS-REENTRANT>false</IS-REENTRANT>
              <IS-SYNCHRONOUS>true</IS-SYNCHRONOUS>
              <CALL-TYPE>SCHEDULED</CALL-TYPE>
              <EXECUTION-CONTEXT>TASK</EXECUTION-CONTEXT>
              <SW-SERVICE-IMPL-POLICY>STANDARD</SW-SERVICE-IMPL-POLICY>
              <ARGUMENTS>
              </ARGUMENTS>
            </BSW-MODULE-ENTRY>
[!IF "as:modconf('IpduM')[1]/IpduMGeneral/IpduMDedicatedIpduProcessingSupport = 'true'"!][!//
[!LOOP "as:modconf('IpduM')[1]/IpduMGeneral/IpduMTxProcessing/*"!][!//
            <BSW-MODULE-ENTRY>
              <SHORT-NAME>IpduM_MainFunctionTx_[!"as:name(.)"!]</SHORT-NAME>
              <SERVICE-ID>0x12</SERVICE-ID>
              <IS-REENTRANT>false</IS-REENTRANT>
              <IS-SYNCHRONOUS>true</IS-SYNCHRONOUS>
              <CALL-TYPE>SCHEDULED</CALL-TYPE>
              <EXECUTION-CONTEXT>TASK</EXECUTION-CONTEXT>
              <SW-SERVICE-IMPL-POLICY>STANDARD</SW-SERVICE-IMPL-POLICY>
              <ARGUMENTS>
              </ARGUMENTS>
            </BSW-MODULE-ENTRY>
[!ENDLOOP!][!//
[!ENDIF!][!//
          </ELEMENTS>
        </AR-PACKAGE>
        <AR-PACKAGE>
          <SHORT-NAME>ImplementationDataTypes</SHORT-NAME>
          <ELEMENTS>
          </ELEMENTS>
        </AR-PACKAGE>
      </AR-PACKAGES>
    </AR-PACKAGE>

    <AR-PACKAGE>
      <SHORT-NAME>EB_IpduM</SHORT-NAME>
      <AR-PACKAGES>
        <AR-PACKAGE>
          <SHORT-NAME>Implementations</SHORT-NAME>
          <ELEMENTS>
            <BSW-IMPLEMENTATION>
              <SHORT-NAME>BswImplementation_0</SHORT-NAME>
              <CODE-DESCRIPTORS>
                <CODE>
                  <SHORT-NAME>Files</SHORT-NAME>
                  <ARTIFACT-DESCRIPTORS>
                    <AUTOSAR-ENGINEERING-OBJECT>
                      <SHORT-LABEL>Autosar::include::IpduM.h</SHORT-LABEL>
                      <CATEGORY>SWHDR</CATEGORY>
                    </AUTOSAR-ENGINEERING-OBJECT>
                    <AUTOSAR-ENGINEERING-OBJECT>
                      <SHORT-LABEL>Autosar::include::IpduM_Api.h</SHORT-LABEL>
                      <CATEGORY>SWHDR</CATEGORY>
                    </AUTOSAR-ENGINEERING-OBJECT>
                    <AUTOSAR-ENGINEERING-OBJECT>
                      <SHORT-LABEL>Autosar::include::IpduM_Cbk.h</SHORT-LABEL>
                      <CATEGORY>SWHDR</CATEGORY>
                    </AUTOSAR-ENGINEERING-OBJECT>
                    <AUTOSAR-ENGINEERING-OBJECT>
                      <SHORT-LABEL>Autosar::include::IpduM_ComCallout.h</SHORT-LABEL>
                      <CATEGORY>SWHDR</CATEGORY>
                    </AUTOSAR-ENGINEERING-OBJECT>
                    <AUTOSAR-ENGINEERING-OBJECT>
                      <SHORT-LABEL>Autosar::include::IpduM_Lcfg_Static.h</SHORT-LABEL>
                      <CATEGORY>SWHDR</CATEGORY>
                    </AUTOSAR-ENGINEERING-OBJECT>
                    <AUTOSAR-ENGINEERING-OBJECT>
                      <SHORT-LABEL>Autosar::include::IpduM_Trace.h</SHORT-LABEL>
                      <CATEGORY>SWHDR</CATEGORY>
                    </AUTOSAR-ENGINEERING-OBJECT>
                    <AUTOSAR-ENGINEERING-OBJECT>
                      <SHORT-LABEL>Autosar::include::IpduM_Trace_Internal.h</SHORT-LABEL>
                      <CATEGORY>SWHDR</CATEGORY>
                    </AUTOSAR-ENGINEERING-OBJECT>
                    <AUTOSAR-ENGINEERING-OBJECT>
                      <SHORT-LABEL>Autosar::include::IpduM_Version.h</SHORT-LABEL>
                      <CATEGORY>SWHDR</CATEGORY>
                    </AUTOSAR-ENGINEERING-OBJECT>
                    <AUTOSAR-ENGINEERING-OBJECT>
                      <SHORT-LABEL>Autosar::src::IpduM.c</SHORT-LABEL>
                      <CATEGORY>SWSRC</CATEGORY>
                    </AUTOSAR-ENGINEERING-OBJECT>
                    <AUTOSAR-ENGINEERING-OBJECT>
                      <SHORT-LABEL>Autosar::src::IpduM_ComCallout.c</SHORT-LABEL>
                      <CATEGORY>SWSRC</CATEGORY>
                    </AUTOSAR-ENGINEERING-OBJECT>
                    <AUTOSAR-ENGINEERING-OBJECT>
                      <SHORT-LABEL>make::IpduM_defs.mak</SHORT-LABEL>
                      <CATEGORY>SWMAKE</CATEGORY>
                    </AUTOSAR-ENGINEERING-OBJECT>
                    <AUTOSAR-ENGINEERING-OBJECT>
                      <SHORT-LABEL>make::IpduM_rules.mak</SHORT-LABEL>
                      <CATEGORY>SWMAKE</CATEGORY>
                    </AUTOSAR-ENGINEERING-OBJECT>
                  </ARTIFACT-DESCRIPTORS>
                </CODE>
              </CODE-DESCRIPTORS>
              <PROGRAMMING-LANGUAGE>C</PROGRAMMING-LANGUAGE>
              <RESOURCE-CONSUMPTION>
                <SHORT-NAME>ResourceConsumption</SHORT-NAME>
                <MEMORY-SECTIONS>
                  <MEMORY-SECTION>
                    <SHORT-NAME>CONST_32</SHORT-NAME>
                    <ALIGNMENT>32</ALIGNMENT>
                    <SW-ADDRMETHOD-REF DEST="SW-ADDR-METHOD">/AUTOSAR_MemMap/SwAddrMethods/CONST</SW-ADDRMETHOD-REF>
                  </MEMORY-SECTION>
                  <MEMORY-SECTION>
                    <SHORT-NAME>VAR_NO_INIT_16</SHORT-NAME>
                    <ALIGNMENT>16</ALIGNMENT>
                    <SW-ADDRMETHOD-REF DEST="SW-ADDR-METHOD">/AUTOSAR_MemMap/SwAddrMethods/VAR_NOINIT</SW-ADDRMETHOD-REF>
                  </MEMORY-SECTION>
                  <MEMORY-SECTION>
                    <SHORT-NAME>VAR_NO_INIT_8</SHORT-NAME>
                    <ALIGNMENT>8</ALIGNMENT>
                    <SW-ADDRMETHOD-REF DEST="SW-ADDR-METHOD">/AUTOSAR_MemMap/SwAddrMethods/VAR_NOINIT</SW-ADDRMETHOD-REF>
                  </MEMORY-SECTION>
                  <MEMORY-SECTION>
                    <SHORT-NAME>VAR_FAST_INIT_8</SHORT-NAME>
                    <ALIGNMENT>8</ALIGNMENT>
                    <SW-ADDRMETHOD-REF DEST="SW-ADDR-METHOD">/AUTOSAR_MemMap/SwAddrMethods/VAR_FAST</SW-ADDRMETHOD-REF>
                  </MEMORY-SECTION>
                  <MEMORY-SECTION>
                    <SHORT-NAME>VAR_NO_INIT_BOOLEAN</SHORT-NAME>
                    <ALIGNMENT>BOOLEAN</ALIGNMENT>
                    <SW-ADDRMETHOD-REF DEST="SW-ADDR-METHOD">/AUTOSAR_MemMap/SwAddrMethods/VAR_NOINIT</SW-ADDRMETHOD-REF>
                  </MEMORY-SECTION>
                  <MEMORY-SECTION>
                    <SHORT-NAME>CONST_UNSPECIFIED</SHORT-NAME>
                    <ALIGNMENT>UNSPECIFIED</ALIGNMENT>
                    <SW-ADDRMETHOD-REF DEST="SW-ADDR-METHOD">/AUTOSAR_MemMap/SwAddrMethods/CONST</SW-ADDRMETHOD-REF>
                  </MEMORY-SECTION>
                  <MEMORY-SECTION>
                    <SHORT-NAME>CODE</SHORT-NAME>
                    <SW-ADDRMETHOD-REF DEST="SW-ADDR-METHOD">/AUTOSAR_MemMap/SwAddrMethods/CODE</SW-ADDRMETHOD-REF>
                  </MEMORY-SECTION>
<!-- Deactivated for the moment due to MemMap
[!IF "as:modconf('IpduM')[1]/IpduMGeneral/IpduMDedicatedIpduProcessingSupport = 'true'"!][!//
[!LOOP "as:modconf('IpduM')[1]/IpduMGeneral/IpduMRxProcessing/*"!][!//
                  <MEMORY-SECTION>
                    <SHORT-NAME>CODE_LOCAL</SHORT-NAME>
                    <PREFIX-REF DEST="SECTION-NAME-PREFIX">/EB_IpduM/Implementations/BswImplementation_0/ResourceConsumption/IPDUM_[!"text:toupper(as:name(.))"!]</PREFIX-REF>
                    <SW-ADDRMETHOD-REF DEST="SW-ADDR-METHOD">/AUTOSAR_MemMap/SwAddrMethods/CODE</SW-ADDRMETHOD-REF>
                  </MEMORY-SECTION>
[!ENDLOOP!][!//
[!LOOP "as:modconf('IpduM')[1]/IpduMGeneral/IpduMTxProcessing/*"!][!//
                  <MEMORY-SECTION>
                    <SHORT-NAME>CODE_LOCAL</SHORT-NAME>
                    <PREFIX-REF DEST="SECTION-NAME-PREFIX">/EB_IpduM/Implementations/BswImplementation_0/ResourceConsumption/IPDUM_[!"text:toupper(as:name(.))"!]</PREFIX-REF>
                    <SW-ADDRMETHOD-REF DEST="SW-ADDR-METHOD">/AUTOSAR_MemMap/SwAddrMethods/CODE</SW-ADDRMETHOD-REF>
                  </MEMORY-SECTION>
[!ENDLOOP!][!//
[!ENDIF!][!//
-->
                  <MEMORY-SECTION>
                    <SHORT-NAME>VAR_FAST_INIT_UNSPECIFIED</SHORT-NAME>
                    <ALIGNMENT>UNSPECIFIED</ALIGNMENT>
                    <SW-ADDRMETHOD-REF DEST="SW-ADDR-METHOD">/AUTOSAR_MemMap/SwAddrMethods/VAR_FAST</SW-ADDRMETHOD-REF>
                  </MEMORY-SECTION>
                  <MEMORY-SECTION>
                    <SHORT-NAME>VAR_INIT_UNSPECIFIED</SHORT-NAME>
                    <ALIGNMENT>UNSPECIFIED</ALIGNMENT>
                    <SW-ADDRMETHOD-REF DEST="SW-ADDR-METHOD">/AUTOSAR_MemMap/SwAddrMethods/VAR_INIT</SW-ADDRMETHOD-REF>
                  </MEMORY-SECTION>
                  <MEMORY-SECTION>
                    <SHORT-NAME>VAR_NO_INIT_UNSPECIFIED</SHORT-NAME>
                    <ALIGNMENT>UNSPECIFIED</ALIGNMENT>
                    <SW-ADDRMETHOD-REF DEST="SW-ADDR-METHOD">/AUTOSAR_MemMap/SwAddrMethods/VAR_NOINIT</SW-ADDRMETHOD-REF>
                  </MEMORY-SECTION>
                  <MEMORY-SECTION>
                    <SHORT-NAME>CONFIG_DATA_UNSPECIFIED</SHORT-NAME>
                    <ALIGNMENT>UNSPECIFIED</ALIGNMENT>
                    <SW-ADDRMETHOD-REF DEST="SW-ADDR-METHOD">/AUTOSAR_MemMap/SwAddrMethods/CONFIG_DATA</SW-ADDRMETHOD-REF>
                  </MEMORY-SECTION>
                </MEMORY-SECTIONS>
                <SECTION-NAME-PREFIXS>
<!-- Deactivated for the moment due to MemMap
[!IF "as:modconf('IpduM')[1]/IpduMGeneral/IpduMDedicatedIpduProcessingSupport = 'true'"!][!//
[!LOOP "as:modconf('IpduM')[1]/IpduMGeneral/IpduMRxProcessing/*"!][!//
                  <SECTION-NAME-PREFIX>
                    <SHORT-NAME>IPDUM_[!"text:toupper(as:name(.))"!]</SHORT-NAME>
                    <SYMBOL>IPDUM_[!"text:toupper(as:name(.))"!]</SYMBOL>
                  </SECTION-NAME-PREFIX>
[!ENDLOOP!][!//
[!LOOP "as:modconf('IpduM')[1]/IpduMGeneral/IpduMTxProcessing/*"!][!//
                  <SECTION-NAME-PREFIX>
                    <SHORT-NAME>IPDUM_[!"text:toupper(as:name(.))"!]</SHORT-NAME>
                    <SYMBOL>IPDUM_[!"text:toupper(as:name(.))"!]</SYMBOL>
                  </SECTION-NAME-PREFIX>
[!ENDLOOP!][!//
[!ENDIF!][!//
-->
              </SECTION-NAME-PREFIXS>
              </RESOURCE-CONSUMPTION>
              <SW-VERSION>3.3.24</SW-VERSION>
              <VENDOR-ID>1</VENDOR-ID>
              <AR-RELEASE-VERSION>4.0.3</AR-RELEASE-VERSION>
              <BEHAVIOR-REF DEST="BSW-INTERNAL-BEHAVIOR">/AUTOSAR_IpduM/BswModuleDescriptions/IpduM/InternalBehavior_0</BEHAVIOR-REF>
              <VENDOR-SPECIFIC-MODULE-DEF-REFS>
                <VENDOR-SPECIFIC-MODULE-DEF-REF DEST="ECUC-MODULE-DEF">/TS_TxDxM3I3R0/IpduM</VENDOR-SPECIFIC-MODULE-DEF-REF>
              </VENDOR-SPECIFIC-MODULE-DEF-REFS>
            </BSW-IMPLEMENTATION>     
[!IF "as:modconf('IpduM')[1]/IpduMGeneral/IpduMDedicatedIpduProcessingSupport = 'true'"!][!//
[!VAR "PartitionsRefs"!][!ENDVAR!][!//
[!LOOP "node:order(as:modconf('IpduM')[1]/IpduMGeneral/IpduMRxProcessing/*, 'node:IpduMPartitionRef')"!][!//
  [!VAR "PartitionsRefs"!][!"$PartitionsRefs"!];[!"as:name(as:ref(IpduMPartitionRef))"!][!ENDVAR!][!//
[!ENDLOOP!][!//
[!LOOP "node:order(as:modconf('IpduM')[1]/IpduMGeneral/IpduMTxProcessing/*, 'node:IpduMPartitionRef')"!][!//
  [!VAR "PartitionsRefs"!][!"$PartitionsRefs"!];[!"as:name(as:ref(IpduMPartitionRef))"!][!ENDVAR!][!//
[!ENDLOOP!][!//
[!LOOP "text:order(text:split($PartitionsRefs, ';'))"!][!//             
            <BSW-IMPLEMENTATION>
              <SHORT-NAME>BswImplementation_[!"."!]</SHORT-NAME>
              <CODE-DESCRIPTORS>
                <CODE>
                  <SHORT-NAME>Files</SHORT-NAME>
                  <ARTIFACT-DESCRIPTORS>
                    <AUTOSAR-ENGINEERING-OBJECT>
                      <SHORT-LABEL>Autosar::include::IpduM.h</SHORT-LABEL>
                      <CATEGORY>SWHDR</CATEGORY>
                    </AUTOSAR-ENGINEERING-OBJECT>
                    <AUTOSAR-ENGINEERING-OBJECT>
                      <SHORT-LABEL>Autosar::include::IpduM_Api.h</SHORT-LABEL>
                      <CATEGORY>SWHDR</CATEGORY>
                    </AUTOSAR-ENGINEERING-OBJECT>
                    <AUTOSAR-ENGINEERING-OBJECT>
                      <SHORT-LABEL>Autosar::include::IpduM_Cbk.h</SHORT-LABEL>
                      <CATEGORY>SWHDR</CATEGORY>
                    </AUTOSAR-ENGINEERING-OBJECT>
                    <AUTOSAR-ENGINEERING-OBJECT>
                      <SHORT-LABEL>Autosar::include::IpduM_ComCallout.h</SHORT-LABEL>
                      <CATEGORY>SWHDR</CATEGORY>
                    </AUTOSAR-ENGINEERING-OBJECT>
                    <AUTOSAR-ENGINEERING-OBJECT>
                      <SHORT-LABEL>Autosar::include::IpduM_Lcfg_Static.h</SHORT-LABEL>
                      <CATEGORY>SWHDR</CATEGORY>
                    </AUTOSAR-ENGINEERING-OBJECT>
                    <AUTOSAR-ENGINEERING-OBJECT>
                      <SHORT-LABEL>Autosar::include::IpduM_Trace.h</SHORT-LABEL>
                      <CATEGORY>SWHDR</CATEGORY>
                    </AUTOSAR-ENGINEERING-OBJECT>
                    <AUTOSAR-ENGINEERING-OBJECT>
                      <SHORT-LABEL>Autosar::include::IpduM_Trace_Internal.h</SHORT-LABEL>
                      <CATEGORY>SWHDR</CATEGORY>
                    </AUTOSAR-ENGINEERING-OBJECT>
                    <AUTOSAR-ENGINEERING-OBJECT>
                      <SHORT-LABEL>Autosar::include::IpduM_Version.h</SHORT-LABEL>
                      <CATEGORY>SWHDR</CATEGORY>
                    </AUTOSAR-ENGINEERING-OBJECT>
                    <AUTOSAR-ENGINEERING-OBJECT>
                      <SHORT-LABEL>Autosar::src::IpduM.c</SHORT-LABEL>
                      <CATEGORY>SWSRC</CATEGORY>
                    </AUTOSAR-ENGINEERING-OBJECT>
                    <AUTOSAR-ENGINEERING-OBJECT>
                      <SHORT-LABEL>Autosar::src::IpduM_ComCallout.c</SHORT-LABEL>
                      <CATEGORY>SWSRC</CATEGORY>
                    </AUTOSAR-ENGINEERING-OBJECT>
                    <AUTOSAR-ENGINEERING-OBJECT>
                      <SHORT-LABEL>make::IpduM_defs.mak</SHORT-LABEL>
                      <CATEGORY>SWMAKE</CATEGORY>
                    </AUTOSAR-ENGINEERING-OBJECT>
                    <AUTOSAR-ENGINEERING-OBJECT>
                      <SHORT-LABEL>make::IpduM_rules.mak</SHORT-LABEL>
                      <CATEGORY>SWMAKE</CATEGORY>
                    </AUTOSAR-ENGINEERING-OBJECT>
                  </ARTIFACT-DESCRIPTORS>
                </CODE>
              </CODE-DESCRIPTORS>
              <PROGRAMMING-LANGUAGE>C</PROGRAMMING-LANGUAGE>
              <RESOURCE-CONSUMPTION>
                <SHORT-NAME>ResourceConsumption_[!"."!]</SHORT-NAME>
                <MEMORY-SECTIONS>
                  <MEMORY-SECTION>
                    <SHORT-NAME>CONST_32</SHORT-NAME>
                    <ALIGNMENT>32</ALIGNMENT>
                    <SW-ADDRMETHOD-REF DEST="SW-ADDR-METHOD">/AUTOSAR_MemMap/SwAddrMethods/CONST</SW-ADDRMETHOD-REF>
                  </MEMORY-SECTION>
                  <MEMORY-SECTION>
                    <SHORT-NAME>VAR_NO_INIT_32</SHORT-NAME>
                    <ALIGNMENT>32</ALIGNMENT>
                    <SW-ADDRMETHOD-REF DEST="SW-ADDR-METHOD">/AUTOSAR_MemMap/SwAddrMethods/VAR_NOINIT</SW-ADDRMETHOD-REF>
                  </MEMORY-SECTION>
                  <MEMORY-SECTION>
                    <SHORT-NAME>VAR_NO_INIT_16</SHORT-NAME>
                    <ALIGNMENT>16</ALIGNMENT>
                    <SW-ADDRMETHOD-REF DEST="SW-ADDR-METHOD">/AUTOSAR_MemMap/SwAddrMethods/VAR_NOINIT</SW-ADDRMETHOD-REF>
                  </MEMORY-SECTION>
                  <MEMORY-SECTION>
                    <SHORT-NAME>VAR_NO_INIT_8</SHORT-NAME>
                    <ALIGNMENT>8</ALIGNMENT>
                    <SW-ADDRMETHOD-REF DEST="SW-ADDR-METHOD">/AUTOSAR_MemMap/SwAddrMethods/VAR_NOINIT</SW-ADDRMETHOD-REF>
                  </MEMORY-SECTION>
                  <MEMORY-SECTION>
                    <SHORT-NAME>VAR_FAST_INIT_8</SHORT-NAME>
                    <ALIGNMENT>8</ALIGNMENT>
                    <SW-ADDRMETHOD-REF DEST="SW-ADDR-METHOD">/AUTOSAR_MemMap/SwAddrMethods/VAR_FAST</SW-ADDRMETHOD-REF>
                  </MEMORY-SECTION>
                  <MEMORY-SECTION>
                    <SHORT-NAME>VAR_NO_INIT_BOOLEAN</SHORT-NAME>
                    <ALIGNMENT>BOOLEAN</ALIGNMENT>
                    <SW-ADDRMETHOD-REF DEST="SW-ADDR-METHOD">/AUTOSAR_MemMap/SwAddrMethods/VAR_NOINIT</SW-ADDRMETHOD-REF>
                  </MEMORY-SECTION>
                  <MEMORY-SECTION>
                    <SHORT-NAME>CONST_UNSPECIFIED</SHORT-NAME>
                    <ALIGNMENT>UNSPECIFIED</ALIGNMENT>
                    <SW-ADDRMETHOD-REF DEST="SW-ADDR-METHOD">/AUTOSAR_MemMap/SwAddrMethods/CONST</SW-ADDRMETHOD-REF>
                  </MEMORY-SECTION>
                  <MEMORY-SECTION>
                    <SHORT-NAME>CODE</SHORT-NAME>
                    <SW-ADDRMETHOD-REF DEST="SW-ADDR-METHOD">/AUTOSAR_MemMap/SwAddrMethods/CODE</SW-ADDRMETHOD-REF>
                  </MEMORY-SECTION>
<!-- Deactivated for the moment due to MemMap
[!IF "as:modconf('IpduM')[1]/IpduMGeneral/IpduMDedicatedIpduProcessingSupport = 'true'"!][!//
[!LOOP "as:modconf('IpduM')[1]/IpduMGeneral/IpduMRxProcessing/*"!][!//
                  <MEMORY-SECTION>
                    <SHORT-NAME>CODE_LOCAL</SHORT-NAME>
                    <PREFIX-REF DEST="SECTION-NAME-PREFIX">/EB_IpduM/Implementations/BswImplementation_0/ResourceConsumption/IPDUM_[!"text:toupper(as:name(.))"!]</PREFIX-REF>
                    <SW-ADDRMETHOD-REF DEST="SW-ADDR-METHOD">/AUTOSAR_MemMap/SwAddrMethods/CODE</SW-ADDRMETHOD-REF>
                  </MEMORY-SECTION>
[!ENDLOOP!][!//
[!LOOP "as:modconf('IpduM')[1]/IpduMGeneral/IpduMTxProcessing/*"!][!//
                  <MEMORY-SECTION>
                    <SHORT-NAME>CODE_LOCAL</SHORT-NAME>
                    <PREFIX-REF DEST="SECTION-NAME-PREFIX">/EB_IpduM/Implementations/BswImplementation_0/ResourceConsumption/IPDUM_[!"text:toupper(as:name(.))"!]</PREFIX-REF>
                    <SW-ADDRMETHOD-REF DEST="SW-ADDR-METHOD">/AUTOSAR_MemMap/SwAddrMethods/CODE</SW-ADDRMETHOD-REF>
                  </MEMORY-SECTION>
[!ENDLOOP!][!//
[!ENDIF!][!//
-->
                  <MEMORY-SECTION>
                    <SHORT-NAME>VAR_FAST_INIT_UNSPECIFIED</SHORT-NAME>
                    <ALIGNMENT>UNSPECIFIED</ALIGNMENT>
                    <SW-ADDRMETHOD-REF DEST="SW-ADDR-METHOD">/AUTOSAR_MemMap/SwAddrMethods/VAR_FAST</SW-ADDRMETHOD-REF>
                  </MEMORY-SECTION>
                  <MEMORY-SECTION>
                    <SHORT-NAME>VAR_INIT_UNSPECIFIED</SHORT-NAME>
                    <ALIGNMENT>UNSPECIFIED</ALIGNMENT>
                    <SW-ADDRMETHOD-REF DEST="SW-ADDR-METHOD">/AUTOSAR_MemMap/SwAddrMethods/VAR_INIT</SW-ADDRMETHOD-REF>
                  </MEMORY-SECTION>
                  <MEMORY-SECTION>
                    <SHORT-NAME>VAR_NO_INIT_UNSPECIFIED</SHORT-NAME>
                    <ALIGNMENT>UNSPECIFIED</ALIGNMENT>
                    <SW-ADDRMETHOD-REF DEST="SW-ADDR-METHOD">/AUTOSAR_MemMap/SwAddrMethods/VAR_NOINIT</SW-ADDRMETHOD-REF>
                  </MEMORY-SECTION>
                  <MEMORY-SECTION>
                    <SHORT-NAME>CONFIG_DATA_UNSPECIFIED</SHORT-NAME>
                    <ALIGNMENT>UNSPECIFIED</ALIGNMENT>
                    <SW-ADDRMETHOD-REF DEST="SW-ADDR-METHOD">/AUTOSAR_MemMap/SwAddrMethods/CONFIG_DATA</SW-ADDRMETHOD-REF>
                  </MEMORY-SECTION>
                </MEMORY-SECTIONS>
                <SECTION-NAME-PREFIXS>
<!-- Deactivated for the moment due to MemMap
[!IF "as:modconf('IpduM')[1]/IpduMGeneral/IpduMDedicatedIpduProcessingSupport = 'true'"!][!//
[!LOOP "as:modconf('IpduM')[1]/IpduMGeneral/IpduMRxProcessing/*"!][!//
                  <SECTION-NAME-PREFIX>
                    <SHORT-NAME>IPDUM_[!"text:toupper(as:name(.))"!]</SHORT-NAME>
                    <SYMBOL>IPDUM_[!"text:toupper(as:name(.))"!]</SYMBOL>
                  </SECTION-NAME-PREFIX>
[!ENDLOOP!][!//
[!LOOP "as:modconf('IpduM')[1]/IpduMGeneral/IpduMTxProcessing/*"!][!//
                  <SECTION-NAME-PREFIX>
                    <SHORT-NAME>IPDUM_[!"text:toupper(as:name(.))"!]</SHORT-NAME>
                    <SYMBOL>IPDUM_[!"text:toupper(as:name(.))"!]</SYMBOL>
                  </SECTION-NAME-PREFIX>
[!ENDLOOP!][!//
[!ENDIF!][!//
-->
              </SECTION-NAME-PREFIXS>
              </RESOURCE-CONSUMPTION>
              <SW-VERSION>3.3.24</SW-VERSION>
              <VENDOR-ID>1</VENDOR-ID>
              <AR-RELEASE-VERSION>4.0.3</AR-RELEASE-VERSION>
              <BEHAVIOR-REF DEST="BSW-INTERNAL-BEHAVIOR">/AUTOSAR_IpduM/BswModuleDescriptions/IpduM/InternalBehavior_[!"."!]</BEHAVIOR-REF>
              <VENDOR-SPECIFIC-MODULE-DEF-REFS>
                <VENDOR-SPECIFIC-MODULE-DEF-REF DEST="ECUC-MODULE-DEF">/TS_TxDxM3I3R0/IpduM</VENDOR-SPECIFIC-MODULE-DEF-REF>
              </VENDOR-SPECIFIC-MODULE-DEF-REFS>
            </BSW-IMPLEMENTATION>
[!ENDLOOP!][!//
[!ENDIF!]            
          </ELEMENTS>
        </AR-PACKAGE>
      </AR-PACKAGES>
    </AR-PACKAGE>
  </AR-PACKAGES>
</AUTOSAR>
