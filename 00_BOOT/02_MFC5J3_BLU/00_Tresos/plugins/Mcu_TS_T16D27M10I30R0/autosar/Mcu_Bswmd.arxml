[part 1 of 2]
<?xml version="1.0" encoding="UTF-8"?>
[!/*<!--
/**************************************************************************** **
**                                                                            **
** Copyright (C) Infineon Technologies (2019)                                 **
**                                                                            **
** All rights reserved.                                                       **
**                                                                            **
** This document contains proprietary information belonging to Infineon       **
** Technologies. Passing on and copying of this document, and communication   **
** of its contents is not permitted without prior written authorization.      **
**                                                                            **
***************************************************************************** **
**                                                                            **
**  FILENAME   : Mcu_Bswmd.arxml                                              **
**                                                                            **
**  CC VERSION :  1.30.0_16.0.0                                               **
**                                                                            **
**  DATE       :  2019-10-09                                                  **
**                                                                            **
**  VARIANT    : Variant PB                                                   **
**                                                                            **
**  PLATFORM   : Infineon AURIX2G                                             **
**                                                                            **
**  AUTHOR     : DL-AUTOSAR-Engineering                                       **
**                                                                            **
**  VENDOR     : Infineon Technologies                                        **
**                                                                            **
**  TRACEABILITY : [cover parentID=]                                          **
**                                                                            **
**  DESCRIPTION  : BSWMD for Mcu driver                                       **
**                                                                            **
**  [/cover]                                                                  **
**                                                                            **
**  SPECIFICATION(S) : Specification of Mcu Driver, AUTOSAR Release 4.2.2     **
**                                                                            **
**  MAY BE CHANGED BY USER : no                                               **
**                                                                            **
*******************************************************************************/
-->*/!]
<!--
/*******************************************************************************
**                                                                            **
** Copyright (C) Infineon Technologies (2019)                                 **
**                                                                            **
** All rights reserved.                                                       **
**                                                                            **
** This document contains proprietary information belonging to Infineon       **
** Technologies. Passing on and copying of this document, and communication   **
** of its contents is not permitted without prior written authorization.      **
**                                                                            **
********************************************************************************
**                                                                            **
**  FILENAME  : Mcu_Bswmd.arxml                                               **
**                                                                            **
**  VERSION   : 1.30.0_16.0.0                                                 **
**                                                                            **
**  DATE, TIME: [!"$date"!], [!"$time"!]          !!!IGNORE-LINE!!!               **
**                                                                            **
**  GENERATOR : Build [!"$buildnr"!]            !!!IGNORE-LINE!!!               **
**                                                                            **
**  VARIANT   : Variant PB                                                    **
**                                                                            **
**  PLATFORM  : Infineon AURIX2G                                              **
**                                                                            **
**  AUTHOR    : DL-AUTOSAR-Engineering                                        **
**                                                                            **
**  VENDOR    : Infineon Technologies                                         **
**                                                                            **
**  DESCRIPTION  : Basic Software Module Description for MCU                  **
**                                                                            **
**  SPECIFICATION(S) : Specification of Mcu Driver, AUTOSAR Release 4.2.2     **
**                                                                            **
**  MAY BE CHANGED BY USER : no                                               **
**                                                                            **
*******************************************************************************/
-->
[!NOCODE!][!//
[!/*<!--[cover parentID={D1091AC4-7A9B-49d1-AD96-B4B060EDCDD2}][/cover]-->*/!]
[!/*<!--[cover parentID={EEF5FB94-EA5F-424b-A443-44494182737A}][/cover]-->*/!]
[!ENDNOCODE!][!//
<AUTOSAR xmlns="http://autosar.org/schema/r4.0" xmlns:xsi="http://www.w3.org/2001/XMLSchema-instance" xsi:schemaLocation="http://autosar.org/schema/r4.0 AUTOSAR_4-2-2.xsd">
[!AUTOSPACING!][!//
[!NOCODE!][!//
  [!/*<!--[cover parentID={9DC850D8-0D0B-46de-A2D1-99660301906F}][/cover]-->*/!]
  [!VAR "WdgUser" = "num:i(0)"!][!//
  [!VAR "StmUser" = "num:i(0)"!][!//
  [!VAR "PwmUser" = "num:i(0)"!][!//
  [!VAR "GptUser" = "num:i(0)"!][!//
  [!VAR "IcuUser" = "num:i(0)"!][!//
  [!VAR "Mcu_StmUserAvailabe_Xpath" = "'false'"!][!//
  [!VAR "Mcu_WdgUserAvailabe_Xpath" = "'false'"!][!//
  [!VAR "Mcu_PwmUserAvailabe_Xpath" = "'false'"!][!//
  [!VAR "Mcu_GptUserAvailabe_Xpath" = "'false'"!][!//
  [!VAR "Mcu_IcuUserAvailabe_Xpath" = "'false'"!][!//
  [!SELECT " as:modconf('Mcu')[1]"!][!//
    [!VAR "Mcu_InitClock_Xpath" = "McuGeneralConfiguration/McuInitClock"!][!//
    [!VAR "Mcu_InitCheck_Xpath" = "McuGeneralConfiguration/McuInitCheckApi"!][!//
    [!VAR "McuDetEnable_Xpath" = "McuGeneralConfiguration/McuDevErrorDetect"!][!//
    [!VAR "McuSafetyEnable_Xpath" = "McuGeneralConfiguration/McuSafetyEnable"!][!//
    [!VAR "Mcu_PerformReset_Xpath" = "McuGeneralConfiguration/McuPerformResetApi"!][!//
    [!VAR "Mcu_VersionInfo_Xpath" = "McuGeneralConfiguration/McuVersionInfoApi"!][!//
    [!VAR "Mcu_ClearColdReset_Xpath" = "McuGeneralConfiguration/McuClearColdResetStatusApi"!][!//
    [!VAR "Mcu_GetRamStateApi_Xpath" = "McuGeneralConfiguration/McuGetRamStateApi"!][!//
    [!VAR "Mcu_TrapApi_Xpath" = "McuGeneralConfiguration/McuIfxTrapApi"!][!//
    [!VAR "Mcu_LowPowerModeApis_Xpath" = "McuGeneralConfiguration/McuIfxLpmApi"!][!//
    [!VAR "Mcu_ClockFailureNotification_Xpath" = "McuGeneralConfiguration/McuClockSourceFailureNotification"!][!//
    [!VAR "Mcu_CcuconApi_Xpath" = "McuGeneralConfiguration/McuIfxCpuCcuconApi"!][!//
    [!VAR "Mcu_DeInitApi_Xpath" = "McuGeneralConfiguration/McuIfxDeInitApi"!][!//
    [!VAR "Mcu_GtmIpAvailable_Xpath" = "ecu:get('Gtm.Available')"!][!//
    [!VAR "Mcu_DistributePllClock_Xpath" = "'false'"!][!//
    [!IF "(McuGeneralConfiguration/McuNoPll = 'false')"!][!//
      [!VAR "Mcu_DistributePllClock_Xpath" = "'true'"!][!//
    [!ENDIF!][!//
    [!SELECT "./McuHardwareResourceAllocationConf/*[1]/McuStmAllocationConf"!][!//
      [!IF "node:containsValue(./*/McuStmCmp0RegAllocationConf, 'STM_CMP0_USED_BY_WDG') = 'true'"!][!//
        [!VAR "WdgUser" = "num:i($WdgUser+1)"!][!//
      [!ELSEIF "node:containsValue(./*/McuStmCmp0RegAllocationConf, 'STM_CMP0_USED_BY_STM') = 'true'"!][!//
        [!VAR "StmUser" = "num:i($StmUser+1)"!][!//
      [!ENDIF!][!//
      [!IF "node:containsValue(./*/McuStmCmp1RegAllocationConf, 'STM_CMP1_USED_BY_WDG') = 'true'"!][!//
        [!VAR "WdgUser" = "num:i($WdgUser+1)"!][!//
      [!ELSEIF "node:containsValue(./*/McuStmCmp0RegAllocationConf, 'STM_CMP1_USED_BY_STM') = 'true'"!][!//
        [!VAR "StmUser" = "num:i($StmUser+1)"!][!//
      [!ENDIF!][!//
    [!ENDSELECT!][!//
    [!IF "ecu:get('Gtm.Available')='true'"!][!//
      [!SELECT "./McuHardwareResourceAllocationConf/*[1]/McuGtmAllocationConf/*[1]"!][!//
        [!VAR "TomCount" = "num:i(ecu:get('Gtm.NumberOfTomModules'))"!][!//
        [!VAR "TomChCount" = "num:i(ecu:get('Gtm.NumberOfTomChannels'))"!][!//
        [!VAR "AtomCount" = "num:i(ecu:get('Gtm.NumberOfAtomModules'))"!][!//
        [!VAR "AtomChCount" = "num:i(ecu:get('Gtm.NumberOfAtomChannels'))"!][!//
        [!VAR "TimCount" = "num:i(ecu:get('Gtm.NumberOfTimModules'))"!][!//
        [!VAR "TimChCount" = "num:i(ecu:get('Gtm.NumberOfTimChannels'))"!][!//
        [!IF "$TimCount > num:i(0)"!][!//
          [!IF "node:containsValue(./*/*/McuGtmTimChannelAllocationConf/*/McuGtmTimChannelAllocationConf, 'GTM_TIM_CHANNEL_USED_BY_ICU') = 'true'"!][!//
            [!VAR "IcuUser" = "num:i($IcuUser+1)"!][!//
          [!ENDIF!][!//
        [!ENDIF!][!//
        [!IF "$TomCount > num:i(0)"!][!//
          [!IF "node:containsValue(./*/*/McuGtmTomChannelAllocationConf/*/McuGtmTomChannelAllocationConf, 'GTM_TOM_CHANNEL_USED_BY_WDG') = 'true'"!][!//
            [!VAR "WdgUser" = "num:i($WdgUser+1)"!][!//
          [!ENDIF!][!//
          [!IF "node:containsValue(./*/*/McuGtmTomChannelAllocationConf/*/McuGtmTomChannelAllocationConf, 'GTM_TOM_CHANNEL_USED_BY_PWM') = 'true'"!][!//
            [!VAR "PwmUser" = "num:i($PwmUser+1)"!][!//
          [!ENDIF!][!//
          [!IF "node:containsValue(./*/*/McuGtmTomChannelAllocationConf/*/McuGtmTomChannelAllocationConf, 'GTM_TOM_CHANNEL_USED_BY_GPT') = 'true'"!][!//
            [!VAR "GptUser" = "num:i($GptUser+1)"!][!//
          [!ENDIF!][!//
        [!ENDIF!][!//
        [!IF "$AtomCount > num:i(0)"!][!//
          [!IF "node:containsValue(./*/*/McuGtmAtomChannelAllocationConf/*/McuGtmAtomChannelAllocationConf, 'GTM_ATOM_CHANNEL_USED_BY_WDG') = 'true'"!][!//
            [!VAR "WdgUser" = "num:i($WdgUser+1)"!][!//
          [!ENDIF!][!//
          [!IF "node:containsValue(./*/*/McuGtmAtomChannelAllocationConf/*/McuGtmAtomChannelAllocationConf, 'GTM_ATOM_CHANNEL_USED_BY_PWM') = 'true'"!][!//
            [!VAR "PwmUser" = "num:i($PwmUser+1)"!][!//
          [!ENDIF!][!//
          [!IF "node:containsValue(./*/*/McuGtmAtomChannelAllocationConf/*/McuGtmAtomChannelAllocationConf, 'GTM_ATOM_CHANNEL_USED_BY_GPT') = 'true'"!][!//
            [!VAR "GptUser" = "num:i($GptUser+1)"!][!//
          [!ENDIF!][!//
        [!ENDIF!][!//
      [!ENDSELECT!][!//
    [!ENDIF!][!//
    [!IF "ecu:get('Ccu6.Available') = 'true'"!][!//
      [!SELECT "./McuHardwareResourceAllocationConf/*[1]/McuCcu6ModuleAllocationConf"!][!//
        [!IF "node:containsValue(./*/McuCcu6ModuleAllocationConf, 'CCU6_MODULE_USED_BY_ICU_DRIVER') = 'true'"!][!//
          [!VAR "IcuUser" = "num:i($IcuUser+1)"!][!//
        [!ENDIF!][!//
        [!IF "node:containsValue(./*/McuCcu6ModuleAllocationConf, 'CCU6_MODULE_USED_BY_PWM_DRIVER') = 'true'"!][!//
          [!VAR "PwmUser" = "num:i($PwmUser+1)"!][!//
        [!ENDIF!][!//
      [!ENDSELECT!][!//
    [!ENDIF!][!//
    [!IF "ecu:get('Gpt12.Available') = 'true'"!][!//
      [!SELECT "./McuHardwareResourceAllocationConf/*[1]/McuGpt12ModuleAllocationConf"!][!//
        [!IF "node:containsValue(./*/McuGpt12ModuleAllocationConf, 'GPT_BLOCK_USED_BY_ICU_DRIVER') = 'true'"!][!//
          [!VAR "IcuUser" = "num:i($IcuUser+1)"!][!//
        [!ENDIF!][!//
      [!ENDSELECT!][!//
    [!ENDIF!][!//
    [!SELECT "./McuHardwareResourceAllocationConf/*[1]/McuEruAllocationConf"!][!//
      [!IF "node:containsValue(./*[1]/*/*/McuEruChannelInputLineConf, 'ERU_CHANNEL_INP_USED_BY_ICU_DRIVER') = 'true'"!][!//
        [!VAR "IcuUser" = "num:i($IcuUser+1)"!][!//
      [!ENDIF!][!//
      [!IF "node:containsValue(./*[1]/*/*/McuEruChannelOutputUnitConf, 'ERU_CHANNEL_INP_USED_BY_ICU_DRIVER') = 'true'"!][!//
        [!VAR "IcuUser" = "num:i($IcuUser+1)"!][!//
      [!ENDIF!][!//
    [!ENDSELECT!][!//
    [!IF "$StmUser > num:i(0)"!][!//
      [!VAR "Mcu_StmUserAvailabe_Xpath" = "'true'"!][!//
    [!ENDIF!][!//
    [!IF "$WdgUser > num:i(0)"!][!//
      [!VAR "Mcu_WdgUserAvailabe_Xpath" = "'true'"!][!//
    [!ENDIF!][!//
    [!IF "$PwmUser > num:i(0)"!][!//
      [!VAR "Mcu_PwmUserAvailabe_Xpath" = "'true'"!][!//
    [!ENDIF!][!//
    [!IF "$GptUser > num:i(0)"!][!//
      [!VAR "Mcu_GptUserAvailabe_Xpath" = "'true'"!][!//
    [!ENDIF!][!//
    [!IF "$IcuUser > num:i(0)"!][!//
      [!VAR "Mcu_IcuUserAvailabe_Xpath" = "'true'"!][!//
    [!ENDIF!][!//
  [!ENDSELECT!][!//


  [!IF "ecu:has('Tasking.Version') and ecu:has('Tasking.Compiler.Options') and ecu:has('Tasking.Linker.Options')"!][!//
    [!VAR "TaskingCompilerOption" = "ecu:get('Tasking.Compiler.Options')"!][!//
    [!VAR "TaskingLinkerOption"   = "ecu:get('Tasking.Linker.Options')"!][!//
    [!VAR "TaskingVersion"        = "ecu:get('Tasking.Version')"!][!//
  [!ELSE!]
    [!ERROR!] Tasking Options not available in Property File[!ENDERROR!][!//
  [!ENDIF!]
  [!IF "ecu:has('Tasking_v6_3r1.Version') and ecu:has('Tasking_v6_3r1.Compiler.Options') and ecu:has('Tasking_v6_3r1.Linker.Options')"!][!//
    [!VAR "Tasking6_3r1CompilerOption" = "ecu:get('Tasking_v6_3r1.Compiler.Options')"!][!//
    [!VAR "Tasking6_3r1LinkerOption"   = "ecu:get('Tasking_v6_3r1.Linker.Options')"!][!//
    [!VAR "Tasking6_3r1Version"        = "ecu:get('Tasking_v6_3r1.Version')"!][!//
    [!VAR "IsTasking6_3r1VersionAvailable"        = "'YES'"!][!//
  [!ELSE!]
    [!VAR "IsTasking6_3r1VersionAvailable"        = "'NO'"!][!//
  [!ENDIF!]
  [!IF "ecu:has('Gnuc.Version') and ecu:has('Gnuc.Compiler.Options') and ecu:has('Gnuc.Linker.Options')"!][!//
    [!VAR "GnucCompilerOption" = "ecu:get('Gnuc.Compiler.Options')"!][!//
    [!VAR "GnucLinkerOption"   = "ecu:get('Gnuc.Linker.Options')"!][!//
    [!VAR "GnucVersion"        = "ecu:get('Gnuc.Version')"!][!//
  [!ELSE!]
    [!ERROR!] GNUC Options not available in Property File[!ENDERROR!][!//
  [!ENDIF!]
  [!IF "ecu:has('Ghs.Version') and ecu:has('Ghs.Compiler.Options') and ecu:has('Ghs.Linker.Options')"!][!//
    [!VAR "GhsCompilerOption" = "ecu:get('Ghs.Compiler.Options')"!][!//
    [!VAR "GhsLinkerOption"   = "ecu:get('Ghs.Linker.Options')"!][!//
    [!VAR "GhsVersion"        = "ecu:get('Ghs.Version')"!][!//
  [!ELSE!]
    [!ERROR!] GHS Options not available in Property File[!ENDERROR!][!//
  [!ENDIF!]
  [!IF "ecu:has('Dcc.Version') and ecu:has('Dcc.Compiler.Options') and ecu:has('Dcc.Linker.Options')"!][!//
    [!VAR "DccCompilerOption" = "ecu:get('Dcc.Compiler.Options')"!][!//
    [!VAR "DccLinkerOption"   = "ecu:get('Dcc.Linker.Options')"!][!//
    [!VAR "DccVersion"        = "ecu:get('Dcc.Version')"!][!//
  [!ELSE!]
    [!ERROR!] DCC Options not available in Property File[!ENDERROR!][!//
  [!ENDIF!]
[!ENDNOCODE!][!//
<AR-PACKAGES>
  <AR-PACKAGE>
    <SHORT-NAME>AUTOSAR_Mcu</SHORT-NAME>
    <AR-PACKAGES>
      <AR-PACKAGE>
        <SHORT-NAME>BswModuleDescriptions</SHORT-NAME>
        <CATEGORY>STANDARD</CATEGORY>
        <ELEMENTS>
          <BSW-MODULE-DESCRIPTION>
            <SHORT-NAME>Mcu</SHORT-NAME>
            <LONG-NAME>
              <L-4 L="EN">Mcu Driver</L-4>
            </LONG-NAME>
            <CATEGORY>BSW_MODULE</CATEGORY>
            <MODULE-ID>101</MODULE-ID>
            <PROVIDED-ENTRYS>
              <BSW-MODULE-ENTRY-REF-CONDITIONAL>
                <BSW-MODULE-ENTRY-REF DEST="BSW-MODULE-ENTRY">/AUTOSAR_Mcu/BswModuleEntrys/Mcu_Init</BSW-MODULE-ENTRY-REF>
              </BSW-MODULE-ENTRY-REF-CONDITIONAL>
              <BSW-MODULE-ENTRY-REF-CONDITIONAL>
                <BSW-MODULE-ENTRY-REF DEST="BSW-MODULE-ENTRY">/AUTOSAR_Mcu/BswModuleEntrys/Mcu_InitRamSection</BSW-MODULE-ENTRY-REF>
              </BSW-MODULE-ENTRY-REF-CONDITIONAL>
[!IF "$Mcu_InitClock_Xpath = 'true'"!]
              <BSW-MODULE-ENTRY-REF-CONDITIONAL>
                <BSW-MODULE-ENTRY-REF DEST="BSW-MODULE-ENTRY">/AUTOSAR_Mcu/BswModuleEntrys/Mcu_InitClock</BSW-MODULE-ENTRY-REF>
              </BSW-MODULE-ENTRY-REF-CONDITIONAL>
[!ENDIF!][!//
[!IF "$Mcu_DistributePllClock_Xpath = 'true'"!]
              <BSW-MODULE-ENTRY-REF-CONDITIONAL>
                <BSW-MODULE-ENTRY-REF DEST="BSW-MODULE-ENTRY">/AUTOSAR_Mcu/BswModuleEntrys/Mcu_DistributePllClock</BSW-MODULE-ENTRY-REF>
              </BSW-MODULE-ENTRY-REF-CONDITIONAL>
[!ENDIF!][!//
              <BSW-MODULE-ENTRY-REF-CONDITIONAL>
                <BSW-MODULE-ENTRY-REF DEST="BSW-MODULE-ENTRY">/AUTOSAR_Mcu/BswModuleEntrys/Mcu_GetPllStatus</BSW-MODULE-ENTRY-REF>
              </BSW-MODULE-ENTRY-REF-CONDITIONAL>
              <BSW-MODULE-ENTRY-REF-CONDITIONAL>
                <BSW-MODULE-ENTRY-REF DEST="BSW-MODULE-ENTRY">/AUTOSAR_Mcu/BswModuleEntrys/Mcu_GetResetReason</BSW-MODULE-ENTRY-REF>
              </BSW-MODULE-ENTRY-REF-CONDITIONAL>
              <BSW-MODULE-ENTRY-REF-CONDITIONAL>
                <BSW-MODULE-ENTRY-REF DEST="BSW-MODULE-ENTRY">/AUTOSAR_Mcu/BswModuleEntrys/Mcu_GetResetRawValue</BSW-MODULE-ENTRY-REF>
              </BSW-MODULE-ENTRY-REF-CONDITIONAL>
[!IF "$Mcu_PerformReset_Xpath = 'true'"!]
              <BSW-MODULE-ENTRY-REF-CONDITIONAL>
                <BSW-MODULE-ENTRY-REF DEST="BSW-MODULE-ENTRY">/AUTOSAR_Mcu/BswModuleEntrys/Mcu_PerformReset</BSW-MODULE-ENTRY-REF>
              </BSW-MODULE-ENTRY-REF-CONDITIONAL>
[!ENDIF!][!//
              <BSW-MODULE-ENTRY-REF-CONDITIONAL>
                <BSW-MODULE-ENTRY-REF DEST="BSW-MODULE-ENTRY">/AUTOSAR_Mcu/BswModuleEntrys/Mcu_SetMode</BSW-MODULE-ENTRY-REF>
              </BSW-MODULE-ENTRY-REF-CONDITIONAL>
[!IF "$Mcu_VersionInfo_Xpath = 'true'"!]
              <BSW-MODULE-ENTRY-REF-CONDITIONAL>
                <BSW-MODULE-ENTRY-REF DEST="BSW-MODULE-ENTRY">/AUTOSAR_Mcu/BswModuleEntrys/Mcu_GetVersionInfo</BSW-MODULE-ENTRY-REF>
              </BSW-MODULE-ENTRY-REF-CONDITIONAL>
[!ENDIF!][!//
[!IF "$Mcu_GetRamStateApi_Xpath = 'true'"!]
              <BSW-MODULE-ENTRY-REF-CONDITIONAL>
                <BSW-MODULE-ENTRY-REF DEST="BSW-MODULE-ENTRY">/AUTOSAR_Mcu/BswModuleEntrys/Mcu_GetRamState</BSW-MODULE-ENTRY-REF>
              </BSW-MODULE-ENTRY-REF-CONDITIONAL>
[!ENDIF!][!//
[!IF "$Mcu_ClockFailureNotification_Xpath = 'true'"!]
              <BSW-MODULE-ENTRY-REF-CONDITIONAL>
                <BSW-MODULE-ENTRY-REF DEST="BSW-MODULE-ENTRY">/AUTOSAR_Mcu/BswModuleEntrys/Mcu_ClockFailureNotification</BSW-MODULE-ENTRY-REF>
              </BSW-MODULE-ENTRY-REF-CONDITIONAL>
[!ENDIF!][!//
[!IF "$Mcu_ClearColdReset_Xpath = 'true'"!]
              <BSW-MODULE-ENTRY-REF-CONDITIONAL>
                <BSW-MODULE-ENTRY-REF DEST="BSW-MODULE-ENTRY">/AUTOSAR_Mcu/BswModuleEntrys/Mcu_ClearColdResetStatus</BSW-MODULE-ENTRY-REF>
              </BSW-MODULE-ENTRY-REF-CONDITIONAL>
[!ENDIF!][!//
[!IF "$Mcu_DeInitApi_Xpath = 'true'"!]
              <BSW-MODULE-ENTRY-REF-CONDITIONAL>
                <BSW-MODULE-ENTRY-REF DEST="BSW-MODULE-ENTRY">/AUTOSAR_Mcu/BswModuleEntrys/Mcu_DeInit</BSW-MODULE-ENTRY-REF>
              </BSW-MODULE-ENTRY-REF-CONDITIONAL>
[!ENDIF!][!//
[!IF "$Mcu_LowPowerModeApis_Xpath = 'true'"!]
              <BSW-MODULE-ENTRY-REF-CONDITIONAL>
                <BSW-MODULE-ENTRY-REF DEST="BSW-MODULE-ENTRY">/AUTOSAR_Mcu/BswModuleEntrys/Mcu_GetCpuIdleModeInitiator</BSW-MODULE-ENTRY-REF>
              </BSW-MODULE-ENTRY-REF-CONDITIONAL>
              <BSW-MODULE-ENTRY-REF-CONDITIONAL>
                <BSW-MODULE-ENTRY-REF DEST="BSW-MODULE-ENTRY">/AUTOSAR_Mcu/BswModuleEntrys/Mcu_GetCpuState</BSW-MODULE-ENTRY-REF>
              </BSW-MODULE-ENTRY-REF-CONDITIONAL>
              <BSW-MODULE-ENTRY-REF-CONDITIONAL>
                <BSW-MODULE-ENTRY-REF DEST="BSW-MODULE-ENTRY">/AUTOSAR_Mcu/BswModuleEntrys/Mcu_GetWakeupCause</BSW-MODULE-ENTRY-REF>
              </BSW-MODULE-ENTRY-REF-CONDITIONAL>
              <BSW-MODULE-ENTRY-REF-CONDITIONAL>
                <BSW-MODULE-ENTRY-REF DEST="BSW-MODULE-ENTRY">/AUTOSAR_Mcu/BswModuleEntrys/Mcu_ClearWakeupCause</BSW-MODULE-ENTRY-REF>
              </BSW-MODULE-ENTRY-REF-CONDITIONAL>
[!ENDIF!][!//
[!IF "$Mcu_TrapApi_Xpath = 'true'"!]
              <BSW-MODULE-ENTRY-REF-CONDITIONAL>
                <BSW-MODULE-ENTRY-REF DEST="BSW-MODULE-ENTRY">/AUTOSAR_Mcu/BswModuleEntrys/Mcu_GetTrapCause</BSW-MODULE-ENTRY-REF>
              </BSW-MODULE-ENTRY-REF-CONDITIONAL>
              <BSW-MODULE-ENTRY-REF-CONDITIONAL>
                <BSW-MODULE-ENTRY-REF DEST="BSW-MODULE-ENTRY">/AUTOSAR_Mcu/BswModuleEntrys/Mcu_SetTrapRequest</BSW-MODULE-ENTRY-REF>
              </BSW-MODULE-ENTRY-REF-CONDITIONAL>
              <BSW-MODULE-ENTRY-REF-CONDITIONAL>
                <BSW-MODULE-ENTRY-REF DEST="BSW-MODULE-ENTRY">/AUTOSAR_Mcu/BswModuleEntrys/Mcu_ClearTrapRequest</BSW-MODULE-ENTRY-REF>
              </BSW-MODULE-ENTRY-REF-CONDITIONAL>
[!ENDIF!][!//
[!IF "$Mcu_CcuconApi_Xpath = 'true'"!]
              <BSW-MODULE-ENTRY-REF-CONDITIONAL>
                <BSW-MODULE-ENTRY-REF DEST="BSW-MODULE-ENTRY">/AUTOSAR_Mcu/BswModuleEntrys/Mcu_UpdateCpuCcuconReg</BSW-MODULE-ENTRY-REF>
              </BSW-MODULE-ENTRY-REF-CONDITIONAL>
[!ENDIF!][!//
[!IF "$Mcu_InitCheck_Xpath = 'true'"!]
              <BSW-MODULE-ENTRY-REF-CONDITIONAL>
                <BSW-MODULE-ENTRY-REF DEST="BSW-MODULE-ENTRY">/AUTOSAR_Mcu/BswModuleEntrys/Mcu_InitCheck</BSW-MODULE-ENTRY-REF>
              </BSW-MODULE-ENTRY-REF-CONDITIONAL>
[!ENDIF!][!//
[!IF "$Mcu_GtmIpAvailable_Xpath = 'true'"!]
              <BSW-MODULE-ENTRY-REF-CONDITIONAL>
                <BSW-MODULE-ENTRY-REF DEST="BSW-MODULE-ENTRY">/AUTOSAR_Mcu/BswModuleEntrys/Mcu_17_Gtm_TomChannelInit</BSW-MODULE-ENTRY-REF>
              </BSW-MODULE-ENTRY-REF-CONDITIONAL>
              <BSW-MODULE-ENTRY-REF-CONDITIONAL>
                <BSW-MODULE-ENTRY-REF DEST="BSW-MODULE-ENTRY">/AUTOSAR_Mcu/BswModuleEntrys/Mcu_17_Gtm_TomChannelShadowTransfer</BSW-MODULE-ENTRY-REF>
              </BSW-MODULE-ENTRY-REF-CONDITIONAL>
              <BSW-MODULE-ENTRY-REF-CONDITIONAL>
                <BSW-MODULE-ENTRY-REF DEST="BSW-MODULE-ENTRY">/AUTOSAR_Mcu/BswModuleEntrys/Mcu_17_Gtm_TomChannelDeInit</BSW-MODULE-ENTRY-REF>
              </BSW-MODULE-ENTRY-REF-CONDITIONAL>
              <BSW-MODULE-ENTRY-REF-CONDITIONAL>
                <BSW-MODULE-ENTRY-REF DEST="BSW-MODULE-ENTRY">/AUTOSAR_Mcu/BswModuleEntrys/Mcu_17_Gtm_AtomChannelInit</BSW-MODULE-ENTRY-REF>
              </BSW-MODULE-ENTRY-REF-CONDITIONAL>
              <BSW-MODULE-ENTRY-REF-CONDITIONAL>
                <BSW-MODULE-ENTRY-REF DEST="BSW-MODULE-ENTRY">/AUTOSAR_Mcu/BswModuleEntrys/Mcu_17_Gtm_AtomChannelShadowTransfer</BSW-MODULE-ENTRY-REF>
              </BSW-MODULE-ENTRY-REF-CONDITIONAL>
              <BSW-MODULE-ENTRY-REF-CONDITIONAL>
                <BSW-MODULE-ENTRY-REF DEST="BSW-MODULE-ENTRY">/AUTOSAR_Mcu/BswModuleEntrys/Mcu_17_Gtm_AtomChannelDeInit</BSW-MODULE-ENTRY-REF>
              </BSW-MODULE-ENTRY-REF-CONDITIONAL>
              <BSW-MODULE-ENTRY-REF-CONDITIONAL>
                <BSW-MODULE-ENTRY-REF DEST="BSW-MODULE-ENTRY">/AUTOSAR_Mcu/BswModuleEntrys/Mcu_17_Gtm_TimChannelInit</BSW-MODULE-ENTRY-REF>
              </BSW-MODULE-ENTRY-REF-CONDITIONAL>
              <BSW-MODULE-ENTRY-REF-CONDITIONAL>
                <BSW-MODULE-ENTRY-REF DEST="BSW-MODULE-ENTRY">/AUTOSAR_Mcu/BswModuleEntrys/Mcu_17_Gtm_TimChannelDeInit</BSW-MODULE-ENTRY-REF>
              </BSW-MODULE-ENTRY-REF-CONDITIONAL>
              <BSW-MODULE-ENTRY-REF-CONDITIONAL>
                <BSW-MODULE-ENTRY-REF DEST="BSW-MODULE-ENTRY">/AUTOSAR_Mcu/BswModuleEntrys/Mcu_17_Gtm_TomChannelEnable</BSW-MODULE-ENTRY-REF>
              </BSW-MODULE-ENTRY-REF-CONDITIONAL>
              <BSW-MODULE-ENTRY-REF-CONDITIONAL>
                <BSW-MODULE-ENTRY-REF DEST="BSW-MODULE-ENTRY">/AUTOSAR_Mcu/BswModuleEntrys/Mcu_17_Gtm_TomChannelDisable</BSW-MODULE-ENTRY-REF>
              </BSW-MODULE-ENTRY-REF-CONDITIONAL>
              <BSW-MODULE-ENTRY-REF-CONDITIONAL>
                <BSW-MODULE-ENTRY-REF DEST="BSW-MODULE-ENTRY">/AUTOSAR_Mcu/BswModuleEntrys/Mcu_17_Gtm_IsTomChannelEnabled</BSW-MODULE-ENTRY-REF>
              </BSW-MODULE-ENTRY-REF-CONDITIONAL>
              <BSW-MODULE-ENTRY-REF-CONDITIONAL>
                <BSW-MODULE-ENTRY-REF DEST="BSW-MODULE-ENTRY">/AUTOSAR_Mcu/BswModuleEntrys/Mcu_17_Gtm_AtomChannelEnable</BSW-MODULE-ENTRY-REF>
              </BSW-MODULE-ENTRY-REF-CONDITIONAL>
              <BSW-MODULE-ENTRY-REF-CONDITIONAL>
                <BSW-MODULE-ENTRY-REF DEST="BSW-MODULE-ENTRY">/AUTOSAR_Mcu/BswModuleEntrys/Mcu_17_Gtm_AtomChannelDisable</BSW-MODULE-ENTRY-REF>
              </BSW-MODULE-ENTRY-REF-CONDITIONAL>
              <BSW-MODULE-ENTRY-REF-CONDITIONAL>
                <BSW-MODULE-ENTRY-REF DEST="BSW-MODULE-ENTRY">/AUTOSAR_Mcu/BswModuleEntrys/Mcu_17_Gtm_IsAtomChannelEnabled</BSW-MODULE-ENTRY-REF>
              </BSW-MODULE-ENTRY-REF-CONDITIONAL>
              <BSW-MODULE-ENTRY-REF-CONDITIONAL>
                <BSW-MODULE-ENTRY-REF DEST="BSW-MODULE-ENTRY">/AUTOSAR_Mcu/BswModuleEntrys/Mcu_17_Gtm_TimChannelEnable</BSW-MODULE-ENTRY-REF>
              </BSW-MODULE-ENTRY-REF-CONDITIONAL>
              <BSW-MODULE-ENTRY-REF-CONDITIONAL>
                <BSW-MODULE-ENTRY-REF DEST="BSW-MODULE-ENTRY">/AUTOSAR_Mcu/BswModuleEntrys/Mcu_17_Gtm_TimChannelDisable</BSW-MODULE-ENTRY-REF>
              </BSW-MODULE-ENTRY-REF-CONDITIONAL>
              <BSW-MODULE-ENTRY-REF-CONDITIONAL>
                <BSW-MODULE-ENTRY-REF DEST="BSW-MODULE-ENTRY">/AUTOSAR_Mcu/BswModuleEntrys/Mcu_17_Gtm_IsTimChannelEnabled</BSW-MODULE-ENTRY-REF>
              </BSW-MODULE-ENTRY-REF-CONDITIONAL>
              <BSW-MODULE-ENTRY-REF-CONDITIONAL>
                <BSW-MODULE-ENTRY-REF DEST="BSW-MODULE-ENTRY">/AUTOSAR_Mcu/BswModuleEntrys/Mcu_17_Gtm_ConnectPortPinToTim</BSW-MODULE-ENTRY-REF>
              </BSW-MODULE-ENTRY-REF-CONDITIONAL>
              <BSW-MODULE-ENTRY-REF-CONDITIONAL>
                <BSW-MODULE-ENTRY-REF DEST="BSW-MODULE-ENTRY">/AUTOSAR_Mcu/BswModuleEntrys/Mcu_17_Gtm_ConnectTimerOutToPortPin</BSW-MODULE-ENTRY-REF>
              </BSW-MODULE-ENTRY-REF-CONDITIONAL>
              <BSW-MODULE-ENTRY-REF-CONDITIONAL>
                <BSW-MODULE-ENTRY-REF DEST="BSW-MODULE-ENTRY">/AUTOSAR_Mcu/BswModuleEntrys/Mcu_17_Gtm_TomTriggerRequest</BSW-MODULE-ENTRY-REF>
              </BSW-MODULE-ENTRY-REF-CONDITIONAL>
              <BSW-MODULE-ENTRY-REF-CONDITIONAL>
                <BSW-MODULE-ENTRY-REF DEST="BSW-MODULE-ENTRY">/AUTOSAR_Mcu/BswModuleEntrys/Mcu_17_Gtm_TomChInitCheck</BSW-MODULE-ENTRY-REF>
              </BSW-MODULE-ENTRY-REF-CONDITIONAL>
              <BSW-MODULE-ENTRY-REF-CONDITIONAL>
                <BSW-MODULE-ENTRY-REF DEST="BSW-MODULE-ENTRY">/AUTOSAR_Mcu/BswModuleEntrys/Mcu_17_Gtm_TomChUpdateEnDis</BSW-MODULE-ENTRY-REF>
              </BSW-MODULE-ENTRY-REF-CONDITIONAL>
              <BSW-MODULE-ENTRY-REF-CONDITIONAL>
                <BSW-MODULE-ENTRY-REF DEST="BSW-MODULE-ENTRY">/AUTOSAR_Mcu/BswModuleEntrys/Mcu_17_Gtm_TomChOutEnCtrlUpdate</BSW-MODULE-ENTRY-REF>
              </BSW-MODULE-ENTRY-REF-CONDITIONAL>
              <BSW-MODULE-ENTRY-REF-CONDITIONAL>
                <BSW-MODULE-ENTRY-REF DEST="BSW-MODULE-ENTRY">/AUTOSAR_Mcu/BswModuleEntrys/Mcu_17_Gtm_TomChOutEnStatUpdate</BSW-MODULE-ENTRY-REF>
              </BSW-MODULE-ENTRY-REF-CONDITIONAL>
              <BSW-MODULE-ENTRY-REF-CONDITIONAL>
                <BSW-MODULE-ENTRY-REF DEST="BSW-MODULE-ENTRY">/AUTOSAR_Mcu/BswModuleEntrys/Mcu_17_Gtm_TomChEndisCtrlUpdate</BSW-MODULE-ENTRY-REF>
              </BSW-MODULE-ENTRY-REF-CONDITIONAL>
              <BSW-MODULE-ENTRY-REF-CONDITIONAL>
                <BSW-MODULE-ENTRY-REF DEST="BSW-MODULE-ENTRY">/AUTOSAR_Mcu/BswModuleEntrys/Mcu_17_Gtm_TomChEndisStatUpdate</BSW-MODULE-ENTRY-REF>
              </BSW-MODULE-ENTRY-REF-CONDITIONAL>
              <BSW-MODULE-ENTRY-REF-CONDITIONAL>
                <BSW-MODULE-ENTRY-REF DEST="BSW-MODULE-ENTRY">/AUTOSAR_Mcu/BswModuleEntrys/Mcu_17_Gtm_AtomTriggerRequest</BSW-MODULE-ENTRY-REF>
              </BSW-MODULE-ENTRY-REF-CONDITIONAL>
              <BSW-MODULE-ENTRY-REF-CONDITIONAL>
                <BSW-MODULE-ENTRY-REF DEST="BSW-MODULE-ENTRY">/AUTOSAR_Mcu/BswModuleEntrys/Mcu_17_Gtm_AtomChInitCheck</BSW-MODULE-ENTRY-REF>
              </BSW-MODULE-ENTRY-REF-CONDITIONAL>
              <BSW-MODULE-ENTRY-REF-CONDITIONAL>
                <BSW-MODULE-ENTRY-REF DEST="BSW-MODULE-ENTRY">/AUTOSAR_Mcu/BswModuleEntrys/Mcu_17_Gtm_AtomChUpdateEnDis</BSW-MODULE-ENTRY-REF>
              </BSW-MODULE-ENTRY-REF-CONDITIONAL>
              <BSW-MODULE-ENTRY-REF-CONDITIONAL>
                <BSW-MODULE-ENTRY-REF DEST="BSW-MODULE-ENTRY">/AUTOSAR_Mcu/BswModuleEntrys/Mcu_17_Gtm_AtomChOutEnCtrlUpdate</BSW-MODULE-ENTRY-REF>
              </BSW-MODULE-ENTRY-REF-CONDITIONAL>
              <BSW-MODULE-ENTRY-REF-CONDITIONAL>
                <BSW-MODULE-ENTRY-REF DEST="BSW-MODULE-ENTRY">/AUTOSAR_Mcu/BswModuleEntrys/Mcu_17_Gtm_AtomChOutEnStatUpdate</BSW-MODULE-ENTRY-REF>
              </BSW-MODULE-ENTRY-REF-CONDITIONAL>
              <BSW-MODULE-ENTRY-REF-CONDITIONAL>
                <BSW-MODULE-ENTRY-REF DEST="BSW-MODULE-ENTRY">/AUTOSAR_Mcu/BswModuleEntrys/Mcu_17_Gtm_AtomChEndisCtrlUpdate</BSW-MODULE-ENTRY-REF>
              </BSW-MODULE-ENTRY-REF-CONDITIONAL>
              <BSW-MODULE-ENTRY-REF-CONDITIONAL>
                <BSW-MODULE-ENTRY-REF DEST="BSW-MODULE-ENTRY">/AUTOSAR_Mcu/BswModuleEntrys/Mcu_17_Gtm_AtomChEndisStatUpdate</BSW-MODULE-ENTRY-REF>
              </BSW-MODULE-ENTRY-REF-CONDITIONAL>
              <BSW-MODULE-ENTRY-REF-CONDITIONAL>
                <BSW-MODULE-ENTRY-REF DEST="BSW-MODULE-ENTRY">/AUTOSAR_Mcu/BswModuleEntrys/Mcu_17_Gtm_TomChannelIsr</BSW-MODULE-ENTRY-REF>
              </BSW-MODULE-ENTRY-REF-CONDITIONAL>
              <BSW-MODULE-ENTRY-REF-CONDITIONAL>
                <BSW-MODULE-ENTRY-REF DEST="BSW-MODULE-ENTRY">/AUTOSAR_Mcu/BswModuleEntrys/Mcu_17_Gtm_AtomChannelIsr</BSW-MODULE-ENTRY-REF>
              </BSW-MODULE-ENTRY-REF-CONDITIONAL>
              <BSW-MODULE-ENTRY-REF-CONDITIONAL>
                <BSW-MODULE-ENTRY-REF DEST="BSW-MODULE-ENTRY">/AUTOSAR_Mcu/BswModuleEntrys/Mcu_17_Gtm_TimChannelIsr</BSW-MODULE-ENTRY-REF>
              </BSW-MODULE-ENTRY-REF-CONDITIONAL>
              <BSW-MODULE-ENTRY-REF-CONDITIONAL>
                <BSW-MODULE-ENTRY-REF DEST="BSW-MODULE-ENTRY">/AUTOSAR_Mcu/BswModuleEntrys/Mcu_17_Gtm_TimChInitCheck</BSW-MODULE-ENTRY-REF>
              </BSW-MODULE-ENTRY-REF-CONDITIONAL>
[!ENDIF!][!//
              <BSW-MODULE-ENTRY-REF-CONDITIONAL>
                <BSW-MODULE-ENTRY-REF DEST="BSW-MODULE-ENTRY">/AUTOSAR_Mcu/BswModuleEntrys/Mcu_17_Ccu6_TimerInit</BSW-MODULE-ENTRY-REF>
              </BSW-MODULE-ENTRY-REF-CONDITIONAL>
              <BSW-MODULE-ENTRY-REF-CONDITIONAL>
                <BSW-MODULE-ENTRY-REF DEST="BSW-MODULE-ENTRY">/AUTOSAR_Mcu/BswModuleEntrys/Mcu_17_Ccu6_TimerDeInit</BSW-MODULE-ENTRY-REF>
              </BSW-MODULE-ENTRY-REF-CONDITIONAL>
              <BSW-MODULE-ENTRY-REF-CONDITIONAL>
                <BSW-MODULE-ENTRY-REF DEST="BSW-MODULE-ENTRY">/AUTOSAR_Mcu/BswModuleEntrys/Mcu_17_Ccu6_TimerStart</BSW-MODULE-ENTRY-REF>
              </BSW-MODULE-ENTRY-REF-CONDITIONAL>
              <BSW-MODULE-ENTRY-REF-CONDITIONAL>
                <BSW-MODULE-ENTRY-REF DEST="BSW-MODULE-ENTRY">/AUTOSAR_Mcu/BswModuleEntrys/Mcu_17_Ccu6_TimerStop</BSW-MODULE-ENTRY-REF>
              </BSW-MODULE-ENTRY-REF-CONDITIONAL>
              <BSW-MODULE-ENTRY-REF-CONDITIONAL>
                <BSW-MODULE-ENTRY-REF DEST="BSW-MODULE-ENTRY">/AUTOSAR_Mcu/BswModuleEntrys/Mcu_17_Ccu6_TimerShadowTransfer</BSW-MODULE-ENTRY-REF>
              </BSW-MODULE-ENTRY-REF-CONDITIONAL>
              <BSW-MODULE-ENTRY-REF-CONDITIONAL>
                <BSW-MODULE-ENTRY-REF DEST="BSW-MODULE-ENTRY">/AUTOSAR_Mcu/BswModuleEntrys/Mcu_17_Ccu6_TimerIntEnDis</BSW-MODULE-ENTRY-REF>
              </BSW-MODULE-ENTRY-REF-CONDITIONAL>
              <BSW-MODULE-ENTRY-REF-CONDITIONAL>
                <BSW-MODULE-ENTRY-REF DEST="BSW-MODULE-ENTRY">/AUTOSAR_Mcu/BswModuleEntrys/Mcu_17_Ccu6_ChannelIsr</BSW-MODULE-ENTRY-REF>
              </BSW-MODULE-ENTRY-REF-CONDITIONAL>
              <BSW-MODULE-ENTRY-REF-CONDITIONAL>
                <BSW-MODULE-ENTRY-REF DEST="BSW-MODULE-ENTRY">/AUTOSAR_Mcu/BswModuleEntrys/Mcu_17_Gpt12_TimerInit</BSW-MODULE-ENTRY-REF>
              </BSW-MODULE-ENTRY-REF-CONDITIONAL>
              <BSW-MODULE-ENTRY-REF-CONDITIONAL>
                <BSW-MODULE-ENTRY-REF DEST="BSW-MODULE-ENTRY">/AUTOSAR_Mcu/BswModuleEntrys/Mcu_17_Gpt12_TimerDeInit</BSW-MODULE-ENTRY-REF>
              </BSW-MODULE-ENTRY-REF-CONDITIONAL>
              <BSW-MODULE-ENTRY-REF-CONDITIONAL>
                <BSW-MODULE-ENTRY-REF DEST="BSW-MODULE-ENTRY">/AUTOSAR_Mcu/BswModuleEntrys/Mcu_17_Gpt12_TimerStart</BSW-MODULE-ENTRY-REF>
              </BSW-MODULE-ENTRY-REF-CONDITIONAL>
              <BSW-MODULE-ENTRY-REF-CONDITIONAL>
                <BSW-MODULE-ENTRY-REF DEST="BSW-MODULE-ENTRY">/AUTOSAR_Mcu/BswModuleEntrys/Mcu_17_Gpt12_TimerStop</BSW-MODULE-ENTRY-REF>
              </BSW-MODULE-ENTRY-REF-CONDITIONAL>
              <BSW-MODULE-ENTRY-REF-CONDITIONAL>
                <BSW-MODULE-ENTRY-REF DEST="BSW-MODULE-ENTRY">/AUTOSAR_Mcu/BswModuleEntrys/Mcu_17_Gpt12_TimerClockInit</BSW-MODULE-ENTRY-REF>
              </BSW-MODULE-ENTRY-REF-CONDITIONAL>
              <BSW-MODULE-ENTRY-REF-CONDITIONAL>
                <BSW-MODULE-ENTRY-REF DEST="BSW-MODULE-ENTRY">/AUTOSAR_Mcu/BswModuleEntrys/Mcu_17_Gpt12_ChannelIsr</BSW-MODULE-ENTRY-REF>
              </BSW-MODULE-ENTRY-REF-CONDITIONAL>
              <BSW-MODULE-ENTRY-REF-CONDITIONAL>
                <BSW-MODULE-ENTRY-REF DEST="BSW-MODULE-ENTRY">/AUTOSAR_Mcu/BswModuleEntrys/Mcu_17_Stm_SetupComparator</BSW-MODULE-ENTRY-REF>
              </BSW-MODULE-ENTRY-REF-CONDITIONAL>
              <BSW-MODULE-ENTRY-REF-CONDITIONAL>
                <BSW-MODULE-ENTRY-REF DEST="BSW-MODULE-ENTRY">/AUTOSAR_Mcu/BswModuleEntrys/Mcu_17_Stm_CheckComparator</BSW-MODULE-ENTRY-REF>
              </BSW-MODULE-ENTRY-REF-CONDITIONAL>
              <BSW-MODULE-ENTRY-REF-CONDITIONAL>
                <BSW-MODULE-ENTRY-REF DEST="BSW-MODULE-ENTRY">/AUTOSAR_Mcu/BswModuleEntrys/Mcu_17_Stm_ComparatorIntDisable</BSW-MODULE-ENTRY-REF>
              </BSW-MODULE-ENTRY-REF-CONDITIONAL>
              <BSW-MODULE-ENTRY-REF-CONDITIONAL>
                <BSW-MODULE-ENTRY-REF DEST="BSW-MODULE-ENTRY">/AUTOSAR_Mcu/BswModuleEntrys/Mcu_17_Stm_CompareMatchIsr</BSW-MODULE-ENTRY-REF>
              </BSW-MODULE-ENTRY-REF-CONDITIONAL>
              <BSW-MODULE-ENTRY-REF-CONDITIONAL>
                <BSW-MODULE-ENTRY-REF DEST="BSW-MODULE-ENTRY">/AUTOSAR_Mcu/BswModuleEntrys/Mcu_17_Eru_GatingIsr</BSW-MODULE-ENTRY-REF>
              </BSW-MODULE-ENTRY-REF-CONDITIONAL>
              <BSW-MODULE-ENTRY-REF-CONDITIONAL>
                <BSW-MODULE-ENTRY-REF DEST="BSW-MODULE-ENTRY">/AUTOSAR_Mcu/BswModuleEntrys/Mcu_17_Ccu6_TimerInitCheck</BSW-MODULE-ENTRY-REF>
              </BSW-MODULE-ENTRY-REF-CONDITIONAL>
              <BSW-MODULE-ENTRY-REF-CONDITIONAL>
                <BSW-MODULE-ENTRY-REF DEST="BSW-MODULE-ENTRY">/AUTOSAR_Mcu/BswModuleEntrys/Mcu_17_Gpt12_TimerInitCheck</BSW-MODULE-ENTRY-REF>
              </BSW-MODULE-ENTRY-REF-CONDITIONAL>
            </PROVIDED-ENTRYS>
            <BSW-MODULE-DEPENDENCYS>
              <BSW-MODULE-DEPENDENCY>
                <SHORT-NAME>McalLibDependency</SHORT-NAME>
                <TARGET-MODULE-ID>255</TARGET-MODULE-ID>
                <REQUIRED-ENTRYS>
                  <BSW-MODULE-ENTRY-REF-CONDITIONAL>
                    <BSW-MODULE-ENTRY-REF DEST="BSW-MODULE-ENTRY">/AURIX2G_McalLib/BswModuleEntrys/Mcal_WritePeripEndInitProtReg</BSW-MODULE-ENTRY-REF>
                  </BSW-MODULE-ENTRY-REF-CONDITIONAL>
                  <BSW-MODULE-ENTRY-REF-CONDITIONAL>
                    <BSW-MODULE-ENTRY-REF DEST="BSW-MODULE-ENTRY">/AURIX2G_McalLib/BswModuleEntrys/Mcal_WriteSafetyEndInitProtRegMask</BSW-MODULE-ENTRY-REF>
                  </BSW-MODULE-ENTRY-REF-CONDITIONAL>
                  <BSW-MODULE-ENTRY-REF-CONDITIONAL>
                    <BSW-MODULE-ENTRY-REF DEST="BSW-MODULE-ENTRY">/AURIX2G_McalLib/BswModuleEntrys/Mcal_GetCpuIndex</BSW-MODULE-ENTRY-REF>
                  </BSW-MODULE-ENTRY-REF-CONDITIONAL>
                  <BSW-MODULE-ENTRY-REF-CONDITIONAL>
                    <BSW-MODULE-ENTRY-REF DEST="BSW-MODULE-ENTRY">/AURIX2G_McalLib/BswModuleEntrys/Mcal_GetBitAtomic</BSW-MODULE-ENTRY-REF>
                  </BSW-MODULE-ENTRY-REF-CONDITIONAL>
                  <BSW-MODULE-ENTRY-REF-CONDITIONAL>
                    <BSW-MODULE-ENTRY-REF DEST="BSW-MODULE-ENTRY">/AURIX2G_McalLib/BswModuleEntrys/Mcal_SetBitAtomic</BSW-MODULE-ENTRY-REF>
                  </BSW-MODULE-ENTRY-REF-CONDITIONAL>
                  <BSW-MODULE-ENTRY-REF-CONDITIONAL>
                    <BSW-MODULE-ENTRY-REF DEST="BSW-MODULE-ENTRY">/AURIX2G_McalLib/BswModuleEntrys/Mcal_WriteCpuEndInitProtReg</BSW-MODULE-ENTRY-REF>
                  </BSW-MODULE-ENTRY-REF-CONDITIONAL>
                  <BSW-MODULE-ENTRY-REF-CONDITIONAL>
                    <BSW-MODULE-ENTRY-REF DEST="BSW-MODULE-ENTRY">/AURIX2G_McalLib/BswModuleEntrys/Mcal_DelayGetTick</BSW-MODULE-ENTRY-REF>
                  </BSW-MODULE-ENTRY-REF-CONDITIONAL>
                  <BSW-MODULE-ENTRY-REF-CONDITIONAL>
                    <BSW-MODULE-ENTRY-REF DEST="BSW-MODULE-ENTRY">/AURIX2G_McalLib/BswModuleEntrys/Mcal_DelayResetTickCalibration</BSW-MODULE-ENTRY-REF>
                  </BSW-MODULE-ENTRY-REF-CONDITIONAL>
                  <BSW-MODULE-ENTRY-REF-CONDITIONAL>
                    <BSW-MODULE-ENTRY-REF DEST="BSW-MODULE-ENTRY">/AURIX2G_McalLib/BswModuleEntrys/Mcal_GetSpinlock</BSW-MODULE-ENTRY-REF>
                  </BSW-MODULE-ENTRY-REF-CONDITIONAL>
                  <BSW-MODULE-ENTRY-REF-CONDITIONAL>
                    <BSW-MODULE-ENTRY-REF DEST="BSW-MODULE-ENTRY">/AURIX2G_McalLib/BswModuleEntrys/Mcal_ReleaseSpinlock</BSW-MODULE-ENTRY-REF>
                  </BSW-MODULE-ENTRY-REF-CONDITIONAL>
                </REQUIRED-ENTRYS>
              </BSW-MODULE-DEPENDENCY>
[!IF "$McuDetEnable_Xpath = 'true'"!][!//
              <BSW-MODULE-DEPENDENCY>
                <SHORT-NAME>DetDependency</SHORT-NAME>
                <TARGET-MODULE-ID>15</TARGET-MODULE-ID>
                <REQUIRED-ENTRYS>
                  <BSW-MODULE-ENTRY-REF-CONDITIONAL>
                    <BSW-MODULE-ENTRY-REF DEST="BSW-MODULE-ENTRY">/AUTOSAR_Det/BswModuleEntrys/Det_ReportError</BSW-MODULE-ENTRY-REF>
                  </BSW-MODULE-ENTRY-REF-CONDITIONAL>
                </REQUIRED-ENTRYS>
              </BSW-MODULE-DEPENDENCY>
[!ENDIF!][!//
              <BSW-MODULE-DEPENDENCY>
                <SHORT-NAME>DemDependency</SHORT-NAME>
                <TARGET-MODULE-ID>54</TARGET-MODULE-ID>
                <REQUIRED-ENTRYS>
                  <BSW-MODULE-ENTRY-REF-CONDITIONAL>
                    <BSW-MODULE-ENTRY-REF DEST="BSW-MODULE-ENTRY">/AUTOSAR_Dem/BswModuleEntrys/Dem_ReportErrorStatus</BSW-MODULE-ENTRY-REF>
                  </BSW-MODULE-ENTRY-REF-CONDITIONAL>
                </REQUIRED-ENTRYS>
              </BSW-MODULE-DEPENDENCY>
[!IF "$Mcu_GptUserAvailabe_Xpath = 'true'"!][!//
              <BSW-MODULE-DEPENDENCY>
                <SHORT-NAME>GptDependency</SHORT-NAME>
                <TARGET-MODULE-ID>100</TARGET-MODULE-ID>
                <REQUIRED-ENTRYS>
                  <BSW-MODULE-ENTRY-REF-CONDITIONAL>
                    <BSW-MODULE-ENTRY-REF DEST="BSW-MODULE-ENTRY">/AUTOSAR_Gpt/BswModuleEntrys/Gpt_Isr</BSW-MODULE-ENTRY-REF>
                  </BSW-MODULE-ENTRY-REF-CONDITIONAL>
                </REQUIRED-ENTRYS>
              </BSW-MODULE-DEPENDENCY>
[!ENDIF!][!//
[!IF "$Mcu_WdgUserAvailabe_Xpath = 'true'"!][!//
              <BSW-MODULE-DEPENDENCY>
                <SHORT-NAME>WdgDependency</SHORT-NAME>
                <TARGET-MODULE-ID>102</TARGET-MODULE-ID>
                <REQUIRED-ENTRYS>
                  <BSW-MODULE-ENTRY-REF-CONDITIONAL>
                    <BSW-MODULE-ENTRY-REF DEST="BSW-MODULE-ENTRY">/AUTOSAR_Wdg_17_Scu/BswModuleEntrys/Wdg_Isr</BSW-MODULE-ENTRY-REF>
                  </BSW-MODULE-ENTRY-REF-CONDITIONAL>
                </REQUIRED-ENTRYS>
              </BSW-MODULE-DEPENDENCY>
[!ENDIF!][!//
[!IF "$Mcu_PwmUserAvailabe_Xpath = 'true'"!][!//
              <BSW-MODULE-DEPENDENCY>
                <SHORT-NAME>PwmDependency</SHORT-NAME>
                <TARGET-MODULE-ID>121</TARGET-MODULE-ID>
                <REQUIRED-ENTRYS>
                  <BSW-MODULE-ENTRY-REF-CONDITIONAL>
                    <BSW-MODULE-ENTRY-REF DEST="BSW-MODULE-ENTRY">/AUTOSAR_Pwm_17_GtmCcu6/BswModuleEntrys/Pwm_Isr</BSW-MODULE-ENTRY-REF>
                  </BSW-MODULE-ENTRY-REF-CONDITIONAL>
                </REQUIRED-ENTRYS>
              </BSW-MODULE-DEPENDENCY>
[!ENDIF!][!//
[!IF "$Mcu_IcuUserAvailabe_Xpath = 'true'"!][!//
              <BSW-MODULE-DEPENDENCY>
                <SHORT-NAME>IcuDependency</SHORT-NAME>
                <TARGET-MODULE-ID>122</TARGET-MODULE-ID>
                <REQUIRED-ENTRYS>
                  <BSW-MODULE-ENTRY-REF-CONDITIONAL>
                    <BSW-MODULE-ENTRY-REF DEST="BSW-MODULE-ENTRY">/AUTOSAR_Icu_17_TimerIp/BswModuleEntrys/Icu_Timer_Isr</BSW-MODULE-ENTRY-REF>
                  </BSW-MODULE-ENTRY-REF-CONDITIONAL>
                </REQUIRED-ENTRYS>
              </BSW-MODULE-DEPENDENCY>
[!ENDIF!][!//
[!IF "$McuSafetyEnable_Xpath = 'true'"!][!//
              <BSW-MODULE-DEPENDENCY>
                <SHORT-NAME>McalSafetyErrorDependency</SHORT-NAME>
                <TARGET-MODULE-ID>255</TARGET-MODULE-ID>
                <REQUIRED-ENTRYS>
                  <BSW-MODULE-ENTRY-REF-CONDITIONAL>
                    <BSW-MODULE-ENTRY-REF DEST="BSW-MODULE-ENTRY">/AUTOSAR_Stub/BswModuleEntrys/Mcal_ReportSafetyError</BSW-MODULE-ENTRY-REF>
                  </BSW-MODULE-ENTRY-REF-CONDITIONAL>
                </REQUIRED-ENTRYS>
              </BSW-MODULE-DEPENDENCY>
[!ENDIF!][!//
            </BSW-MODULE-DEPENDENCYS>
            <INTERNAL-BEHAVIORS>
              <BSW-INTERNAL-BEHAVIOR>
                <SHORT-NAME>McuBehavior</SHORT-NAME>
[!IF "$Mcu_GtmIpAvailable_Xpath = 'true'"!]
                <EXCLUSIVE-AREAS>
                  <EXCLUSIVE-AREA>
                    <SHORT-NAME>TomTgcReg</SHORT-NAME>
                    <INTRODUCTION>
                      <NOTE SI="User of MCU TOM shall ensure that the critical section protection provided by MCU for TOM is implemented to disable or enable interrupts" NOTE-TYPE="HINT"/>
                    </INTRODUCTION>
                  </EXCLUSIVE-AREA>
                  <EXCLUSIVE-AREA>
                    <SHORT-NAME>AtomAgcReg</SHORT-NAME>
                    <INTRODUCTION>
                      <NOTE SI="User of MCU ATOM shall ensure that the critical section protection provided by MCU for ATOM is implemented to disable or enable interrupts" NOTE-TYPE="HINT"/>
                    </INTRODUCTION>
                  </EXCLUSIVE-AREA>
                </EXCLUSIVE-AREAS>
[!ENDIF!][!//
                <ENTITYS>
                  <BSW-CALLED-ENTITY>
                    <SHORT-NAME>Mcu_Init</SHORT-NAME>
                    <REENTRANCY-LEVEL>NON-REENTRANT</REENTRANCY-LEVEL>
                    <IMPLEMENTED-ENTRY-REF DEST="BSW-MODULE-ENTRY">/AUTOSAR_Mcu/BswModuleEntrys/Mcu_Init</IMPLEMENTED-ENTRY-REF>
                  </BSW-CALLED-ENTITY>
[!IF "$Mcu_DeInitApi_Xpath = 'true'"!]
                  <BSW-CALLED-ENTITY>
                    <SHORT-NAME>Mcu_DeInit</SHORT-NAME>
                    <REENTRANCY-LEVEL>NON-REENTRANT</REENTRANCY-LEVEL>
                    <IMPLEMENTED-ENTRY-REF DEST="BSW-MODULE-ENTRY">/AUTOSAR_Mcu/BswModuleEntrys/Mcu_DeInit</IMPLEMENTED-ENTRY-REF>
                  </BSW-CALLED-ENTITY>
[!ENDIF!][!//
[!IF "$Mcu_VersionInfo_Xpath = 'true'"!]
                  <BSW-CALLED-ENTITY>
                    <SHORT-NAME>Mcu_GetVersionInfo</SHORT-NAME>
                    <REENTRANCY-LEVEL>MULTICORE-REENTRANT</REENTRANCY-LEVEL>
                    <IMPLEMENTED-ENTRY-REF DEST="BSW-MODULE-ENTRY">/AUTOSAR_Mcu/BswModuleEntrys/Mcu_GetVersionInfo</IMPLEMENTED-ENTRY-REF>
                  </BSW-CALLED-ENTITY>
[!ENDIF!][!//
[!IF "$Mcu_InitClock_Xpath = 'true'"!]
                  <BSW-CALLED-ENTITY>
                    <SHORT-NAME>Mcu_InitClock</SHORT-NAME>
                    <REENTRANCY-LEVEL>NON-REENTRANT</REENTRANCY-LEVEL>
                    <IMPLEMENTED-ENTRY-REF DEST="BSW-MODULE-ENTRY">/AUTOSAR_Mcu/BswModuleEntrys/Mcu_InitClock</IMPLEMENTED-ENTRY-REF>
                  </BSW-CALLED-ENTITY>
[!ENDIF!][!//
                  <BSW-CALLED-ENTITY>
                    <SHORT-NAME>Mcu_InitRamSection</SHORT-NAME>
                    <REENTRANCY-LEVEL>MULTICORE-REENTRANT</REENTRANCY-LEVEL>
                    <IMPLEMENTED-ENTRY-REF DEST="BSW-MODULE-ENTRY">/AUTOSAR_Mcu/BswModuleEntrys/Mcu_InitRamSection</IMPLEMENTED-ENTRY-REF>
                  </BSW-CALLED-ENTITY>
[!IF "$Mcu_PerformReset_Xpath = 'true'"!]
                  <BSW-CALLED-ENTITY>
                    <SHORT-NAME>Mcu_PerformReset</SHORT-NAME>
                    <REENTRANCY-LEVEL>MULTICORE-REENTRANT</REENTRANCY-LEVEL>
                    <IMPLEMENTED-ENTRY-REF DEST="BSW-MODULE-ENTRY">/AUTOSAR_Mcu/BswModuleEntrys/Mcu_PerformReset</IMPLEMENTED-ENTRY-REF>
                  </BSW-CALLED-ENTITY>
[!ENDIF!][!//
                  <BSW-CALLED-ENTITY>
                    <SHORT-NAME>Mcu_SetMode</SHORT-NAME>
                    <REENTRANCY-LEVEL>NON-REENTRANT</REENTRANCY-LEVEL>
                    <IMPLEMENTED-ENTRY-REF DEST="BSW-MODULE-ENTRY">/AUTOSAR_Mcu/BswModuleEntrys/Mcu_SetMode</IMPLEMENTED-ENTRY-REF>
                  </BSW-CALLED-ENTITY>
[!IF "$Mcu_ClockFailureNotification_Xpath = 'true'"!]
                  <BSW-CALLED-ENTITY>
                    <SHORT-NAME>Mcu_ClockFailureNotification</SHORT-NAME>
                    <REENTRANCY-LEVEL>MULTICORE-REENTRANT</REENTRANCY-LEVEL>
                    <IMPLEMENTED-ENTRY-REF DEST="BSW-MODULE-ENTRY">/AUTOSAR_Mcu/BswModuleEntrys/Mcu_ClockFailureNotification</IMPLEMENTED-ENTRY-REF>
                  </BSW-CALLED-ENTITY>
[!ENDIF!][!//
[!IF "$Mcu_DistributePllClock_Xpath = 'true'"!]
                  <BSW-CALLED-ENTITY>
                    <SHORT-NAME>Mcu_DistributePllClock</SHORT-NAME>
                    <REENTRANCY-LEVEL>NON-REENTRANT</REENTRANCY-LEVEL>
                    <IMPLEMENTED-ENTRY-REF DEST="BSW-MODULE-ENTRY">/AUTOSAR_Mcu/BswModuleEntrys/Mcu_DistributePllClock</IMPLEMENTED-ENTRY-REF>
                  </BSW-CALLED-ENTITY>
[!ENDIF!][!//
                  <BSW-CALLED-ENTITY>
                    <SHORT-NAME>Mcu_GetPllStatus</SHORT-NAME>
                    <REENTRANCY-LEVEL>MULTICORE-REENTRANT</REENTRANCY-LEVEL>
                    <IMPLEMENTED-ENTRY-REF DEST="BSW-MODULE-ENTRY">/AUTOSAR_Mcu/BswModuleEntrys/Mcu_GetPllStatus</IMPLEMENTED-ENTRY-REF>
                  </BSW-CALLED-ENTITY>
                  <BSW-CALLED-ENTITY>
                    <SHORT-NAME>Mcu_GetResetRawValue</SHORT-NAME>
                    <REENTRANCY-LEVEL>MULTICORE-REENTRANT</REENTRANCY-LEVEL>
                    <IMPLEMENTED-ENTRY-REF DEST="BSW-MODULE-ENTRY">/AUTOSAR_Mcu/BswModuleEntrys/Mcu_GetResetRawValue</IMPLEMENTED-ENTRY-REF>
                  </BSW-CALLED-ENTITY>
                  <BSW-CALLED-ENTITY>
                    <SHORT-NAME>Mcu_GetResetReason</SHORT-NAME>
                    <REENTRANCY-LEVEL>MULTICORE-REENTRANT</REENTRANCY-LEVEL>
                    <IMPLEMENTED-ENTRY-REF DEST="BSW-MODULE-ENTRY">/AUTOSAR_Mcu/BswModuleEntrys/Mcu_GetResetReason</IMPLEMENTED-ENTRY-REF>
                  </BSW-CALLED-ENTITY>
[!IF "$Mcu_GetRamStateApi_Xpath = 'true'"!]
                  <BSW-CALLED-ENTITY>
                    <SHORT-NAME>Mcu_GetRamState</SHORT-NAME>
                    <REENTRANCY-LEVEL>MULTICORE-REENTRANT</REENTRANCY-LEVEL>
                    <IMPLEMENTED-ENTRY-REF DEST="BSW-MODULE-ENTRY">/AUTOSAR_Mcu/BswModuleEntrys/Mcu_GetRamState</IMPLEMENTED-ENTRY-REF>
                  </BSW-CALLED-ENTITY>
[!ENDIF!][!//
[!IF "$Mcu_ClearColdReset_Xpath = 'true'"!]
                  <BSW-CALLED-ENTITY>
                    <SHORT-NAME>Mcu_ClearColdResetStatus</SHORT-NAME>
                    <REENTRANCY-LEVEL>MULTICORE-REENTRANT</REENTRANCY-LEVEL>
                    <IMPLEMENTED-ENTRY-REF DEST="BSW-MODULE-ENTRY">/AUTOSAR_Mcu/BswModuleEntrys/Mcu_ClearColdResetStatus</IMPLEMENTED-ENTRY-REF>
                  </BSW-CALLED-ENTITY>
[!ENDIF!][!//
[!IF "$Mcu_LowPowerModeApis_Xpath = 'true'"!]
                  <BSW-CALLED-ENTITY>
                    <SHORT-NAME>Mcu_GetCpuIdleModeInitiator</SHORT-NAME>
                    <REENTRANCY-LEVEL>MULTICORE-REENTRANT</REENTRANCY-LEVEL>
                    <IMPLEMENTED-ENTRY-REF DEST="BSW-MODULE-ENTRY">/AUTOSAR_Mcu/BswModuleEntrys/Mcu_GetCpuIdleModeInitiator</IMPLEMENTED-ENTRY-REF>
                  </BSW-CALLED-ENTITY>
                  <BSW-CALLED-ENTITY>
                    <SHORT-NAME>Mcu_GetCpuState</SHORT-NAME>
                    <REENTRANCY-LEVEL>MULTICORE-REENTRANT</REENTRANCY-LEVEL>
                    <IMPLEMENTED-ENTRY-REF DEST="BSW-MODULE-ENTRY">/AUTOSAR_Mcu/BswModuleEntrys/Mcu_GetCpuState</IMPLEMENTED-ENTRY-REF>
                  </BSW-CALLED-ENTITY>
                  <BSW-CALLED-ENTITY>
                    <SHORT-NAME>Mcu_GetWakeupCause</SHORT-NAME>
                    <REENTRANCY-LEVEL>MULTICORE-REENTRANT</REENTRANCY-LEVEL>
                    <IMPLEMENTED-ENTRY-REF DEST="BSW-MODULE-ENTRY">/AUTOSAR_Mcu/BswModuleEntrys/Mcu_GetWakeupCause</IMPLEMENTED-ENTRY-REF>
                  </BSW-CALLED-ENTITY>
                  <BSW-CALLED-ENTITY>
                    <SHORT-NAME>Mcu_ClearWakeupCause</SHORT-NAME>
                    <REENTRANCY-LEVEL>MULTICORE-REENTRANT</REENTRANCY-LEVEL>
                    <IMPLEMENTED-ENTRY-REF DEST="BSW-MODULE-ENTRY">/AUTOSAR_Mcu/BswModuleEntrys/Mcu_ClearWakeupCause</IMPLEMENTED-ENTRY-REF>
                  </BSW-CALLED-ENTITY>
[!ENDIF!][!//
[!IF "$Mcu_TrapApi_Xpath = 'true'"!]
                  <BSW-CALLED-ENTITY>
                    <SHORT-NAME>Mcu_GetTrapCause</SHORT-NAME>
                    <REENTRANCY-LEVEL>MULTICORE-REENTRANT</REENTRANCY-LEVEL>
                    <IMPLEMENTED-ENTRY-REF DEST="BSW-MODULE-ENTRY">/AUTOSAR_Mcu/BswModuleEntrys/Mcu_GetTrapCause</IMPLEMENTED-ENTRY-REF>
                  </BSW-CALLED-ENTITY>
                  <BSW-CALLED-ENTITY>
                    <SHORT-NAME>Mcu_SetTrapRequest</SHORT-NAME>
                    <REENTRANCY-LEVEL>MULTICORE-REENTRANT</REENTRANCY-LEVEL>
                    <IMPLEMENTED-ENTRY-REF DEST="BSW-MODULE-ENTRY">/AUTOSAR_Mcu/BswModuleEntrys/Mcu_SetTrapRequest</IMPLEMENTED-ENTRY-REF>
                  </BSW-CALLED-ENTITY>
                  <BSW-CALLED-ENTITY>
                    <SHORT-NAME>Mcu_ClearTrapRequest</SHORT-NAME>
                    <REENTRANCY-LEVEL>MULTICORE-REENTRANT</REENTRANCY-LEVEL>
                    <IMPLEMENTED-ENTRY-REF DEST="BSW-MODULE-ENTRY">/AUTOSAR_Mcu/BswModuleEntrys/Mcu_ClearTrapRequest</IMPLEMENTED-ENTRY-REF>
                  </BSW-CALLED-ENTITY>
[!ENDIF!][!//
[!IF "$Mcu_CcuconApi_Xpath = 'true'"!]
                  <BSW-CALLED-ENTITY>
                    <SHORT-NAME>Mcu_UpdateCpuCcuconReg</SHORT-NAME>
                    <REENTRANCY-LEVEL>MULTICORE-REENTRANT</REENTRANCY-LEVEL>
                    <IMPLEMENTED-ENTRY-REF DEST="BSW-MODULE-ENTRY">/AUTOSAR_Mcu/BswModuleEntrys/Mcu_UpdateCpuCcuconReg</IMPLEMENTED-ENTRY-REF>
                  </BSW-CALLED-ENTITY>
[!ENDIF!][!//
[!IF "$Mcu_GtmIpAvailable_Xpath = 'true'"!]
                  <BSW-CALLED-ENTITY>
                    <SHORT-NAME>Mcu_17_Gtm_TomChannelInit</SHORT-NAME>
                    <REENTRANCY-LEVEL>MULTICORE-REENTRANT</REENTRANCY-LEVEL>
                    <IMPLEMENTED-ENTRY-REF DEST="BSW-MODULE-ENTRY">/AUTOSAR_Mcu/BswModuleEntrys/Mcu_17_Gtm_TomChannelInit</IMPLEMENTED-ENTRY-REF>
                  </BSW-CALLED-ENTITY>
                  <BSW-CALLED-ENTITY>
                    <SHORT-NAME>Mcu_17_Gtm_TomChannelShadowTransfer</SHORT-NAME>
                    <CAN-ENTER-EXCLUSIVE-AREA-REFS>
                      <CAN-ENTER-EXCLUSIVE-AREA-REF DEST="EXCLUSIVE-AREA">/AUTOSAR_Mcu/BswModuleDescriptions/Mcu/McuBehavior/TomTgcReg</CAN-ENTER-EXCLUSIVE-AREA-REF>
                    </CAN-ENTER-EXCLUSIVE-AREA-REFS>
                    <REENTRANCY-LEVEL>NON-REENTRANT</REENTRANCY-LEVEL>
                    <IMPLEMENTED-ENTRY-REF DEST="BSW-MODULE-ENTRY">/AUTOSAR_Mcu/BswModuleEntrys/Mcu_17_Gtm_TomChannelShadowTransfer</IMPLEMENTED-ENTRY-REF>
                  </BSW-CALLED-ENTITY>
                  <BSW-CALLED-ENTITY>
                    <SHORT-NAME>Mcu_17_Gtm_TomChannelDeInit</SHORT-NAME>
                    <CAN-ENTER-EXCLUSIVE-AREA-REFS>
                      <CAN-ENTER-EXCLUSIVE-AREA-REF DEST="EXCLUSIVE-AREA">/AUTOSAR_Mcu/BswModuleDescriptions/Mcu/McuBehavior/TomTgcReg</CAN-ENTER-EXCLUSIVE-AREA-REF>
                    </CAN-ENTER-EXCLUSIVE-AREA-REFS>
                    <REENTRANCY-LEVEL>MULTICORE-REENTRANT</REENTRANCY-LEVEL>
                    <IMPLEMENTED-ENTRY-REF DEST="BSW-MODULE-ENTRY">/AUTOSAR_Mcu/BswModuleEntrys/Mcu_17_Gtm_TomChannelDeInit</IMPLEMENTED-ENTRY-REF>
                  </BSW-CALLED-ENTITY>
                  <BSW-CALLED-ENTITY>
                    <SHORT-NAME>Mcu_17_Gtm_AtomChannelInit</SHORT-NAME>
                    <REENTRANCY-LEVEL>MULTICORE-REENTRANT</REENTRANCY-LEVEL>
                    <IMPLEMENTED-ENTRY-REF DEST="BSW-MODULE-ENTRY">/AUTOSAR_Mcu/BswModuleEntrys/Mcu_17_Gtm_AtomChannelInit</IMPLEMENTED-ENTRY-REF>
                  </BSW-CALLED-ENTITY>
                  <BSW-CALLED-ENTITY>
                    <SHORT-NAME>Mcu_17_Gtm_AtomChannelShadowTransfer</SHORT-NAME>
                    <CAN-ENTER-EXCLUSIVE-AREA-REFS>
                      <CAN-ENTER-EXCLUSIVE-AREA-REF DEST="EXCLUSIVE-AREA">/AUTOSAR_Mcu/BswModuleDescriptions/Mcu/McuBehavior/AtomAgcReg</CAN-ENTER-EXCLUSIVE-AREA-REF>
                    </CAN-ENTER-EXCLUSIVE-AREA-REFS>
                    <REENTRANCY-LEVEL>NON-REENTRANT</REENTRANCY-LEVEL>
                    <IMPLEMENTED-ENTRY-REF DEST="BSW-MODULE-ENTRY">/AUTOSAR_Mcu/BswModuleEntrys/Mcu_17_Gtm_AtomChannelShadowTransfer</IMPLEMENTED-ENTRY-REF>
                  </BSW-CALLED-ENTITY>
                  <BSW-CALLED-ENTITY>
                    <SHORT-NAME>Mcu_17_Gtm_AtomChannelDeInit</SHORT-NAME>
                    <CAN-ENTER-EXCLUSIVE-AREA-REFS>
                      <CAN-ENTER-EXCLUSIVE-AREA-REF DEST="EXCLUSIVE-AREA">/AUTOSAR_Mcu/BswModuleDescriptions/Mcu/McuBehavior/AtomAgcReg</CAN-ENTER-EXCLUSIVE-AREA-REF>
                    </CAN-ENTER-EXCLUSIVE-AREA-REFS>
                    <REENTRANCY-LEVEL>MULTICORE-REENTRANT</REENTRANCY-LEVEL>
                    <IMPLEMENTED-ENTRY-REF DEST="BSW-MODULE-ENTRY">/AUTOSAR_Mcu/BswModuleEntrys/Mcu_17_Gtm_AtomChannelDeInit</IMPLEMENTED-ENTRY-REF>
                  </BSW-CALLED-ENTITY>
                  <BSW-CALLED-ENTITY>
                    <SHORT-NAME>Mcu_17_Gtm_TimChannelInit</SHORT-NAME>
                    <REENTRANCY-LEVEL>MULTICORE-REENTRANT</REENTRANCY-LEVEL>
                    <IMPLEMENTED-ENTRY-REF DEST="BSW-MODULE-ENTRY">/AUTOSAR_Mcu/BswModuleEntrys/Mcu_17_Gtm_TimChannelInit</IMPLEMENTED-ENTRY-REF>
                  </BSW-CALLED-ENTITY>
                  <BSW-CALLED-ENTITY>
                    <SHORT-NAME>Mcu_17_Gtm_TimChannelDeInit</SHORT-NAME>
                    <REENTRANCY-LEVEL>MULTICORE-REENTRANT</REENTRANCY-LEVEL>
                    <IMPLEMENTED-ENTRY-REF DEST="BSW-MODULE-ENTRY">/AUTOSAR_Mcu/BswModuleEntrys/Mcu_17_Gtm_TimChannelDeInit</IMPLEMENTED-ENTRY-REF>
                  </BSW-CALLED-ENTITY>
                  <BSW-CALLED-ENTITY>
                    <SHORT-NAME>Mcu_17_Gtm_TomChannelEnable</SHORT-NAME>
                    <CAN-ENTER-EXCLUSIVE-AREA-REFS>
                      <CAN-ENTER-EXCLUSIVE-AREA-REF DEST="EXCLUSIVE-AREA">/AUTOSAR_Mcu/BswModuleDescriptions/Mcu/McuBehavior/TomTgcReg</CAN-ENTER-EXCLUSIVE-AREA-REF>
                    </CAN-ENTER-EXCLUSIVE-AREA-REFS>
                    <REENTRANCY-LEVEL>MULTICORE-REENTRANT</REENTRANCY-LEVEL>
                    <IMPLEMENTED-ENTRY-REF DEST="BSW-MODULE-ENTRY">/AUTOSAR_Mcu/BswModuleEntrys/Mcu_17_Gtm_TomChannelEnable</IMPLEMENTED-ENTRY-REF>
                  </BSW-CALLED-ENTITY>
                  <BSW-CALLED-ENTITY>
                    <SHORT-NAME>Mcu_17_Gtm_TomChannelDisable</SHORT-NAME>
                    <CAN-ENTER-EXCLUSIVE-AREA-REFS>
                      <CAN-ENTER-EXCLUSIVE-AREA-REF DEST="EXCLUSIVE-AREA">/AUTOSAR_Mcu/BswModuleDescriptions/Mcu/McuBehavior/TomTgcReg</CAN-ENTER-EXCLUSIVE-AREA-REF>
                    </CAN-ENTER-EXCLUSIVE-AREA-REFS>
                    <REENTRANCY-LEVEL>MULTICORE-REENTRANT</REENTRANCY-LEVEL>
                    <IMPLEMENTED-ENTRY-REF DEST="BSW-MODULE-ENTRY">/AUTOSAR_Mcu/BswModuleEntrys/Mcu_17_Gtm_TomChannelDisable</IMPLEMENTED-ENTRY-REF>
                  </BSW-CALLED-ENTITY>
                  <BSW-CALLED-ENTITY>
                    <SHORT-NAME>Mcu_17_Gtm_IsTomChannelEnabled</SHORT-NAME>
                    <REENTRANCY-LEVEL>MULTICORE-REENTRANT</REENTRANCY-LEVEL>
                    <IMPLEMENTED-ENTRY-REF DEST="BSW-MODULE-ENTRY">/AUTOSAR_Mcu/BswModuleEntrys/Mcu_17_Gtm_IsTomChannelEnabled</IMPLEMENTED-ENTRY-REF>
                  </BSW-CALLED-ENTITY>
                  <BSW-CALLED-ENTITY>
                    <SHORT-NAME>Mcu_17_Gtm_AtomChannelEnable</SHORT-NAME>
                    <CAN-ENTER-EXCLUSIVE-AREA-REFS>
                      <CAN-ENTER-EXCLUSIVE-AREA-REF DEST="EXCLUSIVE-AREA">/AUTOSAR_Mcu/BswModuleDescriptions/Mcu/McuBehavior/AtomAgcReg</CAN-ENTER-EXCLUSIVE-AREA-REF>
                    </CAN-ENTER-EXCLUSIVE-AREA-REFS>
                    <REENTRANCY-LEVEL>MULTICORE-REENTRANT</REENTRANCY-LEVEL>
                    <IMPLEMENTED-ENTRY-REF DEST="BSW-MODULE-ENTRY">/AUTOSAR_Mcu/BswModuleEntrys/Mcu_17_Gtm_AtomChannelEnable</IMPLEMENTED-ENTRY-REF>
                  </BSW-CALLED-ENTITY>
                  <BSW-CALLED-ENTITY>
                    <SHORT-NAME>Mcu_17_Gtm_AtomChannelDisable</SHORT-NAME>
                    <CAN-ENTER-EXCLUSIVE-AREA-REFS>
                      <CAN-ENTER-EXCLUSIVE-AREA-REF DEST="EXCLUSIVE-AREA">/AUTOSAR_Mcu/BswModuleDescriptions/Mcu/McuBehavior/AtomAgcReg</CAN-ENTER-EXCLUSIVE-AREA-REF>
                    </CAN-ENTER-EXCLUSIVE-AREA-REFS>
                    <REENTRANCY-LEVEL>MULTICORE-REENTRANT</REENTRANCY-LEVEL>
                    <IMPLEMENTED-ENTRY-REF DEST="BSW-MODULE-ENTRY">/AUTOSAR_Mcu/BswModuleEntrys/Mcu_17_Gtm_AtomChannelDisable</IMPLEMENTED-ENTRY-REF>
                  </BSW-CALLED-ENTITY>
                  <BSW-CALLED-ENTITY>
                    <SHORT-NAME>Mcu_17_Gtm_IsAtomChannelEnabled</SHORT-NAME>
                    <REENTRANCY-LEVEL>MULTICORE-REENTRANT</REENTRANCY-LEVEL>
                    <IMPLEMENTED-ENTRY-REF DEST="BSW-MODULE-ENTRY">/AUTOSAR_Mcu/BswModuleEntrys/Mcu_17_Gtm_IsAtomChannelEnabled</IMPLEMENTED-ENTRY-REF>
                  </BSW-CALLED-ENTITY>
                  <BSW-CALLED-ENTITY>
                    <SHORT-NAME>Mcu_17_Gtm_TimChannelEnable</SHORT-NAME>
                    <REENTRANCY-LEVEL>MULTICORE-REENTRANT</REENTRANCY-LEVEL>
                    <IMPLEMENTED-ENTRY-REF DEST="BSW-MODULE-ENTRY">/AUTOSAR_Mcu/BswModuleEntrys/Mcu_17_Gtm_TimChannelEnable</IMPLEMENTED-ENTRY-REF>
                  </BSW-CALLED-ENTITY>
                  <BSW-CALLED-ENTITY>
                    <SHORT-NAME>Mcu_17_Gtm_TimChannelDisable</SHORT-NAME>
                    <REENTRANCY-LEVEL>MULTICORE-REENTRANT</REENTRANCY-LEVEL>
                    <IMPLEMENTED-ENTRY-REF DEST="BSW-MODULE-ENTRY">/AUTOSAR_Mcu/BswModuleEntrys/Mcu_17_Gtm_TimChannelDisable</IMPLEMENTED-ENTRY-REF>
                  </BSW-CALLED-ENTITY>
                  <BSW-CALLED-ENTITY>
                    <SHORT-NAME>Mcu_17_Gtm_IsTimChannelEnabled</SHORT-NAME>
                    <REENTRANCY-LEVEL>MULTICORE-REENTRANT</REENTRANCY-LEVEL>
                    <IMPLEMENTED-ENTRY-REF DEST="BSW-MODULE-ENTRY">/AUTOSAR_Mcu/BswModuleEntrys/Mcu_17_Gtm_IsTimChannelEnabled</IMPLEMENTED-ENTRY-REF>
                  </BSW-CALLED-ENTITY>
                  <BSW-INTERRUPT-ENTITY>
                    <SHORT-NAME>Mcu_17_Gtm_TimChannelIsr</SHORT-NAME>
                    <REENTRANCY-LEVEL>MULTICORE-REENTRANT</REENTRANCY-LEVEL>
                    <IMPLEMENTED-ENTRY-REF DEST="BSW-MODULE-ENTRY">/AUTOSAR_Mcu/BswModuleEntrys/Mcu_17_Gtm_TimChannelIsr</IMPLEMENTED-ENTRY-REF>
                  </BSW-INTERRUPT-ENTITY>
                  <BSW-INTERRUPT-ENTITY>
                    <SHORT-NAME>Mcu_17_Gtm_TomChannelIsr</SHORT-NAME>
                    <REENTRANCY-LEVEL>MULTICORE-REENTRANT</REENTRANCY-LEVEL>
                    <IMPLEMENTED-ENTRY-REF DEST="BSW-MODULE-ENTRY">/AUTOSAR_Mcu/BswModuleEntrys/Mcu_17_Gtm_TomChannelIsr</IMPLEMENTED-ENTRY-REF>
                  </BSW-INTERRUPT-ENTITY>
                  <BSW-INTERRUPT-ENTITY>
                    <SHORT-NAME>Mcu_17_Gtm_AtomChannelIsr</SHORT-NAME>
                    <REENTRANCY-LEVEL>MULTICORE-REENTRANT</REENTRANCY-LEVEL>
                    <IMPLEMENTED-ENTRY-REF DEST="BSW-MODULE-ENTRY">/AUTOSAR_Mcu/BswModuleEntrys/Mcu_17_Gtm_AtomChannelIsr</IMPLEMENTED-ENTRY-REF>
                  </BSW-INTERRUPT-ENTITY>
                  <BSW-CALLED-ENTITY>
                    <SHORT-NAME>Mcu_17_Gtm_ConnectPortPinToTim</SHORT-NAME>
                    <REENTRANCY-LEVEL>MULTICORE-REENTRANT</REENTRANCY-LEVEL>
                    <IMPLEMENTED-ENTRY-REF DEST="BSW-MODULE-ENTRY">/AUTOSAR_Mcu/BswModuleEntrys/Mcu_17_Gtm_ConnectPortPinToTim</IMPLEMENTED-ENTRY-REF>
                  </BSW-CALLED-ENTITY>
                  <BSW-CALLED-ENTITY>
                    <SHORT-NAME>Mcu_17_Gtm_ConnectTimerOutToPortPin</SHORT-NAME>
                    <REENTRANCY-LEVEL>MULTICORE-REENTRANT</REENTRANCY-LEVEL>
                    <IMPLEMENTED-ENTRY-REF DEST="BSW-MODULE-ENTRY">/AUTOSAR_Mcu/BswModuleEntrys/Mcu_17_Gtm_ConnectTimerOutToPortPin</IMPLEMENTED-ENTRY-REF>
                  </BSW-CALLED-ENTITY>
                  <BSW-CALLED-ENTITY>
                    <SHORT-NAME>Mcu_17_Gtm_TomTriggerRequest</SHORT-NAME>
                    <CAN-ENTER-EXCLUSIVE-AREA-REFS>
                      <CAN-ENTER-EXCLUSIVE-AREA-REF DEST="EXCLUSIVE-AREA">/AUTOSAR_Mcu/BswModuleDescriptions/Mcu/McuBehavior/TomTgcReg</CAN-ENTER-EXCLUSIVE-AREA-REF>
                    </CAN-ENTER-EXCLUSIVE-AREA-REFS>
                    <REENTRANCY-LEVEL>MULTICORE-REENTRANT</REENTRANCY-LEVEL>
                    <IMPLEMENTED-ENTRY-REF DEST="BSW-MODULE-ENTRY">/AUTOSAR_Mcu/BswModuleEntrys/Mcu_17_Gtm_TomTriggerRequest</IMPLEMENTED-ENTRY-REF>
                  </BSW-CALLED-ENTITY>
                  <BSW-CALLED-ENTITY>
                    <SHORT-NAME>Mcu_17_Gtm_TomChInitCheck</SHORT-NAME>
                    <REENTRANCY-LEVEL>MULTICORE-REENTRANT</REENTRANCY-LEVEL>
                    <IMPLEMENTED-ENTRY-REF DEST="BSW-MODULE-ENTRY">/AUTOSAR_Mcu/BswModuleEntrys/Mcu_17_Gtm_TomChInitCheck</IMPLEMENTED-ENTRY-REF>
                  </BSW-CALLED-ENTITY>
                  <BSW-CALLED-ENTITY>
                    <SHORT-NAME>Mcu_17_Gtm_TomChUpdateEnDis</SHORT-NAME>
                    <CAN-ENTER-EXCLUSIVE-AREA-REFS>
                      <CAN-ENTER-EXCLUSIVE-AREA-REF DEST="EXCLUSIVE-AREA">/AUTOSAR_Mcu/BswModuleDescriptions/Mcu/McuBehavior/TomTgcReg</CAN-ENTER-EXCLUSIVE-AREA-REF>
                    </CAN-ENTER-EXCLUSIVE-AREA-REFS>
                    <REENTRANCY-LEVEL>MULTICORE-REENTRANT</REENTRANCY-LEVEL>
                    <IMPLEMENTED-ENTRY-REF DEST="BSW-MODULE-ENTRY">/AUTOSAR_Mcu/BswModuleEntrys/Mcu_17_Gtm_TomChUpdateEnDis</IMPLEMENTED-ENTRY-REF>
                  </BSW-CALLED-ENTITY>
                  <BSW-CALLED-ENTITY>
                    <SHORT-NAME>Mcu_17_Gtm_TomChOutEnCtrlUpdate</SHORT-NAME>
                    <CAN-ENTER-EXCLUSIVE-AREA-REFS>
                      <CAN-ENTER-EXCLUSIVE-AREA-REF DEST="EXCLUSIVE-AREA">/AUTOSAR_Mcu/BswModuleDescriptions/Mcu/McuBehavior/TomTgcReg</CAN-ENTER-EXCLUSIVE-AREA-REF>
                    </CAN-ENTER-EXCLUSIVE-AREA-REFS>
                    <REENTRANCY-LEVEL>MULTICORE-REENTRANT</REENTRANCY-LEVEL>
                    <IMPLEMENTED-ENTRY-REF DEST="BSW-MODULE-ENTRY">/AUTOSAR_Mcu/BswModuleEntrys/Mcu_17_Gtm_TomChOutEnCtrlUpdate</IMPLEMENTED-ENTRY-REF>
                  </BSW-CALLED-ENTITY>
                  <BSW-CALLED-ENTITY>
                    <SHORT-NAME>Mcu_17_Gtm_TomChOutEnStatUpdate</SHORT-NAME>
                    <CAN-ENTER-EXCLUSIVE-AREA-REFS>
                      <CAN-ENTER-EXCLUSIVE-AREA-REF DEST="EXCLUSIVE-AREA">/AUTOSAR_Mcu/BswModuleDescriptions/Mcu/McuBehavior/TomTgcReg</CAN-ENTER-EXCLUSIVE-AREA-REF>
                    </CAN-ENTER-EXCLUSIVE-AREA-REFS>
                    <REENTRANCY-LEVEL>MULTICORE-REENTRANT</REENTRANCY-LEVEL>
                    <IMPLEMENTED-ENTRY-REF DEST="BSW-MODULE-ENTRY">/AUTOSAR_Mcu/BswModuleEntrys/Mcu_17_Gtm_TomChOutEnStatUpdate</IMPLEMENTED-ENTRY-REF>
                  </BSW-CALLED-ENTITY>
                  <BSW-CALLED-ENTITY>
                    <SHORT-NAME>Mcu_17_Gtm_TomChEndisCtrlUpdate</SHORT-NAME>
                    <CAN-ENTER-EXCLUSIVE-AREA-REFS>
                      <CAN-ENTER-EXCLUSIVE-AREA-REF DEST="EXCLUSIVE-AREA">/AUTOSAR_Mcu/BswModuleDescriptions/Mcu/McuBehavior/TomTgcReg</CAN-ENTER-EXCLUSIVE-AREA-REF>
                    </CAN-ENTER-EXCLUSIVE-AREA-REFS>
                    <REENTRANCY-LEVEL>MULTICORE-REENTRANT</REENTRANCY-LEVEL>
                    <IMPLEMENTED-ENTRY-REF DEST="BSW-MODULE-ENTRY">/AUTOSAR_Mcu/BswModuleEntrys/Mcu_17_Gtm_TomChEndisCtrlUpdate</IMPLEMENTED-ENTRY-REF>
                  </BSW-CALLED-ENTITY>
                  <BSW-CALLED-ENTITY>
                    <SHORT-NAME>Mcu_17_Gtm_TomChEndisStatUpdate</SHORT-NAME>
                    <CAN-ENTER-EXCLUSIVE-AREA-REFS>
                      <CAN-ENTER-EXCLUSIVE-AREA-REF DEST="EXCLUSIVE-AREA">/AUTOSAR_Mcu/BswModuleDescriptions/Mcu/McuBehavior/TomTgcReg</CAN-ENTER-EXCLUSIVE-AREA-REF>
                    </CAN-ENTER-EXCLUSIVE-AREA-REFS>
                    <REENTRANCY-LEVEL>MULTICORE-REENTRANT</REENTRANCY-LEVEL>
                    <IMPLEMENTED-ENTRY-REF DEST="BSW-MODULE-ENTRY">/AUTOSAR_Mcu/BswModuleEntrys/Mcu_17_Gtm_TomChEndisStatUpdate</IMPLEMENTED-ENTRY-REF>
                  </BSW-CALLED-ENTITY>
                  <BSW-CALLED-ENTITY>
                    <SHORT-NAME>Mcu_17_Gtm_AtomTriggerRequest</SHORT-NAME>
                    <CAN-ENTER-EXCLUSIVE-AREA-REFS>
                      <CAN-ENTER-EXCLUSIVE-AREA-REF DEST="EXCLUSIVE-AREA">/AUTOSAR_Mcu/BswModuleDescriptions/Mcu/McuBehavior/AtomAgcReg</CAN-ENTER-EXCLUSIVE-AREA-REF>
                    </CAN-ENTER-EXCLUSIVE-AREA-REFS>
                    <REENTRANCY-LEVEL>MULTICORE-REENTRANT</REENTRANCY-LEVEL>
                    <IMPLEMENTED-ENTRY-REF DEST="BSW-MODULE-ENTRY">/AUTOSAR_Mcu/BswModuleEntrys/Mcu_17_Gtm_AtomTriggerRequest</IMPLEMENTED-ENTRY-REF>
                  </BSW-CALLED-ENTITY>
                  <BSW-CALLED-ENTITY>
                    <SHORT-NAME>Mcu_17_Gtm_AtomChInitCheck</SHORT-NAME>
                    <REENTRANCY-LEVEL>MULTICORE-REENTRANT</REENTRANCY-LEVEL>
                    <IMPLEMENTED-ENTRY-REF DEST="BSW-MODULE-ENTRY">/AUTOSAR_Mcu/BswModuleEntrys/Mcu_17_Gtm_AtomChInitCheck</IMPLEMENTED-ENTRY-REF>
                  </BSW-CALLED-ENTITY>
                  <BSW-CALLED-ENTITY>
                    <SHORT-NAME>Mcu_17_Gtm_AtomChUpdateEnDis</SHORT-NAME>
                    <CAN-ENTER-EXCLUSIVE-AREA-REFS>
                      <CAN-ENTER-EXCLUSIVE-AREA-REF DEST="EXCLUSIVE-AREA">/AUTOSAR_Mcu/BswModuleDescriptions/Mcu/McuBehavior/AtomAgcReg</CAN-ENTER-EXCLUSIVE-AREA-REF>
                    </CAN-ENTER-EXCLUSIVE-AREA-REFS>
                    <REENTRANCY-LEVEL>MULTICORE-REENTRANT</REENTRANCY-LEVEL>
                    <IMPLEMENTED-ENTRY-REF DEST="BSW-MODULE-ENTRY">/AUTOSAR_Mcu/BswModuleEntrys/Mcu_17_Gtm_AtomChUpdateEnDis</IMPLEMENTED-ENTRY-REF>
                  </BSW-CALLED-ENTITY>
                  <BSW-CALLED-ENTITY>
                    <SHORT-NAME>Mcu_17_Gtm_AtomChOutEnCtrlUpdate</SHORT-NAME>
                    <CAN-ENTER-EXCLUSIVE-AREA-REFS>
                      <CAN-ENTER-EXCLUSIVE-AREA-REF DEST="EXCLUSIVE-AREA">/AUTOSAR_Mcu/BswModuleDescriptions/Mcu/McuBehavior/AtomAgcReg</CAN-ENTER-EXCLUSIVE-AREA-REF>
                    </CAN-ENTER-EXCLUSIVE-AREA-REFS>
                    <REENTRANCY-LEVEL>MULTICORE-REENTRANT</REENTRANCY-LEVEL>
                    <IMPLEMENTED-ENTRY-REF DEST="BSW-MODULE-ENTRY">/AUTOSAR_Mcu/BswModuleEntrys/Mcu_17_Gtm_AtomChOutEnCtrlUpdate</IMPLEMENTED-ENTRY-REF>
                  </BSW-CALLED-ENTITY>
                  <BSW-CALLED-ENTITY>
                    <SHORT-NAME>Mcu_17_Gtm_AtomChOutEnStatUpdate</SHORT-NAME>
                    <CAN-ENTER-EXCLUSIVE-AREA-REFS>
                      <CAN-ENTER-EXCLUSIVE-AREA-REF DEST="EXCLUSIVE-AREA">/AUTOSAR_Mcu/BswModuleDescriptions/Mcu/McuBehavior/AtomAgcReg</CAN-ENTER-EXCLUSIVE-AREA-REF>
                    </CAN-ENTER-EXCLUSIVE-AREA-REFS>
                    <REENTRANCY-LEVEL>MULTICORE-REENTRANT</REENTRANCY-LEVEL>
                    <IMPLEMENTED-ENTRY-REF DEST="BSW-MODULE-ENTRY">/AUTOSAR_Mcu/BswModuleEntrys/Mcu_17_Gtm_AtomChOutEnStatUpdate</IMPLEMENTED-ENTRY-REF>
                  </BSW-CALLED-ENTITY>
                  <BSW-CALLED-ENTITY>
                    <SHORT-NAME>Mcu_17_Gtm_AtomChEndisCtrlUpdate</SHORT-NAME>
                    <CAN-ENTER-EXCLUSIVE-AREA-REFS>
                      <CAN-ENTER-EXCLUSIVE-AREA-REF DEST="EXCLUSIVE-AREA">/AUTOSAR_Mcu/BswModuleDescriptions/Mcu/McuBehavior/AtomAgcReg</CAN-ENTER-EXCLUSIVE-AREA-REF>
                    </CAN-ENTER-EXCLUSIVE-AREA-REFS>
                    <REENTRANCY-LEVEL>MULTICORE-REENTRANT</REENTRANCY-LEVEL>
                    <IMPLEMENTED-ENTRY-REF DEST="BSW-MODULE-ENTRY">/AUTOSAR_Mcu/BswModuleEntrys/Mcu_17_Gtm_AtomChEndisCtrlUpdate</IMPLEMENTED-ENTRY-REF>
                  </BSW-CALLED-ENTITY>
                  <BSW-CALLED-ENTITY>
                    <SHORT-NAME>Mcu_17_Gtm_AtomChEndisStatUpdate</SHORT-NAME>
                    <CAN-ENTER-EXCLUSIVE-AREA-REFS>
                      <CAN-ENTER-EXCLUSIVE-AREA-REF DEST="EXCLUSIVE-AREA">/AUTOSAR_Mcu/BswModuleDescriptions/Mcu/McuBehavior/AtomAgcReg</CAN-ENTER-EXCLUSIVE-AREA-REF>
                    </CAN-ENTER-EXCLUSIVE-AREA-REFS>
                    <REENTRANCY-LEVEL>MULTICORE-REENTRANT</REENTRANCY-LEVEL>
                    <IMPLEMENTED-ENTRY-REF DEST="BSW-MODULE-ENTRY">/AUTOSAR_Mcu/BswModuleEntrys/Mcu_17_Gtm_AtomChEndisStatUpdate</IMPLEMENTED-ENTRY-REF>
                  </BSW-CALLED-ENTITY>
                  <BSW-CALLED-ENTITY>
                    <SHORT-NAME>Mcu_17_Gtm_TimChInitCheck</SHORT-NAME>
                    <REENTRANCY-LEVEL>MULTICORE-REENTRANT</REENTRANCY-LEVEL>
                    <IMPLEMENTED-ENTRY-REF DEST="BSW-MODULE-ENTRY">/AUTOSAR_Mcu/BswModuleEntrys/Mcu_17_Gtm_TimChInitCheck</IMPLEMENTED-ENTRY-REF>
                  </BSW-CALLED-ENTITY>
[!ENDIF!][!//
                  <BSW-CALLED-ENTITY>
                    <SHORT-NAME>Mcu_17_Ccu6_TimerInit</SHORT-NAME>
                    <REENTRANCY-LEVEL>MULTICORE-REENTRANT</REENTRANCY-LEVEL>
                    <IMPLEMENTED-ENTRY-REF DEST="BSW-MODULE-ENTRY">/AUTOSAR_Mcu/BswModuleEntrys/Mcu_17_Ccu6_TimerInit</IMPLEMENTED-ENTRY-REF>
                  </BSW-CALLED-ENTITY>
                  <BSW-CALLED-ENTITY>
                    <SHORT-NAME>Mcu_17_Ccu6_TimerStart</SHORT-NAME>
                    <REENTRANCY-LEVEL>MULTICORE-REENTRANT</REENTRANCY-LEVEL>
                    <IMPLEMENTED-ENTRY-REF DEST="BSW-MODULE-ENTRY">/AUTOSAR_Mcu/BswModuleEntrys/Mcu_17_Ccu6_TimerStart</IMPLEMENTED-ENTRY-REF>
                  </BSW-CALLED-ENTITY>
                  <BSW-CALLED-ENTITY>
                    <SHORT-NAME>Mcu_17_Ccu6_TimerStop</SHORT-NAME>
                    <REENTRANCY-LEVEL>MULTICORE-REENTRANT</REENTRANCY-LEVEL>
                    <IMPLEMENTED-ENTRY-REF DEST="BSW-MODULE-ENTRY">/AUTOSAR_Mcu/BswModuleEntrys/Mcu_17_Ccu6_TimerStop</IMPLEMENTED-ENTRY-REF>
                  </BSW-CALLED-ENTITY>
                  <BSW-CALLED-ENTITY>
                    <SHORT-NAME>Mcu_17_Ccu6_TimerShadowTransfer</SHORT-NAME>
                    <REENTRANCY-LEVEL>MULTICORE-REENTRANT</REENTRANCY-LEVEL>
                    <IMPLEMENTED-ENTRY-REF DEST="BSW-MODULE-ENTRY">/AUTOSAR_Mcu/BswModuleEntrys/Mcu_17_Ccu6_TimerShadowTransfer</IMPLEMENTED-ENTRY-REF>
                  </BSW-CALLED-ENTITY>
                  <BSW-CALLED-ENTITY>
                    <SHORT-NAME>Mcu_17_Ccu6_TimerIntEnDis</SHORT-NAME>
                    <REENTRANCY-LEVEL>MULTICORE-REENTRANT</REENTRANCY-LEVEL>
                    <IMPLEMENTED-ENTRY-REF DEST="BSW-MODULE-ENTRY">/AUTOSAR_Mcu/BswModuleEntrys/Mcu_17_Ccu6_TimerIntEnDis</IMPLEMENTED-ENTRY-REF>
                  </BSW-CALLED-ENTITY>
                  <BSW-CALLED-ENTITY>
                    <SHORT-NAME>Mcu_17_Ccu6_TimerDeInit</SHORT-NAME>
                    <REENTRANCY-LEVEL>MULTICORE-REENTRANT</REENTRANCY-LEVEL>
                    <IMPLEMENTED-ENTRY-REF DEST="BSW-MODULE-ENTRY">/AUTOSAR_Mcu/BswModuleEntrys/Mcu_17_Ccu6_TimerDeInit</IMPLEMENTED-ENTRY-REF>
                  </BSW-CALLED-ENTITY>
                  <BSW-INTERRUPT-ENTITY>
                    <SHORT-NAME>Mcu_17_Ccu6_ChannelIsr</SHORT-NAME>
                    <REENTRANCY-LEVEL>MULTICORE-REENTRANT</REENTRANCY-LEVEL>
                    <IMPLEMENTED-ENTRY-REF DEST="BSW-MODULE-ENTRY">/AUTOSAR_Mcu/BswModuleEntrys/Mcu_17_Ccu6_ChannelIsr</IMPLEMENTED-ENTRY-REF>
                  </BSW-INTERRUPT-ENTITY>
                  <BSW-CALLED-ENTITY>
                    <SHORT-NAME>Mcu_17_Gpt12_TimerInit</SHORT-NAME>
                    <REENTRANCY-LEVEL>MULTICORE-REENTRANT</REENTRANCY-LEVEL>
                    <IMPLEMENTED-ENTRY-REF DEST="BSW-MODULE-ENTRY">/AUTOSAR_Mcu/BswModuleEntrys/Mcu_17_Gpt12_TimerInit</IMPLEMENTED-ENTRY-REF>
                  </BSW-CALLED-ENTITY>
                  <BSW-CALLED-ENTITY>
                    <SHORT-NAME>Mcu_17_Gpt12_TimerDeInit</SHORT-NAME>
                    <REENTRANCY-LEVEL>MULTICORE-REENTRANT</REENTRANCY-LEVEL>
                    <IMPLEMENTED-ENTRY-REF DEST="BSW-MODULE-ENTRY">/AUTOSAR_Mcu/BswModuleEntrys/Mcu_17_Gpt12_TimerDeInit</IMPLEMENTED-ENTRY-REF>
                  </BSW-CALLED-ENTITY>
                  <BSW-CALLED-ENTITY>
                    <SHORT-NAME>Mcu_17_Gpt12_TimerStart</SHORT-NAME>
                    <REENTRANCY-LEVEL>MULTICORE-REENTRANT</REENTRANCY-LEVEL>
                    <IMPLEMENTED-ENTRY-REF DEST="BSW-MODULE-ENTRY">/AUTOSAR_Mcu/BswModuleEntrys/Mcu_17_Gpt12_TimerStart</IMPLEMENTED-ENTRY-REF>
                  </BSW-CALLED-ENTITY>
                  <BSW-CALLED-ENTITY>
                    <SHORT-NAME>Mcu_17_Gpt12_TimerStop</SHORT-NAME>
                    <REENTRANCY-LEVEL>MULTICORE-REENTRANT</REENTRANCY-LEVEL>
                    <IMPLEMENTED-ENTRY-REF DEST="BSW-MODULE-ENTRY">/AUTOSAR_Mcu/BswModuleEntrys/Mcu_17_Gpt12_TimerStop</IMPLEMENTED-ENTRY-REF>
                  </BSW-CALLED-ENTITY>
                  <BSW-CALLED-ENTITY>
                    <SHORT-NAME>Mcu_17_Gpt12_TimerClockInit</SHORT-NAME>
                    <REENTRANCY-LEVEL>MULTICORE-REENTRANT</REENTRANCY-LEVEL>
                    <IMPLEMENTED-ENTRY-REF DEST="BSW-MODULE-ENTRY">/AUTOSAR_Mcu/BswModuleEntrys/Mcu_17_Gpt12_TimerClockInit</IMPLEMENTED-ENTRY-REF>
                  </BSW-CALLED-ENTITY>
                  <BSW-INTERRUPT-ENTITY>
                    <SHORT-NAME>Mcu_17_Gpt12_ChannelIsr</SHORT-NAME>
                    <REENTRANCY-LEVEL>MULTICORE-REENTRANT</REENTRANCY-LEVEL>
                    <IMPLEMENTED-ENTRY-REF DEST="BSW-MODULE-ENTRY">/AUTOSAR_Mcu/BswModuleEntrys/Mcu_17_Gpt12_ChannelIsr</IMPLEMENTED-ENTRY-REF>
                  </BSW-INTERRUPT-ENTITY>
                  <BSW-INTERRUPT-ENTITY>
                    <SHORT-NAME>Mcu_17_Stm_CompareMatchIsr</SHORT-NAME>
                    <REENTRANCY-LEVEL>MULTICORE-REENTRANT</REENTRANCY-LEVEL>
                    <IMPLEMENTED-ENTRY-REF DEST="BSW-MODULE-ENTRY">/AUTOSAR_Mcu/BswModuleEntrys/Mcu_17_Stm_CompareMatchIsr</IMPLEMENTED-ENTRY-REF>
                  </BSW-INTERRUPT-ENTITY>
                  <BSW-INTERRUPT-ENTITY>
                    <SHORT-NAME>Mcu_17_Eru_GatingIsr</SHORT-NAME>
                    <REENTRANCY-LEVEL>MULTICORE-REENTRANT</REENTRANCY-LEVEL>
                    <IMPLEMENTED-ENTRY-REF DEST="BSW-MODULE-ENTRY">/AUTOSAR_Mcu/BswModuleEntrys/Mcu_17_Eru_GatingIsr</IMPLEMENTED-ENTRY-REF>
                  </BSW-INTERRUPT-ENTITY>
                  <BSW-CALLED-ENTITY>
                    <SHORT-NAME>Mcu_17_Stm_SetupComparator</SHORT-NAME>
                    <REENTRANCY-LEVEL>MULTICORE-REENTRANT</REENTRANCY-LEVEL>
                    <IMPLEMENTED-ENTRY-REF DEST="BSW-MODULE-ENTRY">/AUTOSAR_Mcu/BswModuleEntrys/Mcu_17_Stm_SetupComparator</IMPLEMENTED-ENTRY-REF>
                  </BSW-CALLED-ENTITY>
                  <BSW-CALLED-ENTITY>
                    <SHORT-NAME>Mcu_17_Stm_CheckComparator</SHORT-NAME>
                    <REENTRANCY-LEVEL>MULTICORE-REENTRANT</REENTRANCY-LEVEL>
                    <IMPLEMENTED-ENTRY-REF DEST="BSW-MODULE-ENTRY">/AUTOSAR_Mcu/BswModuleEntrys/Mcu_17_Stm_CheckComparator</IMPLEMENTED-ENTRY-REF>
                  </BSW-CALLED-ENTITY>
                  <BSW-CALLED-ENTITY>
                    <SHORT-NAME>Mcu_17_Stm_ComparatorIntDisable</SHORT-NAME>
                    <REENTRANCY-LEVEL>MULTICORE-REENTRANT</REENTRANCY-LEVEL>
                    <IMPLEMENTED-ENTRY-REF DEST="BSW-MODULE-ENTRY">/AUTOSAR_Mcu/BswModuleEntrys/Mcu_17_Stm_ComparatorIntDisable</IMPLEMENTED-ENTRY-REF>
                  </BSW-CALLED-ENTITY>
                  <BSW-CALLED-ENTITY>
                    <SHORT-NAME>Mcu_17_Ccu6_TimerInitCheck</SHORT-NAME>
                    <REENTRANCY-LEVEL>MULTICORE-REENTRANT</REENTRANCY-LEVEL>
                    <IMPLEMENTED-ENTRY-REF DEST="BSW-MODULE-ENTRY">/AUTOSAR_Mcu/BswModuleEntrys/Mcu_17_Ccu6_TimerInitCheck</IMPLEMENTED-ENTRY-REF>
                  </BSW-CALLED-ENTITY>
                  <BSW-CALLED-ENTITY>
                    <SHORT-NAME>Mcu_17_Gpt12_TimerInitCheck</SHORT-NAME>
                    <REENTRANCY-LEVEL>MULTICORE-REENTRANT</REENTRANCY-LEVEL>
                    <IMPLEMENTED-ENTRY-REF DEST="BSW-MODULE-ENTRY">/AUTOSAR_Mcu/BswModuleEntrys/Mcu_17_Gpt12_TimerInitCheck</IMPLEMENTED-ENTRY-REF>
                  </BSW-CALLED-ENTITY>
[!IF "$Mcu_InitCheck_Xpath = 'true'"!]
                  <BSW-CALLED-ENTITY>
                    <SHORT-NAME>Mcu_InitCheck</SHORT-NAME>
                    <REENTRANCY-LEVEL>NON-REENTRANT</REENTRANCY-LEVEL>
                    <IMPLEMENTED-ENTRY-REF DEST="BSW-MODULE-ENTRY">/AUTOSAR_Mcu/BswModuleEntrys/Mcu_InitCheck</IMPLEMENTED-ENTRY-REF>
                  </BSW-CALLED-ENTITY>
[!ENDIF!][!//
                </ENTITYS>
                <SERVICE-DEPENDENCYS>
                  <BSW-SERVICE-DEPENDENCY>
                    <SERVICE-NEEDS>
                      <DIAGNOSTIC-EVENT-NEEDS>
                        <SHORT-NAME>MCU_E_GTM_CLC_ENABLE_ERR</SHORT-NAME>
                      </DIAGNOSTIC-EVENT-NEEDS>
                    </SERVICE-NEEDS>
                  </BSW-SERVICE-DEPENDENCY>
                  <BSW-SERVICE-DEPENDENCY>
                    <SERVICE-NEEDS>
                      <DIAGNOSTIC-EVENT-NEEDS>
                        <SHORT-NAME>MCU_E_GTM_CLC_DISABLE_ERR</SHORT-NAME>
                      </DIAGNOSTIC-EVENT-NEEDS>
                    </SERVICE-NEEDS>
                  </BSW-SERVICE-DEPENDENCY>
                  <BSW-SERVICE-DEPENDENCY>
                    <SERVICE-NEEDS>
                      <DIAGNOSTIC-EVENT-NEEDS>
                        <SHORT-NAME>MCU_E_CCU6_CLC_DISABLE_ERR</SHORT-NAME>
                      </DIAGNOSTIC-EVENT-NEEDS>
                    </SERVICE-NEEDS>
                  </BSW-SERVICE-DEPENDENCY>
                  <BSW-SERVICE-DEPENDENCY>
                    <SERVICE-NEEDS>
                      <DIAGNOSTIC-EVENT-NEEDS>
                        <SHORT-NAME>MCU_E_OSC_FAILURE</SHORT-NAME>
                      </DIAGNOSTIC-EVENT-NEEDS>
                    </SERVICE-NEEDS>
                  </BSW-SERVICE-DEPENDENCY>
                  <BSW-SERVICE-DEPENDENCY>
                    <SERVICE-NEEDS>
                      <DIAGNOSTIC-EVENT-NEEDS>
                        <SHORT-NAME>MCU_E_SYSTEM_PLL_TIMEOUT_ERR</SHORT-NAME>
                      </DIAGNOSTIC-EVENT-NEEDS>
                    </SERVICE-NEEDS>
                  </BSW-SERVICE-DEPENDENCY>
                  <BSW-SERVICE-DEPENDENCY>
                    <SERVICE-NEEDS>
                      <DIAGNOSTIC-EVENT-NEEDS>
                        <SHORT-NAME>MCU_E_SYSTEM_PLL_LOCK_LOSS</SHORT-NAME>
                      </DIAGNOSTIC-EVENT-NEEDS>
                    </SERVICE-NEEDS>
                  </BSW-SERVICE-DEPENDENCY>
                  <BSW-SERVICE-DEPENDENCY>
                    <SERVICE-NEEDS>
                      <DIAGNOSTIC-EVENT-NEEDS>
                        <SHORT-NAME>MCU_E_PERIPHERAL_PLL_LOCK_LOSS</SHORT-NAME>
                      </DIAGNOSTIC-EVENT-NEEDS>
                    </SERVICE-NEEDS>
                  </BSW-SERVICE-DEPENDENCY>
                  <BSW-SERVICE-DEPENDENCY>
                    <SERVICE-NEEDS>
                      <DIAGNOSTIC-EVENT-NEEDS>
                        <SHORT-NAME>MCU_E_PERIPHERAL_PLL_TIMEOUT_ERR</SHORT-NAME>
                      </DIAGNOSTIC-EVENT-NEEDS>
                    </SERVICE-NEEDS>
                  </BSW-SERVICE-DEPENDENCY>
                  <BSW-SERVICE-DEPENDENCY>
                    <SERVICE-NEEDS>
                      <DIAGNOSTIC-EVENT-NEEDS>
                        <SHORT-NAME>MCU_E_CONVCTRL_CLC_ENABLE_ERR</SHORT-NAME>
                      </DIAGNOSTIC-EVENT-NEEDS>
                    </SERVICE-NEEDS>
                  </BSW-SERVICE-DEPENDENCY>
                  <BSW-SERVICE-DEPENDENCY>
                    <SERVICE-NEEDS>
                      <DIAGNOSTIC-EVENT-NEEDS>
                        <SHORT-NAME>MCU_E_CCUCON0_UPDATE_ERR</SHORT-NAME>
                      </DIAGNOSTIC-EVENT-NEEDS>
                    </SERVICE-NEEDS>
                  </BSW-SERVICE-DEPENDENCY>
                  <BSW-SERVICE-DEPENDENCY>
                    <SERVICE-NEEDS>
                      <DIAGNOSTIC-EVENT-NEEDS>
                        <SHORT-NAME>MCU_E_CCU6_CLC_ENABLE_ERR</SHORT-NAME>
                      </DIAGNOSTIC-EVENT-NEEDS>
                    </SERVICE-NEEDS>
                  </BSW-SERVICE-DEPENDENCY>
                  <BSW-SERVICE-DEPENDENCY>
                    <SERVICE-NEEDS>
                      <DIAGNOSTIC-EVENT-NEEDS>
                        <SHORT-NAME>MCU_E_CONVCTRL_CLC_DISABLE_ERR</SHORT-NAME>
                      </DIAGNOSTIC-EVENT-NEEDS>
                    </SERVICE-NEEDS>
                  </BSW-SERVICE-DEPENDENCY>
                  <BSW-SERVICE-DEPENDENCY>
                    <SERVICE-NEEDS>
                      <DIAGNOSTIC-EVENT-NEEDS>
                        <SHORT-NAME>MCU_E_GPT12_CLC_ENABLE_ERR</SHORT-NAME>
                      </DIAGNOSTIC-EVENT-NEEDS>
                    </SERVICE-NEEDS>
                  </BSW-SERVICE-DEPENDENCY>
                  <BSW-SERVICE-DEPENDENCY>
                    <SERVICE-NEEDS>
                      <DIAGNOSTIC-EVENT-NEEDS>
                        <SHORT-NAME>MCU_E_GPT12_CLC_DISABLE_ERR</SHORT-NAME>
                      </DIAGNOSTIC-EVENT-NEEDS>
                    </SERVICE-NEEDS>
                  </BSW-SERVICE-DEPENDENCY>
                  <BSW-SERVICE-DEPENDENCY>
                    <SERVICE-NEEDS>
                      <DIAGNOSTIC-EVENT-NEEDS>
                        <SHORT-NAME>MCU_E_PMSWCR_UPDATE_ERR</SHORT-NAME>
                      </DIAGNOSTIC-EVENT-NEEDS>
                    </SERVICE-NEEDS>
                  </BSW-SERVICE-DEPENDENCY>
                </SERVICE-DEPENDENCYS>
              </BSW-INTERNAL-BEHAVIOR>
            </INTERNAL-BEHAVIORS>
          </BSW-MODULE-DESCRIPTION>
        </ELEMENTS>
      </AR-PACKAGE>
      <AR-PACKAGE>
        <SHORT-NAME>BswModuleEntrys</SHORT-NAME>
        <CATEGORY>STANDARD</CATEGORY>
        <ELEMENTS>
          <BSW-MODULE-ENTRY>
            <SHORT-NAME>Mcu_Init</SHORT-NAME>
            <SERVICE-ID>0</SERVICE-ID>
            <IS-REENTRANT>false</IS-REENTRANT>
            <IS-SYNCHRONOUS>true</IS-SYNCHRONOUS>
            <CALL-TYPE>REGULAR</CALL-TYPE>
            <EXECUTION-CONTEXT>TASK</EXECUTION-CONTEXT>
            <SW-SERVICE-IMPL-POLICY>STANDARD</SW-SERVICE-IMPL-POLICY>
            <ARGUMENTS>
              <SW-SERVICE-ARG>
                <SHORT-NAME>ConfigPtr</SHORT-NAME>
                <CATEGORY>DATA_REFERENCE</CATEGORY>
                <SW-DATA-DEF-PROPS>
                  <SW-DATA-DEF-PROPS-VARIANTS>
                    <SW-DATA-DEF-PROPS-CONDITIONAL>
                      <SW-POINTER-TARGET-PROPS>
                        <TARGET-CATEGORY>TYPE_REFERENCE</TARGET-CATEGORY>
                        <SW-DATA-DEF-PROPS>
                          <SW-DATA-DEF-PROPS-VARIANTS>
                            <SW-DATA-DEF-PROPS-CONDITIONAL>
                              <IMPLEMENTATION-DATA-TYPE-REF DEST="IMPLEMENTATION-DATA-TYPE">/AUTOSAR_Mcu/ImplementationDataTypes/Mcu_ConfigType</IMPLEMENTATION-DATA-TYPE-REF>
                            </SW-DATA-DEF-PROPS-CONDITIONAL>
                          </SW-DATA-DEF-PROPS-VARIANTS>
                        </SW-DATA-DEF-PROPS>
                      </SW-POINTER-TARGET-PROPS>
                    </SW-DATA-DEF-PROPS-CONDITIONAL>
                  </SW-DATA-DEF-PROPS-VARIANTS>
                </SW-DATA-DEF-PROPS>
              </SW-SERVICE-ARG>
            </ARGUMENTS>
          </BSW-MODULE-ENTRY>
[!IF "$Mcu_DeInitApi_Xpath = 'true'"!]
          <BSW-MODULE-ENTRY>
            <SHORT-NAME>Mcu_DeInit</SHORT-NAME>
            <SERVICE-ID>81</SERVICE-ID>
            <IS-REENTRANT>false</IS-REENTRANT>
            <IS-SYNCHRONOUS>true</IS-SYNCHRONOUS>
            <CALL-TYPE>REGULAR</CALL-TYPE>
            <EXECUTION-CONTEXT>TASK</EXECUTION-CONTEXT>
            <SW-SERVICE-IMPL-POLICY>STANDARD</SW-SERVICE-IMPL-POLICY>
          </BSW-MODULE-ENTRY>
[!ENDIF!][!//
[!IF "$Mcu_VersionInfo_Xpath = 'true'"!]
          <BSW-MODULE-ENTRY>
            <SHORT-NAME>Mcu_GetVersionInfo</SHORT-NAME>
            <SERVICE-ID>9</SERVICE-ID>
            <IS-REENTRANT>true</IS-REENTRANT>
            <IS-SYNCHRONOUS>true</IS-SYNCHRONOUS>
            <CALL-TYPE>REGULAR</CALL-TYPE>
            <EXECUTION-CONTEXT>TASK</EXECUTION-CONTEXT>
            <SW-SERVICE-IMPL-POLICY>STANDARD</SW-SERVICE-IMPL-POLICY>
            <ARGUMENTS>
              <SW-SERVICE-ARG>
                <SHORT-NAME>versionInfoPtr</SHORT-NAME>
                <CATEGORY>DATA_REFERENCE</CATEGORY>
                <SW-DATA-DEF-PROPS>
                  <SW-DATA-DEF-PROPS-VARIANTS>
                    <SW-DATA-DEF-PROPS-CONDITIONAL>
                      <SW-POINTER-TARGET-PROPS>
                        <TARGET-CATEGORY>TYPE_REFERENCE</TARGET-CATEGORY>
                        <SW-DATA-DEF-PROPS>
                          <SW-DATA-DEF-PROPS-VARIANTS>
                            <SW-DATA-DEF-PROPS-CONDITIONAL>
                              <IMPLEMENTATION-DATA-TYPE-REF DEST="IMPLEMENTATION-DATA-TYPE">/AUTOSAR_Std/ImplementationDataTypes/Std_VersionInfoType</IMPLEMENTATION-DATA-TYPE-REF>
                            </SW-DATA-DEF-PROPS-CONDITIONAL>
                          </SW-DATA-DEF-PROPS-VARIANTS>
                        </SW-DATA-DEF-PROPS>
                      </SW-POINTER-TARGET-PROPS>
                    </SW-DATA-DEF-PROPS-CONDITIONAL>
                  </SW-DATA-DEF-PROPS-VARIANTS>
                </SW-DATA-DEF-PROPS>
              </SW-SERVICE-ARG>
            </ARGUMENTS>
          </BSW-MODULE-ENTRY>
[!ENDIF!][!//
[!IF "$Mcu_InitClock_Xpath = 'true'"!]
          <BSW-MODULE-ENTRY>
            <SHORT-NAME>Mcu_InitClock</SHORT-NAME>
            <SERVICE-ID>2</SERVICE-ID>
            <IS-REENTRANT>false</IS-REENTRANT>
            <IS-SYNCHRONOUS>true</IS-SYNCHRONOUS>
            <CALL-TYPE>REGULAR</CALL-TYPE>
            <EXECUTION-CONTEXT>TASK</EXECUTION-CONTEXT>
            <SW-SERVICE-IMPL-POLICY>STANDARD</SW-SERVICE-IMPL-POLICY>
            <RETURN-TYPE>
              <SHORT-NAME>Return</SHORT-NAME>
              <CATEGORY>TYPE_REFERENCE</CATEGORY>
              <SW-DATA-DEF-PROPS>
                <SW-DATA-DEF-PROPS-VARIANTS>
                  <SW-DATA-DEF-PROPS-CONDITIONAL>
                    <IMPLEMENTATION-DATA-TYPE-REF DEST="IMPLEMENTATION-DATA-TYPE">/AUTOSAR_Std/ImplementationDataTypes/Std_ReturnType</IMPLEMENTATION-DATA-TYPE-REF>
                  </SW-DATA-DEF-PROPS-CONDITIONAL>
                </SW-DATA-DEF-PROPS-VARIANTS>
              </SW-DATA-DEF-PROPS>
            </RETURN-TYPE>
            <ARGUMENTS>
              <SW-SERVICE-ARG>
                <SHORT-NAME>ClockSetting</SHORT-NAME>
                <CATEGORY>TYPE_REFERENCE</CATEGORY>
                <SW-DATA-DEF-PROPS>
                  <SW-DATA-DEF-PROPS-VARIANTS>
                    <SW-DATA-DEF-PROPS-CONDITIONAL>
                      <IMPLEMENTATION-DATA-TYPE-REF DEST="IMPLEMENTATION-DATA-TYPE">/AUTOSAR_Mcu/ImplementationDataTypes/Mcu_ClockType</IMPLEMENTATION-DATA-TYPE-REF>
                    </SW-DATA-DEF-PROPS-CONDITIONAL>
                  </SW-DATA-DEF-PROPS-VARIANTS>
                </SW-DATA-DEF-PROPS>
              </SW-SERVICE-ARG>
            </ARGUMENTS>
          </BSW-MODULE-ENTRY>
[!ENDIF!][!//
          <BSW-MODULE-ENTRY>
            <SHORT-NAME>Mcu_InitRamSection</SHORT-NAME>
            <SERVICE-ID>1</SERVICE-ID>
            <IS-REENTRANT>true</IS-REENTRANT>
            <IS-SYNCHRONOUS>true</IS-SYNCHRONOUS>
            <CALL-TYPE>REGULAR</CALL-TYPE>
            <EXECUTION-CONTEXT>TASK</EXECUTION-CONTEXT>
            <SW-SERVICE-IMPL-POLICY>STANDARD</SW-SERVICE-IMPL-POLICY>
            <RETURN-TYPE>
              <SHORT-NAME>Return</SHORT-NAME>
              <CATEGORY>TYPE_REFERENCE</CATEGORY>
              <SW-DATA-DEF-PROPS>
                <SW-DATA-DEF-PROPS-VARIANTS>
                  <SW-DATA-DEF-PROPS-CONDITIONAL>
                    <IMPLEMENTATION-DATA-TYPE-REF DEST="IMPLEMENTATION-DATA-TYPE">/AUTOSAR_Std/ImplementationDataTypes/Std_ReturnType</IMPLEMENTATION-DATA-TYPE-REF>
                  </SW-DATA-DEF-PROPS-CONDITIONAL>
                </SW-DATA-DEF-PROPS-VARIANTS>
              </SW-DATA-DEF-PROPS>
            </RETURN-TYPE>
            <ARGUMENTS>
              <SW-SERVICE-ARG>
                <SHORT-NAME>RamSection</SHORT-NAME>
                <CATEGORY>TYPE_REFERENCE</CATEGORY>
                <SW-DATA-DEF-PROPS>
                  <SW-DATA-DEF-PROPS-VARIANTS>
                    <SW-DATA-DEF-PROPS-CONDITIONAL>
                      <IMPLEMENTATION-DATA-TYPE-REF DEST="IMPLEMENTATION-DATA-TYPE">/AUTOSAR_Mcu/ImplementationDataTypes/Mcu_RamSectionType</IMPLEMENTATION-DATA-TYPE-REF>
                    </SW-DATA-DEF-PROPS-CONDITIONAL>
                  </SW-DATA-DEF-PROPS-VARIANTS>
                </SW-DATA-DEF-PROPS>
              </SW-SERVICE-ARG>
            </ARGUMENTS>
          </BSW-MODULE-ENTRY>
[!IF "$Mcu_PerformReset_Xpath = 'true'"!]
          <BSW-MODULE-ENTRY>
            <SHORT-NAME>Mcu_PerformReset</SHORT-NAME>
            <SERVICE-ID>7</SERVICE-ID>
            <IS-REENTRANT>true</IS-REENTRANT>
            <IS-SYNCHRONOUS>true</IS-SYNCHRONOUS>
            <CALL-TYPE>REGULAR</CALL-TYPE>
            <EXECUTION-CONTEXT>TASK</EXECUTION-CONTEXT>
            <SW-SERVICE-IMPL-POLICY>STANDARD</SW-SERVICE-IMPL-POLICY>
          </BSW-MODULE-ENTRY>
[!ENDIF!][!//
          <BSW-MODULE-ENTRY>
            <SHORT-NAME>Mcu_SetMode</SHORT-NAME>
            <SERVICE-ID>8</SERVICE-ID>
            <IS-REENTRANT>false</IS-REENTRANT>
            <IS-SYNCHRONOUS>true</IS-SYNCHRONOUS>
            <CALL-TYPE>REGULAR</CALL-TYPE>
            <EXECUTION-CONTEXT>TASK</EXECUTION-CONTEXT>
            <SW-SERVICE-IMPL-POLICY>STANDARD</SW-SERVICE-IMPL-POLICY>
            <ARGUMENTS>
              <SW-SERVICE-ARG>
                <SHORT-NAME>McuMode</SHORT-NAME>
                <CATEGORY>TYPE_REFERENCE</CATEGORY>
                <SW-DATA-DEF-PROPS>
                  <SW-DATA-DEF-PROPS-VARIANTS>
                    <SW-DATA-DEF-PROPS-CONDITIONAL>
                      <IMPLEMENTATION-DATA-TYPE-REF DEST="IMPLEMENTATION-DATA-TYPE">/AUTOSAR_Mcu/ImplementationDataTypes/Mcu_ModeType</IMPLEMENTATION-DATA-TYPE-REF>
                    </SW-DATA-DEF-PROPS-CONDITIONAL>
                  </SW-DATA-DEF-PROPS-VARIANTS>
                </SW-DATA-DEF-PROPS>
              </SW-SERVICE-ARG>
            </ARGUMENTS>
          </BSW-MODULE-ENTRY>
[!IF "$Mcu_ClockFailureNotification_Xpath = 'true'"!]
          <BSW-MODULE-ENTRY>
            <SHORT-NAME>Mcu_ClockFailureNotification</SHORT-NAME>
            <SERVICE-ID>255</SERVICE-ID>
            <IS-REENTRANT>true</IS-REENTRANT>
            <IS-SYNCHRONOUS>true</IS-SYNCHRONOUS>
            <CALL-TYPE>REGULAR</CALL-TYPE>
            <EXECUTION-CONTEXT>TASK</EXECUTION-CONTEXT>
            <SW-SERVICE-IMPL-POLICY>STANDARD</SW-SERVICE-IMPL-POLICY>
          </BSW-MODULE-ENTRY>
[!ENDIF!][!//
[!IF "$Mcu_DistributePllClock_Xpath = 'true'"!]
          <BSW-MODULE-ENTRY>
            <SHORT-NAME>Mcu_DistributePllClock</SHORT-NAME>
            <SERVICE-ID>3</SERVICE-ID>
            <IS-REENTRANT>false</IS-REENTRANT>
            <IS-SYNCHRONOUS>true</IS-SYNCHRONOUS>
            <CALL-TYPE>REGULAR</CALL-TYPE>
            <EXECUTION-CONTEXT>TASK</EXECUTION-CONTEXT>
            <SW-SERVICE-IMPL-POLICY>STANDARD</SW-SERVICE-IMPL-POLICY>
            <RETURN-TYPE>
              <SHORT-NAME>Return</SHORT-NAME>
              <CATEGORY>TYPE_REFERENCE</CATEGORY>
              <SW-DATA-DEF-PROPS>
                <SW-DATA-DEF-PROPS-VARIANTS>
                  <SW-DATA-DEF-PROPS-CONDITIONAL>
                    <IMPLEMENTATION-DATA-TYPE-REF DEST="IMPLEMENTATION-DATA-TYPE">/AUTOSAR_Std/ImplementationDataTypes/Std_ReturnType</IMPLEMENTATION-DATA-TYPE-REF>
                  </SW-DATA-DEF-PROPS-CONDITIONAL>
                </SW-DATA-DEF-PROPS-VARIANTS>
              </SW-DATA-DEF-PROPS>
            </RETURN-TYPE>
          </BSW-MODULE-ENTRY>
[!ENDIF!][!//
          <BSW-MODULE-ENTRY>
            <SHORT-NAME>Mcu_GetPllStatus</SHORT-NAME>
            <SERVICE-ID>4</SERVICE-ID>
            <IS-REENTRANT>true</IS-REENTRANT>
            <IS-SYNCHRONOUS>true</IS-SYNCHRONOUS>
            <CALL-TYPE>REGULAR</CALL-TYPE>
            <EXECUTION-CONTEXT>TASK</EXECUTION-CONTEXT>
            <SW-SERVICE-IMPL-POLICY>STANDARD</SW-SERVICE-IMPL-POLICY>
            <RETURN-TYPE>
              <SHORT-NAME>Return</SHORT-NAME>
              <CATEGORY>TYPE_REFERENCE</CATEGORY>
              <SW-DATA-DEF-PROPS>
                <SW-DATA-DEF-PROPS-VARIANTS>
                  <SW-DATA-DEF-PROPS-CONDITIONAL>
                    <IMPLEMENTATION-DATA-TYPE-REF DEST="IMPLEMENTATION-DATA-TYPE">/AUTOSAR_Mcu/ImplementationDataTypes/Mcu_PllStatusType</IMPLEMENTATION-DATA-TYPE-REF>
                    <ADDITIONAL-NATIVE-TYPE-QUALIFIER>enum</ADDITIONAL-NATIVE-TYPE-QUALIFIER>
                  </SW-DATA-DEF-PROPS-CONDITIONAL>
                </SW-DATA-DEF-PROPS-VARIANTS>
              </SW-DATA-DEF-PROPS>
            </RETURN-TYPE>
          </BSW-MODULE-ENTRY>
          <BSW-MODULE-ENTRY>
            <SHORT-NAME>Mcu_GetResetRawValue</SHORT-NAME>
            <SERVICE-ID>6</SERVICE-ID>
            <IS-REENTRANT>true</IS-REENTRANT>
            <IS-SYNCHRONOUS>true</IS-SYNCHRONOUS>
            <CALL-TYPE>REGULAR</CALL-TYPE>
            <EXECUTION-CONTEXT>TASK</EXECUTION-CONTEXT>
            <SW-SERVICE-IMPL-POLICY>STANDARD</SW-SERVICE-IMPL-POLICY>
            <RETURN-TYPE>
              <SHORT-NAME>Return</SHORT-NAME>
              <CATEGORY>TYPE_REFERENCE</CATEGORY>
              <SW-DATA-DEF-PROPS>
                <SW-DATA-DEF-PROPS-VARIANTS>
                  <SW-DATA-DEF-PROPS-CONDITIONAL>
                    <IMPLEMENTATION-DATA-TYPE-REF DEST="IMPLEMENTATION-DATA-TYPE">/AUTOSAR_Mcu/ImplementationDataTypes/Mcu_RawResetType</IMPLEMENTATION-DATA-TYPE-REF>
                  </SW-DATA-DEF-PROPS-CONDITIONAL>
                </SW-DATA-DEF-PROPS-VARIANTS>
              </SW-DATA-DEF-PROPS>
            </RETURN-TYPE>
          </BSW-MODULE-ENTRY>
          <BSW-MODULE-ENTRY>
            <SHORT-NAME>Mcu_GetResetReason</SHORT-NAME>
            <SERVICE-ID>5</SERVICE-ID>
            <IS-REENTRANT>true</IS-REENTRANT>
            <IS-SYNCHRONOUS>true</IS-SYNCHRONOUS>
            <CALL-TYPE>REGULAR</CALL-TYPE>
            <EXECUTION-CONTEXT>TASK</EXECUTION-CONTEXT>
            <SW-SERVICE-IMPL-POLICY>STANDARD</SW-SERVICE-IMPL-POLICY>
            <RETURN-TYPE>
              <SHORT-NAME>Return</SHORT-NAME>
              <CATEGORY>TYPE_REFERENCE</CATEGORY>
              <SW-DATA-DEF-PROPS>
                <SW-DATA-DEF-PROPS-VARIANTS>
                  <SW-DATA-DEF-PROPS-CONDITIONAL>
                    <IMPLEMENTATION-DATA-TYPE-REF DEST="IMPLEMENTATION-DATA-TYPE">/AUTOSAR_Mcu/ImplementationDataTypes/Mcu_ResetType</IMPLEMENTATION-DATA-TYPE-REF>
                    <ADDITIONAL-NATIVE-TYPE-QUALIFIER>enum</ADDITIONAL-NATIVE-TYPE-QUALIFIER>
                  </SW-DATA-DEF-PROPS-CONDITIONAL>
                </SW-DATA-DEF-PROPS-VARIANTS>
              </SW-DATA-DEF-PROPS>
            </RETURN-TYPE>
          </BSW-MODULE-ENTRY>
[!IF "$Mcu_GetRamStateApi_Xpath = 'true'"!]
          <BSW-MODULE-ENTRY>
            <SHORT-NAME>Mcu_GetRamState</SHORT-NAME>
            <SERVICE-ID>10</SERVICE-ID>
            <IS-REENTRANT>true</IS-REENTRANT>
            <IS-SYNCHRONOUS>true</IS-SYNCHRONOUS>
            <CALL-TYPE>REGULAR</CALL-TYPE>
            <EXECUTION-CONTEXT>TASK</EXECUTION-CONTEXT>
            <SW-SERVICE-IMPL-POLICY>STANDARD</SW-SERVICE-IMPL-POLICY>
            <RETURN-TYPE>
              <SHORT-NAME>Return</SHORT-NAME>
              <CATEGORY>TYPE_REFERENCE</CATEGORY>
              <SW-DATA-DEF-PROPS>
                <SW-DATA-DEF-PROPS-VARIANTS>
                  <SW-DATA-DEF-PROPS-CONDITIONAL>
                    <IMPLEMENTATION-DATA-TYPE-REF DEST="IMPLEMENTATION-DATA-TYPE">/AUTOSAR_Mcu/ImplementationDataTypes/Mcu_RamStateType</IMPLEMENTATION-DATA-TYPE-REF>
                  </SW-DATA-DEF-PROPS-CONDITIONAL>
                </SW-DATA-DEF-PROPS-VARIANTS>
              </SW-DATA-DEF-PROPS>
            </RETURN-TYPE>
          </BSW-MODULE-ENTRY>
[!ENDIF!][!//
[!IF "$Mcu_ClearColdReset_Xpath = 'true'"!]
          <BSW-MODULE-ENTRY>
            <SHORT-NAME>Mcu_ClearColdResetStatus</SHORT-NAME>
            <SERVICE-ID>80</SERVICE-ID>
            <IS-REENTRANT>true</IS-REENTRANT>
            <IS-SYNCHRONOUS>true</IS-SYNCHRONOUS>
            <CALL-TYPE>REGULAR</CALL-TYPE>
            <EXECUTION-CONTEXT>TASK</EXECUTION-CONTEXT>
            <SW-SERVICE-IMPL-POLICY>STANDARD</SW-SERVICE-IMPL-POLICY>
          </BSW-MODULE-ENTRY>
[!ENDIF!][!//
[!IF "$Mcu_LowPowerModeApis_Xpath = 'true'"!]
          <BSW-MODULE-ENTRY>
            <SHORT-NAME>Mcu_GetCpuIdleModeInitiator</SHORT-NAME>
            <SERVICE-ID>52</SERVICE-ID>
            <IS-REENTRANT>true</IS-REENTRANT>
            <IS-SYNCHRONOUS>true</IS-SYNCHRONOUS>
            <CALL-TYPE>REGULAR</CALL-TYPE>
            <EXECUTION-CONTEXT>TASK</EXECUTION-CONTEXT>
            <SW-SERVICE-IMPL-POLICY>STANDARD</SW-SERVICE-IMPL-POLICY>
            <RETURN-TYPE>
              <SHORT-NAME>Return</SHORT-NAME>
              <CATEGORY>TYPE_REFERENCE</CATEGORY>
              <SW-DATA-DEF-PROPS>
                <SW-DATA-DEF-PROPS-VARIANTS>
                  <SW-DATA-DEF-PROPS-CONDITIONAL>
                    <IMPLEMENTATION-DATA-TYPE-REF DEST="IMPLEMENTATION-DATA-TYPE">/AUTOSAR_Platform/ImplementationDataTypes/uint32</IMPLEMENTATION-DATA-TYPE-REF>
                  </SW-DATA-DEF-PROPS-CONDITIONAL>
                </SW-DATA-DEF-PROPS-VARIANTS>
              </SW-DATA-DEF-PROPS>
            </RETURN-TYPE>
          </BSW-MODULE-ENTRY>
          <BSW-MODULE-ENTRY>
            <SHORT-NAME>Mcu_GetCpuState</SHORT-NAME>
            <SERVICE-ID>83</SERVICE-ID>
            <IS-REENTRANT>true</IS-REENTRANT>
            <IS-SYNCHRONOUS>true</IS-SYNCHRONOUS>
            <CALL-TYPE>REGULAR</CALL-TYPE>
            <EXECUTION-CONTEXT>TASK</EXECUTION-CONTEXT>
            <SW-SERVICE-IMPL-POLICY>STANDARD</SW-SERVICE-IMPL-POLICY>
            <RETURN-TYPE>
              <SHORT-NAME>Return</SHORT-NAME>
              <CATEGORY>TYPE_REFERENCE</CATEGORY>
              <SW-DATA-DEF-PROPS>
                <SW-DATA-DEF-PROPS-VARIANTS>
                  <SW-DATA-DEF-PROPS-CONDITIONAL>
                    <IMPLEMENTATION-DATA-TYPE-REF DEST="IMPLEMENTATION-DATA-TYPE">/AUTOSAR_Mcu/ImplementationDataTypes/Mcu_CpuModeType</IMPLEMENTATION-DATA-TYPE-REF>
                    <ADDITIONAL-NATIVE-TYPE-QUALIFIER>enum</ADDITIONAL-NATIVE-TYPE-QUALIFIER>
                  </SW-DATA-DEF-PROPS-CONDITIONAL>
                </SW-DATA-DEF-PROPS-VARIANTS>
              </SW-DATA-DEF-PROPS>
            </RETURN-TYPE>
            <ARGUMENTS>
              <SW-SERVICE-ARG>
                <SHORT-NAME>CpuId</SHORT-NAME>
                <CATEGORY>TYPE_REFERENCE</CATEGORY>
                <SW-DATA-DEF-PROPS>
                  <SW-DATA-DEF-PROPS-VARIANTS>
                    <SW-DATA-DEF-PROPS-CONDITIONAL>
                      <IMPLEMENTATION-DATA-TYPE-REF DEST="IMPLEMENTATION-DATA-TYPE">/AUTOSAR_Mcu/ImplementationDataTypes/Mcu_CpuIdType</IMPLEMENTATION-DATA-TYPE-REF>
                      <ADDITIONAL-NATIVE-TYPE-QUALIFIER>enum</ADDITIONAL-NATIVE-TYPE-QUALIFIER>
                    </SW-DATA-DEF-PROPS-CONDITIONAL>
                  </SW-DATA-DEF-PROPS-VARIANTS>
                </SW-DATA-DEF-PROPS>
              </SW-SERVICE-ARG>
            </ARGUMENTS>
          </BSW-MODULE-ENTRY>
          <BSW-MODULE-ENTRY>
            <SHORT-NAME>Mcu_GetWakeupCause</SHORT-NAME>
            <SERVICE-ID>84</SERVICE-ID>
            <IS-REENTRANT>true</IS-REENTRANT>
            <IS-SYNCHRONOUS>true</IS-SYNCHRONOUS>
            <CALL-TYPE>REGULAR</CALL-TYPE>
            <EXECUTION-CONTEXT>TASK</EXECUTION-CONTEXT>
            <SW-SERVICE-IMPL-POLICY>STANDARD</SW-SERVICE-IMPL-POLICY>
            <RETURN-TYPE>
              <SHORT-NAME>Return</SHORT-NAME>
              <CATEGORY>TYPE_REFERENCE</CATEGORY>
              <SW-DATA-DEF-PROPS>
                <SW-DATA-DEF-PROPS-VARIANTS>
                  <SW-DATA-DEF-PROPS-CONDITIONAL>
                    <IMPLEMENTATION-DATA-TYPE-REF DEST="IMPLEMENTATION-DATA-TYPE">/AUTOSAR_Platform/ImplementationDataTypes/uint32</IMPLEMENTATION-DATA-TYPE-REF>
                  </SW-DATA-DEF-PROPS-CONDITIONAL>
                </SW-DATA-DEF-PROPS-VARIANTS>
              </SW-DATA-DEF-PROPS>
            </RETURN-TYPE>
          </BSW-MODULE-ENTRY>
          <BSW-MODULE-ENTRY>
            <SHORT-NAME>Mcu_ClearWakeupCause</SHORT-NAME>
            <SERVICE-ID>85</SERVICE-ID>
            <IS-REENTRANT>true</IS-REENTRANT>
            <IS-SYNCHRONOUS>true</IS-SYNCHRONOUS>
            <CALL-TYPE>REGULAR</CALL-TYPE>
            <EXECUTION-CONTEXT>TASK</EXECUTION-CONTEXT>
            <SW-SERVICE-IMPL-POLICY>STANDARD</SW-SERVICE-IMPL-POLICY>
            <ARGUMENTS>
              <SW-SERVICE-ARG>
                <SHORT-NAME>WakeupCause</SHORT-NAME>
                <CATEGORY>TYPE_REFERENCE</CATEGORY>
                <SW-DATA-DEF-PROPS>
                  <SW-DATA-DEF-PROPS-VARIANTS>
                    <SW-DATA-DEF-PROPS-CONDITIONAL>
                      <IMPLEMENTATION-DATA-TYPE-REF DEST="IMPLEMENTATION-DATA-TYPE">/AUTOSAR_Platform/ImplementationDataTypes/uint32</IMPLEMENTATION-DATA-TYPE-REF>
                    </SW-DATA-DEF-PROPS-CONDITIONAL>
                  </SW-DATA-DEF-PROPS-VARIANTS>
                </SW-DATA-DEF-PROPS>
              </SW-SERVICE-ARG>
            </ARGUMENTS>
          </BSW-MODULE-ENTRY>
[!ENDIF!][!//
[!IF "$Mcu_TrapApi_Xpath = 'true'"!]
          <BSW-MODULE-ENTRY>
            <SHORT-NAME>Mcu_GetTrapCause</SHORT-NAME>
            <SERVICE-ID>86</SERVICE-ID>
            <IS-REENTRANT>true</IS-REENTRANT>
            <IS-SYNCHRONOUS>true</IS-SYNCHRONOUS>
            <CALL-TYPE>REGULAR</CALL-TYPE>
            <EXECUTION-CONTEXT>TASK</EXECUTION-CONTEXT>
            <SW-SERVICE-IMPL-POLICY>STANDARD</SW-SERVICE-IMPL-POLICY>
            <RETURN-TYPE>
              <SHORT-NAME>Return</SHORT-NAME>
              <CATEGORY>TYPE_REFERENCE</CATEGORY>
              <SW-DATA-DEF-PROPS>
                <SW-DATA-DEF-PROPS-VARIANTS>
                  <SW-DATA-DEF-PROPS-CONDITIONAL>
                    <IMPLEMENTATION-DATA-TYPE-REF DEST="IMPLEMENTATION-DATA-TYPE">/AUTOSAR_Platform/ImplementationDataTypes/uint32</IMPLEMENTATION-DATA-TYPE-REF>
                  </SW-DATA-DEF-PROPS-CONDITIONAL>
                </SW-DATA-DEF-PROPS-VARIANTS>
              </SW-DATA-DEF-PROPS>
            </RETURN-TYPE>
          </BSW-MODULE-ENTRY>
          <BSW-MODULE-ENTRY>
            <SHORT-NAME>Mcu_SetTrapRequest</SHORT-NAME>
            <SERVICE-ID>87</SERVICE-ID>
            <IS-REENTRANT>true</IS-REENTRANT>
            <IS-SYNCHRONOUS>true</IS-SYNCHRONOUS>
            <CALL-TYPE>REGULAR</CALL-TYPE>
            <EXECUTION-CONTEXT>TASK</EXECUTION-CONTEXT>
            <SW-SERVICE-IMPL-POLICY>STANDARD</SW-SERVICE-IMPL-POLICY>
            <ARGUMENTS>
              <SW-SERVICE-ARG>
                <SHORT-NAME>TrapRequestId</SHORT-NAME>
                <CATEGORY>TYPE_REFERENCE</CATEGORY>
                <SW-DATA-DEF-PROPS>
                  <SW-DATA-DEF-PROPS-VARIANTS>
                    <SW-DATA-DEF-PROPS-CONDITIONAL>
                      <IMPLEMENTATION-DATA-TYPE-REF DEST="IMPLEMENTATION-DATA-TYPE">/AUTOSAR_Mcu/ImplementationDataTypes/Mcu_TrapRequestType</IMPLEMENTATION-DATA-TYPE-REF>
                      <ADDITIONAL-NATIVE-TYPE-QUALIFIER>enum</ADDITIONAL-NATIVE-TYPE-QUALIFIER>
                    </SW-DATA-DEF-PROPS-CONDITIONAL>
                  </SW-DATA-DEF-PROPS-VARIANTS>
                </SW-DATA-DEF-PROPS>
              </SW-SERVICE-ARG>
            </ARGUMENTS>
          </BSW-MODULE-ENTRY>
          <BSW-MODULE-ENTRY>
            <SHORT-NAME>Mcu_ClearTrapRequest</SHORT-NAME>
            <SERVICE-ID>88</SERVICE-ID>
            <IS-REENTRANT>true</IS-REENTRANT>
            <IS-SYNCHRONOUS>true</IS-SYNCHRONOUS>
            <CALL-TYPE>REGULAR</CALL-TYPE>
            <EXECUTION-CONTEXT>TASK</EXECUTION-CONTEXT>
            <SW-SERVICE-IMPL-POLICY>STANDARD</SW-SERVICE-IMPL-POLICY>
            <ARGUMENTS>
              <SW-SERVICE-ARG>
                <SHORT-NAME>TrapRequestId</SHORT-NAME>
                <CATEGORY>TYPE_REFERENCE</CATEGORY>
                <SW-DATA-DEF-PROPS>
                  <SW-DATA-DEF-PROPS-VARIANTS>
                    <SW-DATA-DEF-PROPS-CONDITIONAL>
                      <IMPLEMENTATION-DATA-TYPE-REF DEST="IMPLEMENTATION-DATA-TYPE">/AUTOSAR_Mcu/ImplementationDataTypes/Mcu_TrapRequestType</IMPLEMENTATION-DATA-TYPE-REF>
                      <ADDITIONAL-NATIVE-TYPE-QUALIFIER>enum</ADDITIONAL-NATIVE-TYPE-QUALIFIER>
                    </SW-DATA-DEF-PROPS-CONDITIONAL>
                  </SW-DATA-DEF-PROPS-VARIANTS>
                </SW-DATA-DEF-PROPS>
              </SW-SERVICE-ARG>
            </ARGUMENTS>
          </BSW-MODULE-ENTRY>
[!ENDIF!][!//
[!IF "$Mcu_CcuconApi_Xpath = 'true'"!]
          <BSW-MODULE-ENTRY>
            <SHORT-NAME>Mcu_UpdateCpuCcuconReg</SHORT-NAME>
            <SERVICE-ID>89</SERVICE-ID>
            <IS-REENTRANT>true</IS-REENTRANT>
            <IS-SYNCHRONOUS>true</IS-SYNCHRONOUS>
            <CALL-TYPE>REGULAR</CALL-TYPE>
            <EXECUTION-CONTEXT>TASK</EXECUTION-CONTEXT>
            <SW-SERVICE-IMPL-POLICY>STANDARD</SW-SERVICE-IMPL-POLICY>
            <ARGUMENTS>
              <SW-SERVICE-ARG>
                <SHORT-NAME>CpuId</SHORT-NAME>
                <CATEGORY>TYPE_REFERENCE</CATEGORY>
                <SW-DATA-DEF-PROPS>
                  <SW-DATA-DEF-PROPS-VARIANTS>
                    <SW-DATA-DEF-PROPS-CONDITIONAL>
                      <IMPLEMENTATION-DATA-TYPE-REF DEST="IMPLEMENTATION-DATA-TYPE">/AUTOSAR_Mcu/ImplementationDataTypes/Mcu_CpuIdType</IMPLEMENTATION-DATA-TYPE-REF>
                      <ADDITIONAL-NATIVE-TYPE-QUALIFIER>enum</ADDITIONAL-NATIVE-TYPE-QUALIFIER>
                    </SW-DATA-DEF-PROPS-CONDITIONAL>
                  </SW-DATA-DEF-PROPS-VARIANTS>
                </SW-DATA-DEF-PROPS>
              </SW-SERVICE-ARG>
              <SW-SERVICE-ARG>
                <SHORT-NAME>DivVal</SHORT-NAME>
                <CATEGORY>TYPE_REFERENCE</CATEGORY>
                <SW-DATA-DEF-PROPS>
                  <SW-DATA-DEF-PROPS-VARIANTS>
                    <SW-DATA-DEF-PROPS-CONDITIONAL>
                      <IMPLEMENTATION-DATA-TYPE-REF DEST="IMPLEMENTATION-DATA-TYPE">/AUTOSAR_Platform/ImplementationDataTypes/uint8</IMPLEMENTATION-DATA-TYPE-REF>
                    </SW-DATA-DEF-PROPS-CONDITIONAL>
                  </SW-DATA-DEF-PROPS-VARIANTS>
                </SW-DATA-DEF-PROPS>
              </SW-SERVICE-ARG>
              <SW-SERVICE-ARG>
                <SHORT-NAME>Delay</SHORT-NAME>
                <CATEGORY>TYPE_REFERENCE</CATEGORY>
                <SW-DATA-DEF-PROPS>
                  <SW-DATA-DEF-PROPS-VARIANTS>
                    <SW-DATA-DEF-PROPS-CONDITIONAL>
                      <IMPLEMENTATION-DATA-TYPE-REF DEST="IMPLEMENTATION-DATA-TYPE">/AUTOSAR_Platform/ImplementationDataTypes/uint8</IMPLEMENTATION-DATA-TYPE-REF>
                    </SW-DATA-DEF-PROPS-CONDITIONAL>
                  </SW-DATA-DEF-PROPS-VARIANTS>
                </SW-DATA-DEF-PROPS>
              </SW-SERVICE-ARG>
            </ARGUMENTS>
          </BSW-MODULE-ENTRY>
[!ENDIF!][!//
[!IF "$Mcu_GtmIpAvailable_Xpath = 'true'"!]
          <BSW-MODULE-ENTRY>
            <SHORT-NAME>Mcu_17_Gtm_TomChannelInit</SHORT-NAME>
            <INTRODUCTION>
              <NOTE SI="Mcu_17_Gtm_TomChannelInit is reentrant for other channels" NOTE-TYPE="HINT" />
            </INTRODUCTION>
            <SERVICE-ID>96</SERVICE-ID>
            <IS-REENTRANT>true</IS-REENTRANT>
            <IS-SYNCHRONOUS>true</IS-SYNCHRONOUS>
            <CALL-TYPE>REGULAR</CALL-TYPE>
            <EXECUTION-CONTEXT>TASK</EXECUTION-CONTEXT>
            <SW-SERVICE-IMPL-POLICY>STANDARD</SW-SERVICE-IMPL-POLICY>
            <ARGUMENTS>
              <SW-SERVICE-ARG>
                <SHORT-NAME>ConfigPtr</SHORT-NAME>
                <CATEGORY>DATA_REFERENCE</CATEGORY>
                <SW-DATA-DEF-PROPS>
                  <SW-DATA-DEF-PROPS-VARIANTS>
                    <SW-DATA-DEF-PROPS-CONDITIONAL>
                      <SW-POINTER-TARGET-PROPS>
                        <TARGET-CATEGORY>TYPE_REFERENCE</TARGET-CATEGORY>
                        <SW-DATA-DEF-PROPS>
                          <SW-DATA-DEF-PROPS-VARIANTS>
                            <SW-DATA-DEF-PROPS-CONDITIONAL>
                              <IMPLEMENTATION-DATA-TYPE-REF DEST="IMPLEMENTATION-DATA-TYPE">/AUTOSAR_Mcu/ImplementationDataTypes/Mcu_17_Gtm_TomAtomChConfigType</IMPLEMENTATION-DATA-TYPE-REF>
                            </SW-DATA-DEF-PROPS-CONDITIONAL>
                          </SW-DATA-DEF-PROPS-VARIANTS>
                        </SW-DATA-DEF-PROPS>
                      </SW-POINTER-TARGET-PROPS>
                    </SW-DATA-DEF-PROPS-CONDITIONAL>
                  </SW-DATA-DEF-PROPS-VARIANTS>
                </SW-DATA-DEF-PROPS>
              </SW-SERVICE-ARG>
            </ARGUMENTS>
          </BSW-MODULE-ENTRY>
          <BSW-MODULE-ENTRY>
            <SHORT-NAME>Mcu_17_Gtm_TomChannelShadowTransfer</SHORT-NAME>
            <SERVICE-ID>97</SERVICE-ID>
            <IS-REENTRANT>false</IS-REENTRANT>
            <IS-SYNCHRONOUS>true</IS-SYNCHRONOUS>
            <CALL-TYPE>REGULAR</CALL-TYPE>
            <EXECUTION-CONTEXT>TASK</EXECUTION-CONTEXT>
            <SW-SERVICE-IMPL-POLICY>STANDARD</SW-SERVICE-IMPL-POLICY>
            <ARGUMENTS>
              <SW-SERVICE-ARG>
                <SHORT-NAME>Module</SHORT-NAME>
                <CATEGORY>TYPE_REFERENCE</CATEGORY>
                <SW-DATA-DEF-PROPS>
                  <SW-DATA-DEF-PROPS-VARIANTS>
                    <SW-DATA-DEF-PROPS-CONDITIONAL>
                      <IMPLEMENTATION-DATA-TYPE-REF DEST="IMPLEMENTATION-DATA-TYPE">/AUTOSAR_Platform/ImplementationDataTypes/uint8</IMPLEMENTATION-DATA-TYPE-REF>
                    </SW-DATA-DEF-PROPS-CONDITIONAL>
                  </SW-DATA-DEF-PROPS-VARIANTS>
                </SW-DATA-DEF-PROPS>
              </SW-SERVICE-ARG>
              <SW-SERVICE-ARG>
                <SHORT-NAME>Channel</SHORT-NAME>
                <CATEGORY>TYPE_REFERENCE</CATEGORY>
                <SW-DATA-DEF-PROPS>
                  <SW-DATA-DEF-PROPS-VARIANTS>
                    <SW-DATA-DEF-PROPS-CONDITIONAL>
                      <IMPLEMENTATION-DATA-TYPE-REF DEST="IMPLEMENTATION-DATA-TYPE">/AUTOSAR_Platform/ImplementationDataTypes/uint8</IMPLEMENTATION-DATA-TYPE-REF>
                    </SW-DATA-DEF-PROPS-CONDITIONAL>
                  </SW-DATA-DEF-PROPS-VARIANTS>
                </SW-DATA-DEF-PROPS>
              </SW-SERVICE-ARG>
            </ARGUMENTS>
          </BSW-MODULE-ENTRY>
          <BSW-MODULE-ENTRY>
            <SHORT-NAME>Mcu_17_Gtm_TomChannelDeInit</SHORT-NAME>
            <INTRODUCTION>
              <NOTE SI="Mcu_17_Gtm_TomChannelDeInit is reentrant for other channels" NOTE-TYPE="HINT" />
            </INTRODUCTION>
            <SERVICE-ID>99</SERVICE-ID>
            <IS-REENTRANT>true</IS-REENTRANT>
            <IS-SYNCHRONOUS>true</IS-SYNCHRONOUS>
            <CALL-TYPE>REGULAR</CALL-TYPE>
            <EXECUTION-CONTEXT>TASK</EXECUTION-CONTEXT>
            <SW-SERVICE-IMPL-POLICY>STANDARD</SW-SERVICE-IMPL-POLICY>
            <ARGUMENTS>
              <SW-SERVICE-ARG>
                <SHORT-NAME>Module</SHORT-NAME>
                <CATEGORY>TYPE_REFERENCE</CATEGORY>
                <SW-DATA-DEF-PROPS>
                  <SW-DATA-DEF-PROPS-VARIANTS>
                    <SW-DATA-DEF-PROPS-CONDITIONAL>
                      <IMPLEMENTATION-DATA-TYPE-REF DEST="IMPLEMENTATION-DATA-TYPE">/AUTOSAR_Platform/ImplementationDataTypes/uint8</IMPLEMENTATION-DATA-TYPE-REF>
                    </SW-DATA-DEF-PROPS-CONDITIONAL>
                  </SW-DATA-DEF-PROPS-VARIANTS>
                </SW-DATA-DEF-PROPS>
              </SW-SERVICE-ARG>
              <SW-SERVICE-ARG>
                <SHORT-NAME>Channel</SHORT-NAME>
                <CATEGORY>TYPE_REFERENCE</CATEGORY>
                <SW-DATA-DEF-PROPS>
                  <SW-DATA-DEF-PROPS-VARIANTS>
                    <SW-DATA-DEF-PROPS-CONDITIONAL>
                      <IMPLEMENTATION-DATA-TYPE-REF DEST="IMPLEMENTATION-DATA-TYPE">/AUTOSAR_Platform/ImplementationDataTypes/uint8</IMPLEMENTATION-DATA-TYPE-REF>
                    </SW-DATA-DEF-PROPS-CONDITIONAL>
                  </SW-DATA-DEF-PROPS-VARIANTS>
                </SW-DATA-DEF-PROPS>
              </SW-SERVICE-ARG>
            </ARGUMENTS>
          </BSW-MODULE-ENTRY>
          <BSW-MODULE-ENTRY>
            <SHORT-NAME>Mcu_17_Gtm_TomChannelDisable</SHORT-NAME>
            <INTRODUCTION>
              <NOTE SI="Mcu_17_Gtm_TomChannelDisable is reentrant for other channels" NOTE-TYPE="HINT" />
            </INTRODUCTION>
            <SERVICE-ID>105</SERVICE-ID>
            <IS-REENTRANT>true</IS-REENTRANT>
            <IS-SYNCHRONOUS>true</IS-SYNCHRONOUS>
            <CALL-TYPE>REGULAR</CALL-TYPE>
            <EXECUTION-CONTEXT>TASK</EXECUTION-CONTEXT>
            <SW-SERVICE-IMPL-POLICY>STANDARD</SW-SERVICE-IMPL-POLICY>
            <ARGUMENTS>
              <SW-SERVICE-ARG>
                <SHORT-NAME>Module</SHORT-NAME>
                <CATEGORY>TYPE_REFERENCE</CATEGORY>
                <SW-DATA-DEF-PROPS>
                  <SW-DATA-DEF-PROPS-VARIANTS>
                    <SW-DATA-DEF-PROPS-CONDITIONAL>
                      <IMPLEMENTATION-DATA-TYPE-REF DEST="IMPLEMENTATION-DATA-TYPE">/AUTOSAR_Platform/ImplementationDataTypes/uint8</IMPLEMENTATION-DATA-TYPE-REF>
                    </SW-DATA-DEF-PROPS-CONDITIONAL>
                  </SW-DATA-DEF-PROPS-VARIANTS>
                </SW-DATA-DEF-PROPS>
              </SW-SERVICE-ARG>
              <SW-SERVICE-ARG>
                <SHORT-NAME>Channel</SHORT-NAME>
                <CATEGORY>TYPE_REFERENCE</CATEGORY>
                <SW-DATA-DEF-PROPS>
                  <SW-DATA-DEF-PROPS-VARIANTS>
                    <SW-DATA-DEF-PROPS-CONDITIONAL>
                      <IMPLEMENTATION-DATA-TYPE-REF DEST="IMPLEMENTATION-DATA-TYPE">/AUTOSAR_Platform/ImplementationDataTypes/uint8</IMPLEMENTATION-DATA-TYPE-REF>
                    </SW-DATA-DEF-PROPS-CONDITIONAL>
                  </SW-DATA-DEF-PROPS-VARIANTS>
                </SW-DATA-DEF-PROPS>
              </SW-SERVICE-ARG>
            </ARGUMENTS>
          </BSW-MODULE-ENTRY>
          <BSW-MODULE-ENTRY>
            <SHORT-NAME>Mcu_17_Gtm_TomChannelEnable</SHORT-NAME>
            <INTRODUCTION>
              <NOTE SI="Mcu_17_Gtm_TomChannelEnable is reentrant for other channels" NOTE-TYPE="HINT" />
            </INTRODUCTION>
            <SERVICE-ID>104</SERVICE-ID>
            <IS-REENTRANT>true</IS-REENTRANT>
            <IS-SYNCHRONOUS>true</IS-SYNCHRONOUS>
            <CALL-TYPE>REGULAR</CALL-TYPE>
            <EXECUTION-CONTEXT>TASK</EXECUTION-CONTEXT>
            <SW-SERVICE-IMPL-POLICY>STANDARD</SW-SERVICE-IMPL-POLICY>
            <ARGUMENTS>
              <SW-SERVICE-ARG>
                <SHORT-NAME>Module</SHORT-NAME>
                <CATEGORY>TYPE_REFERENCE</CATEGORY>
                <SW-DATA-DEF-PROPS>
                  <SW-DATA-DEF-PROPS-VARIANTS>
                    <SW-DATA-DEF-PROPS-CONDITIONAL>
                      <IMPLEMENTATION-DATA-TYPE-REF DEST="IMPLEMENTATION-DATA-TYPE">/AUTOSAR_Platform/ImplementationDataTypes/uint8</IMPLEMENTATION-DATA-TYPE-REF>
                    </SW-DATA-DEF-PROPS-CONDITIONAL>
                  </SW-DATA-DEF-PROPS-VARIANTS>
                </SW-DATA-DEF-PROPS>
              </SW-SERVICE-ARG>
              <SW-SERVICE-ARG>
                <SHORT-NAME>Channel</SHORT-NAME>
                <CATEGORY>TYPE_REFERENCE</CATEGORY>
                <SW-DATA-DEF-PROPS>
                  <SW-DATA-DEF-PROPS-VARIANTS>
                    <SW-DATA-DEF-PROPS-CONDITIONAL>
                      <IMPLEMENTATION-DATA-TYPE-REF DEST="IMPLEMENTATION-DATA-TYPE">/AUTOSAR_Platform/ImplementationDataTypes/uint8</IMPLEMENTATION-DATA-TYPE-REF>
                    </SW-DATA-DEF-PROPS-CONDITIONAL>
                  </SW-DATA-DEF-PROPS-VARIANTS>
                </SW-DATA-DEF-PROPS>
              </SW-SERVICE-ARG>
              <SW-SERVICE-ARG>
                <SHORT-NAME>TimerOutputEn</SHORT-NAME>
                <CATEGORY>TYPE_REFERENCE</CATEGORY>
                <SW-DATA-DEF-PROPS>
                  <SW-DATA-DEF-PROPS-VARIANTS>
                    <SW-DATA-DEF-PROPS-CONDITIONAL>
                      <IMPLEMENTATION-DATA-TYPE-REF DEST="IMPLEMENTATION-DATA-TYPE">/AUTOSAR_Mcu/ImplementationDataTypes/Mcu_17_Gtm_TimerOutputEnableType</IMPLEMENTATION-DATA-TYPE-REF>
                    </SW-DATA-DEF-PROPS-CONDITIONAL>
                  </SW-DATA-DEF-PROPS-VARIANTS>
                </SW-DATA-DEF-PROPS>
              </SW-SERVICE-ARG>
            </ARGUMENTS>
          </BSW-MODULE-ENTRY>
          <BSW-MODULE-ENTRY>
            <SHORT-NAME>Mcu_17_Gtm_IsTomChannelEnabled</SHORT-NAME>
            <SERVICE-ID>110</SERVICE-ID>
            <IS-REENTRANT>true</IS-REENTRANT>
            <IS-SYNCHRONOUS>true</IS-SYNCHRONOUS>
            <CALL-TYPE>REGULAR</CALL-TYPE>
            <EXECUTION-CONTEXT>TASK</EXECUTION-CONTEXT>
            <SW-SERVICE-IMPL-POLICY>STANDARD</SW-SERVICE-IMPL-POLICY>
            <RETURN-TYPE>
              <SHORT-NAME>Return</SHORT-NAME>
              <CATEGORY>TYPE_REFERENCE</CATEGORY>
              <SW-DATA-DEF-PROPS>
                <SW-DATA-DEF-PROPS-VARIANTS>
                  <SW-DATA-DEF-PROPS-CONDITIONAL>
                    <IMPLEMENTATION-DATA-TYPE-REF DEST="IMPLEMENTATION-DATA-TYPE">/AUTOSAR_Mcu/ImplementationDataTypes/Mcu_17_Gtm_TimerStatusType</IMPLEMENTATION-DATA-TYPE-REF>
                  </SW-DATA-DEF-PROPS-CONDITIONAL>
                </SW-DATA-DEF-PROPS-VARIANTS>
              </SW-DATA-DEF-PROPS>
            </RETURN-TYPE>
            <ARGUMENTS>
              <SW-SERVICE-ARG>
                <SHORT-NAME>Module</SHORT-NAME>
                <CATEGORY>TYPE_REFERENCE</CATEGORY>
                <SW-DATA-DEF-PROPS>
                  <SW-DATA-DEF-PROPS-VARIANTS>
                    <SW-DATA-DEF-PROPS-CONDITIONAL>
                      <IMPLEMENTATION-DATA-TYPE-REF DEST="IMPLEMENTATION-DATA-TYPE">/AUTOSAR_Platform/ImplementationDataTypes/uint8</IMPLEMENTATION-DATA-TYPE-REF>
                    </SW-DATA-DEF-PROPS-CONDITIONAL>
                  </SW-DATA-DEF-PROPS-VARIANTS>
                </SW-DATA-DEF-PROPS>
              </SW-SERVICE-ARG>
              <SW-SERVICE-ARG>
                <SHORT-NAME>Channel</SHORT-NAME>
                <CATEGORY>TYPE_REFERENCE</CATEGORY>
                <SW-DATA-DEF-PROPS>
                  <SW-DATA-DEF-PROPS-VARIANTS>
                    <SW-DATA-DEF-PROPS-CONDITIONAL>
                      <IMPLEMENTATION-DATA-TYPE-REF DEST="IMPLEMENTATION-DATA-TYPE">/AUTOSAR_Platform/ImplementationDataTypes/uint8</IMPLEMENTATION-DATA-TYPE-REF>
                    </SW-DATA-DEF-PROPS-CONDITIONAL>
                  </SW-DATA-DEF-PROPS-VARIANTS>
                </SW-DATA-DEF-PROPS>
              </SW-SERVICE-ARG>
            </ARGUMENTS>
          </BSW-MODULE-ENTRY>
          <BSW-MODULE-ENTRY>
            <SHORT-NAME>Mcu_17_Gtm_IsAtomChannelEnabled</SHORT-NAME>
            <SERVICE-ID>111</SERVICE-ID>
            <IS-REENTRANT>true</IS-REENTRANT>
            <IS-SYNCHRONOUS>true</IS-SYNCHRONOUS>
            <CALL-TYPE>REGULAR</CALL-TYPE>
            <EXECUTION-CONTEXT>TASK</EXECUTION-CONTEXT>
            <SW-SERVICE-IMPL-POLICY>STANDARD</SW-SERVICE-IMPL-POLICY>
            <RETURN-TYPE>
              <SHORT-NAME>Return</SHORT-NAME>
              <CATEGORY>TYPE_REFERENCE</CATEGORY>
              <SW-DATA-DEF-PROPS>
                <SW-DATA-DEF-PROPS-VARIANTS>
                  <SW-DATA-DEF-PROPS-CONDITIONAL>
                    <IMPLEMENTATION-DATA-TYPE-REF DEST="IMPLEMENTATION-DATA-TYPE">/AUTOSAR_Mcu/ImplementationDataTypes/Mcu_17_Gtm_TimerStatusType</IMPLEMENTATION-DATA-TYPE-REF>
                  </SW-DATA-DEF-PROPS-CONDITIONAL>
                </SW-DATA-DEF-PROPS-VARIANTS>
              </SW-DATA-DEF-PROPS>
            </RETURN-TYPE>
            <ARGUMENTS>
              <SW-SERVICE-ARG>
                <SHORT-NAME>Module</SHORT-NAME>
                <CATEGORY>TYPE_REFERENCE</CATEGORY>
                <SW-DATA-DEF-PROPS>
                  <SW-DATA-DEF-PROPS-VARIANTS>
                    <SW-DATA-DEF-PROPS-CONDITIONAL>
                      <IMPLEMENTATION-DATA-TYPE-REF DEST="IMPLEMENTATION-DATA-TYPE">/AUTOSAR_Platform/ImplementationDataTypes/uint8</IMPLEMENTATION-DATA-TYPE-REF>
                    </SW-DATA-DEF-PROPS-CONDITIONAL>
                  </SW-DATA-DEF-PROPS-VARIANTS>
                </SW-DATA-DEF-PROPS>
              </SW-SERVICE-ARG>
              <SW-SERVICE-ARG>
                <SHORT-NAME>Channel</SHORT-NAME>
                <CATEGORY>TYPE_REFERENCE</CATEGORY>
                <SW-DATA-DEF-PROPS>
                  <SW-DATA-DEF-PROPS-VARIANTS>
                    <SW-DATA-DEF-PROPS-CONDITIONAL>
                      <IMPLEMENTATION-DATA-TYPE-REF DEST="IMPLEMENTATION-DATA-TYPE">/AUTOSAR_Platform/ImplementationDataTypes/uint8</IMPLEMENTATION-DATA-TYPE-REF>
                    </SW-DATA-DEF-PROPS-CONDITIONAL>
                  </SW-DATA-DEF-PROPS-VARIANTS>
                </SW-DATA-DEF-PROPS>
              </SW-SERVICE-ARG>
            </ARGUMENTS>
          </BSW-MODULE-ENTRY>
          <BSW-MODULE-ENTRY>
            <SHORT-NAME>Mcu_17_Gtm_IsTimChannelEnabled</SHORT-NAME>
            <SERVICE-ID>112</SERVICE-ID>
            <IS-REENTRANT>true</IS-REENTRANT>
            <IS-SYNCHRONOUS>true</IS-SYNCHRONOUS>
            <CALL-TYPE>REGULAR</CALL-TYPE>
            <EXECUTION-CONTEXT>TASK</EXECUTION-CONTEXT>
            <SW-SERVICE-IMPL-POLICY>STANDARD</SW-SERVICE-IMPL-POLICY>
            <RETURN-TYPE>
              <SHORT-NAME>Return</SHORT-NAME>
              <CATEGORY>TYPE_REFERENCE</CATEGORY>
              <SW-DATA-DEF-PROPS>
                <SW-DATA-DEF-PROPS-VARIANTS>
                  <SW-DATA-DEF-PROPS-CONDITIONAL>
                    <IMPLEMENTATION-DATA-TYPE-REF DEST="IMPLEMENTATION-DATA-TYPE">/AUTOSAR_Mcu/ImplementationDataTypes/Mcu_17_Gtm_TimerStatusType</IMPLEMENTATION-DATA-TYPE-REF>
                  </SW-DATA-DEF-PROPS-CONDITIONAL>
                </SW-DATA-DEF-PROPS-VARIANTS>
              </SW-DATA-DEF-PROPS>
            </RETURN-TYPE>
            <ARGUMENTS>
              <SW-SERVICE-ARG>
                <SHORT-NAME>Module</SHORT-NAME>
                <CATEGORY>TYPE_REFERENCE</CATEGORY>
                <SW-DATA-DEF-PROPS>
                  <SW-DATA-DEF-PROPS-VARIANTS>
                    <SW-DATA-DEF-PROPS-CONDITIONAL>
                      <IMPLEMENTATION-DATA-TYPE-REF DEST="IMPLEMENTATION-DATA-TYPE">/AUTOSAR_Platform/ImplementationDataTypes/uint8</IMPLEMENTATION-DATA-TYPE-REF>
                    </SW-DATA-DEF-PROPS-CONDITIONAL>
                  </SW-DATA-DEF-PROPS-VARIANTS>
                </SW-DATA-DEF-PROPS>
              </SW-SERVICE-ARG>
              <SW-SERVICE-ARG>
                <SHORT-NAME>Channel</SHORT-NAME>
                <CATEGORY>TYPE_REFERENCE</CATEGORY>
                <SW-DATA-DEF-PROPS>
                  <SW-DATA-DEF-PROPS-VARIANTS>
                    <SW-DATA-DEF-PROPS-CONDITIONAL>
                      <IMPLEMENTATION-DATA-TYPE-REF DEST="IMPLEMENTATION-DATA-TYPE">/AUTOSAR_Platform/ImplementationDataTypes/uint8</IMPLEMENTATION-DATA-TYPE-REF>
                    </SW-DATA-DEF-PROPS-CONDITIONAL>
                  </SW-DATA-DEF-PROPS-VARIANTS>
                </SW-DATA-DEF-PROPS>
              </SW-SERVICE-ARG>
            </ARGUMENTS>
          </BSW-MODULE-ENTRY>
          <BSW-MODULE-ENTRY>
            <SHORT-NAME>Mcu_17_Gtm_AtomChannelInit</SHORT-NAME>
            <INTRODUCTION>
              <NOTE SI="Mcu_17_Gtm_AtomChannelInit is reentrant for other channels" NOTE-TYPE="HINT" />
            </INTRODUCTION>
            <SERVICE-ID>100</SERVICE-ID>
            <IS-REENTRANT>true</IS-REENTRANT>
            <IS-SYNCHRONOUS>true</IS-SYNCHRONOUS>
            <CALL-TYPE>REGULAR</CALL-TYPE>
            <EXECUTION-CONTEXT>TASK</EXECUTION-CONTEXT>
            <SW-SERVICE-IMPL-POLICY>STANDARD</SW-SERVICE-IMPL-POLICY>
            <ARGUMENTS>
              <SW-SERVICE-ARG>
                <SHORT-NAME>ConfigPtr</SHORT-NAME>
                <CATEGORY>DATA_REFERENCE</CATEGORY>
                <SW-DATA-DEF-PROPS>
                  <SW-DATA-DEF-PROPS-VARIANTS>
                    <SW-DATA-DEF-PROPS-CONDITIONAL>
                      <SW-POINTER-TARGET-PROPS>
                        <TARGET-CATEGORY>TYPE_REFERENCE</TARGET-CATEGORY>
                        <SW-DATA-DEF-PROPS>
                          <SW-DATA-DEF-PROPS-VARIANTS>
                            <SW-DATA-DEF-PROPS-CONDITIONAL>
                              <IMPLEMENTATION-DATA-TYPE-REF DEST="IMPLEMENTATION-DATA-TYPE">/AUTOSAR_Mcu/ImplementationDataTypes/Mcu_17_Gtm_TomAtomChConfigType</IMPLEMENTATION-DATA-TYPE-REF>
                            </SW-DATA-DEF-PROPS-CONDITIONAL>
                          </SW-DATA-DEF-PROPS-VARIANTS>
                        </SW-DATA-DEF-PROPS>
                      </SW-POINTER-TARGET-PROPS>
                    </SW-DATA-DEF-PROPS-CONDITIONAL>
                  </SW-DATA-DEF-PROPS-VARIANTS>
                </SW-DATA-DEF-PROPS>
              </SW-SERVICE-ARG>
            </ARGUMENTS>
          </BSW-MODULE-ENTRY>
          <BSW-MODULE-ENTRY>
            <SHORT-NAME>Mcu_17_Gtm_AtomChannelShadowTransfer</SHORT-NAME>
            <SERVICE-ID>101</SERVICE-ID>
            <IS-REENTRANT>false</IS-REENTRANT>
            <IS-SYNCHRONOUS>true</IS-SYNCHRONOUS>
            <CALL-TYPE>REGULAR</CALL-TYPE>
            <EXECUTION-CONTEXT>TASK</EXECUTION-CONTEXT>
            <SW-SERVICE-IMPL-POLICY>STANDARD</SW-SERVICE-IMPL-POLICY>
            <ARGUMENTS>
              <SW-SERVICE-ARG>
                <SHORT-NAME>Module</SHORT-NAME>
                <CATEGORY>TYPE_REFERENCE</CATEGORY>
                <SW-DATA-DEF-PROPS>
                  <SW-DATA-DEF-PROPS-VARIANTS>
                    <SW-DATA-DEF-PROPS-CONDITIONAL>
                      <IMPLEMENTATION-DATA-TYPE-REF DEST="IMPLEMENTATION-DATA-TYPE">/AUTOSAR_Platform/ImplementationDataTypes/uint8</IMPLEMENTATION-DATA-TYPE-REF>
                    </SW-DATA-DEF-PROPS-CONDITIONAL>
                  </SW-DATA-DEF-PROPS-VARIANTS>
                </SW-DATA-DEF-PROPS>
              </SW-SERVICE-ARG>
              <SW-SERVICE-ARG>
                <SHORT-NAME>Channel</SHORT-NAME>
                <CATEGORY>TYPE_REFERENCE</CATEGORY>
                <SW-DATA-DEF-PROPS>
                  <SW-DATA-DEF-PROPS-VARIANTS>
                    <SW-DATA-DEF-PROPS-CONDITIONAL>
                      <IMPLEMENTATION-DATA-TYPE-REF DEST="IMPLEMENTATION-DATA-TYPE">/AUTOSAR_Platform/ImplementationDataTypes/uint8</IMPLEMENTATION-DATA-TYPE-REF>
                    </SW-DATA-DEF-PROPS-CONDITIONAL>
                  </SW-DATA-DEF-PROPS-VARIANTS>
                </SW-DATA-DEF-PROPS>
              </SW-SERVICE-ARG>
            </ARGUMENTS>
          </BSW-MODULE-ENTRY>
          <BSW-MODULE-ENTRY>
            <SHORT-NAME>Mcu_17_Gtm_AtomChannelDeInit</SHORT-NAME>
            <INTRODUCTION>
              <NOTE SI="Mcu_17_Gtm_AtomChannelDeInit is reentrant for other channels" NOTE-TYPE="HINT" />
            </INTRODUCTION>
            <SERVICE-ID>102</SERVICE-ID>
            <IS-REENTRANT>true</IS-REENTRANT>
            <IS-SYNCHRONOUS>true</IS-SYNCHRONOUS>
            <CALL-TYPE>REGULAR</CALL-TYPE>
            <EXECUTION-CONTEXT>TASK</EXECUTION-CONTEXT>
            <SW-SERVICE-IMPL-POLICY>STANDARD</SW-SERVICE-IMPL-POLICY>
            <ARGUMENTS>
              <SW-SERVICE-ARG>
                <SHORT-NAME>Module</SHORT-NAME>
                <CATEGORY>TYPE_REFERENCE</CATEGORY>
                <SW-DATA-DEF-PROPS>
                  <SW-DATA-DEF-PROPS-VARIANTS>
                    <SW-DATA-DEF-PROPS-CONDITIONAL>
                      <IMPLEMENTATION-DATA-TYPE-REF DEST="IMPLEMENTATION-DATA-TYPE">/AUTOSAR_Platform/ImplementationDataTypes/uint8</IMPLEMENTATION-DATA-TYPE-REF>
                    </SW-DATA-DEF-PROPS-CONDITIONAL>
                  </SW-DATA-DEF-PROPS-VARIANTS>
                </SW-DATA-DEF-PROPS>
              </SW-SERVICE-ARG>
              <SW-SERVICE-ARG>
                <SHORT-NAME>Channel</SHORT-NAME>
                <CATEGORY>TYPE_REFERENCE</CATEGORY>
                <SW-DATA-DEF-PROPS>
                  <SW-DATA-DEF-PROPS-VARIANTS>
                    <SW-DATA-DEF-PROPS-CONDITIONAL>
                      <IMPLEMENTATION-DATA-TYPE-REF DEST="IMPLEMENTATION-DATA-TYPE">/AUTOSAR_Platform/ImplementationDataTypes/uint8</IMPLEMENTATION-DATA-TYPE-REF>
                    </SW-DATA-DEF-PROPS-CONDITIONAL>
                  </SW-DATA-DEF-PROPS-VARIANTS>
                </SW-DATA-DEF-PROPS>
              </SW-SERVICE-ARG>
            </ARGUMENTS>
          </BSW-MODULE-ENTRY>
          <BSW-MODULE-ENTRY>
            <SHORT-NAME>Mcu_17_Gtm_AtomChannelEnable</SHORT-NAME>
            <INTRODUCTION>
              <NOTE SI="Mcu_17_Gtm_AtomChannelEnable is reentrant for other channels" NOTE-TYPE="HINT" />
            </INTRODUCTION>
            <SERVICE-ID>106</SERVICE-ID>
            <IS-REENTRANT>true</IS-REENTRANT>
            <IS-SYNCHRONOUS>true</IS-SYNCHRONOUS>
            <CALL-TYPE>REGULAR</CALL-TYPE>
            <EXECUTION-CONTEXT>TASK</EXECUTION-CONTEXT>
            <SW-SERVICE-IMPL-POLICY>STANDARD</SW-SERVICE-IMPL-POLICY>
            <ARGUMENTS>
              <SW-SERVICE-ARG>
                <SHORT-NAME>Module</SHORT-NAME>
                <CATEGORY>TYPE_REFERENCE</CATEGORY>
                <SW-DATA-DEF-PROPS>
                  <SW-DATA-DEF-PROPS-VARIANTS>
                    <SW-DATA-DEF-PROPS-CONDITIONAL>
                      <IMPLEMENTATION-DATA-TYPE-REF DEST="IMPLEMENTATION-DATA-TYPE">/AUTOSAR_Platform/ImplementationDataTypes/uint8</IMPLEMENTATION-DATA-TYPE-REF>
                    </SW-DATA-DEF-PROPS-CONDITIONAL>
                  </SW-DATA-DEF-PROPS-VARIANTS>
                </SW-DATA-DEF-PROPS>
              </SW-SERVICE-ARG>
              <SW-SERVICE-ARG>
                <SHORT-NAME>Channel</SHORT-NAME>
                <CATEGORY>TYPE_REFERENCE</CATEGORY>
                <SW-DATA-DEF-PROPS>
                  <SW-DATA-DEF-PROPS-VARIANTS>
                    <SW-DATA-DEF-PROPS-CONDITIONAL>
                      <IMPLEMENTATION-DATA-TYPE-REF DEST="IMPLEMENTATION-DATA-TYPE">/AUTOSAR_Platform/ImplementationDataTypes/uint8</IMPLEMENTATION-DATA-TYPE-REF>
                    </SW-DATA-DEF-PROPS-CONDITIONAL>
                  </SW-DATA-DEF-PROPS-VARIANTS>
                </SW-DATA-DEF-PROPS>
              </SW-SERVICE-ARG>
              <SW-SERVICE-ARG>
                <SHORT-NAME>TimerOutputEn</SHORT-NAME>
                <CATEGORY>TYPE_REFERENCE</CATEGORY>
                <SW-DATA-DEF-PROPS>
                  <SW-DATA-DEF-PROPS-VARIANTS>
                    <SW-DATA-DEF-PROPS-CONDITIONAL>
                      <IMPLEMENTATION-DATA-TYPE-REF DEST="IMPLEMENTATION-DATA-TYPE">/AUTOSAR_Mcu/ImplementationDataTypes/Mcu_17_Gtm_TimerOutputEnableType</IMPLEMENTATION-DATA-TYPE-REF>
                    </SW-DATA-DEF-PROPS-CONDITIONAL>
                  </SW-DATA-DEF-PROPS-VARIANTS>
                </SW-DATA-DEF-PROPS>
              </SW-SERVICE-ARG>
            </ARGUMENTS>
          </BSW-MODULE-ENTRY>
          <BSW-MODULE-ENTRY>
            <SHORT-NAME>Mcu_17_Gtm_AtomChannelDisable</SHORT-NAME>
            <INTRODUCTION>
              <NOTE SI="Mcu_17_Gtm_AtomChannelDisable is reentrant for other channels" NOTE-TYPE="HINT" />
            </INTRODUCTION>
            <SERVICE-ID>107</SERVICE-ID>
            <IS-REENTRANT>true</IS-REENTRANT>
            <IS-SYNCHRONOUS>true</IS-SYNCHRONOUS>
            <CALL-TYPE>REGULAR</CALL-TYPE>
            <EXECUTION-CONTEXT>TASK</EXECUTION-CONTEXT>
            <SW-SERVICE-IMPL-POLICY>STANDARD</SW-SERVICE-IMPL-POLICY>
            <ARGUMENTS>
              <SW-SERVICE-ARG>
                <SHORT-NAME>Module</SHORT-NAME>
                <CATEGORY>TYPE_REFERENCE</CATEGORY>
                <SW-DATA-DEF-PROPS>
                  <SW-DATA-DEF-PROPS-VARIANTS>
                    <SW-DATA-DEF-PROPS-CONDITIONAL>
                      <IMPLEMENTATION-DATA-TYPE-REF DEST="IMPLEMENTATION-DATA-TYPE">/AUTOSAR_Platform/ImplementationDataTypes/uint8</IMPLEMENTATION-DATA-TYPE-REF>
                    </SW-DATA-DEF-PROPS-CONDITIONAL>
                  </SW-DATA-DEF-PROPS-VARIANTS>
                </SW-DATA-DEF-PROPS>
              </SW-SERVICE-ARG>
              <SW-SERVICE-ARG>
                <SHORT-NAME>Channel</SHORT-NAME>
                <CATEGORY>TYPE_REFERENCE</CATEGORY>
                <SW-DATA-DEF-PROPS>
                  <SW-DATA-DEF-PROPS-VARIANTS>
                    <SW-DATA-DEF-PROPS-CONDITIONAL>
                      <IMPLEMENTATION-DATA-TYPE-REF DEST="IMPLEMENTATION-DATA-TYPE">/AUTOSAR_Platform/ImplementationDataTypes/uint8</IMPLEMENTATION-DATA-TYPE-REF>
                    </SW-DATA-DEF-PROPS-CONDITIONAL>
                  </SW-DATA-DEF-PROPS-VARIANTS>
                </SW-DATA-DEF-PROPS>
              </SW-SERVICE-ARG>
            </ARGUMENTS>
          </BSW-MODULE-ENTRY>
          <BSW-MODULE-ENTRY>
            <SHORT-NAME>Mcu_17_Gtm_TimChannelInit</SHORT-NAME>
            <INTRODUCTION>
              <NOTE SI="Mcu_17_Gtm_TimChannelInit is reentrant for other channels" NOTE-TYPE="HINT" />
            </INTRODUCTION>
            <SERVICE-ID>98</SERVICE-ID>
            <IS-REENTRANT>true</IS-REENTRANT>
            <IS-SYNCHRONOUS>true</IS-SYNCHRONOUS>
            <CALL-TYPE>REGULAR</CALL-TYPE>
            <EXECUTION-CONTEXT>TASK</EXECUTION-CONTEXT>
            <SW-SERVICE-IMPL-POLICY>STANDARD</SW-SERVICE-IMPL-POLICY>
            <ARGUMENTS>
              <SW-SERVICE-ARG>
                <SHORT-NAME>ConfigPtr</SHORT-NAME>
                <CATEGORY>DATA_REFERENCE</CATEGORY>
                <SW-DATA-DEF-PROPS>
                  <SW-DATA-DEF-PROPS-VARIANTS>
                    <SW-DATA-DEF-PROPS-CONDITIONAL>
                      <SW-POINTER-TARGET-PROPS>
                        <TARGET-CATEGORY>TYPE_REFERENCE</TARGET-CATEGORY>
                        <SW-DATA-DEF-PROPS>
                          <SW-DATA-DEF-PROPS-VARIANTS>
                            <SW-DATA-DEF-PROPS-CONDITIONAL>
                              <IMPLEMENTATION-DATA-TYPE-REF DEST="IMPLEMENTATION-DATA-TYPE">/AUTOSAR_Mcu/ImplementationDataTypes/Mcu_17_Gtm_TimChConfigType</IMPLEMENTATION-DATA-TYPE-REF>
                            </SW-DATA-DEF-PROPS-CONDITIONAL>
                          </SW-DATA-DEF-PROPS-VARIANTS>
                        </SW-DATA-DEF-PROPS>
                      </SW-POINTER-TARGET-PROPS>
                    </SW-DATA-DEF-PROPS-CONDITIONAL>
                  </SW-DATA-DEF-PROPS-VARIANTS>
                </SW-DATA-DEF-PROPS>
              </SW-SERVICE-ARG>
            </ARGUMENTS>
          </BSW-MODULE-ENTRY>
          <BSW-MODULE-ENTRY>
            <SHORT-NAME>Mcu_17_Gtm_TimChannelDeInit</SHORT-NAME>
            <INTRODUCTION>
              <NOTE SI="Mcu_17_Gtm_TimChannelDeInit is reentrant for other channels" NOTE-TYPE="HINT" />
            </INTRODUCTION>
            <SERVICE-ID>103</SERVICE-ID>
            <IS-REENTRANT>true</IS-REENTRANT>
            <IS-SYNCHRONOUS>true</IS-SYNCHRONOUS>
            <CALL-TYPE>REGULAR</CALL-TYPE>
            <EXECUTION-CONTEXT>TASK</EXECUTION-CONTEXT>
            <SW-SERVICE-IMPL-POLICY>STANDARD</SW-SERVICE-IMPL-POLICY>
            <ARGUMENTS>
              <SW-SERVICE-ARG>
                <SHORT-NAME>Module</SHORT-NAME>
                <CATEGORY>TYPE_REFERENCE</CATEGORY>
                <SW-DATA-DEF-PROPS>
                  <SW-DATA-DEF-PROPS-VARIANTS>
                    <SW-DATA-DEF-PROPS-CONDITIONAL>
                      <IMPLEMENTATION-DATA-TYPE-REF DEST="IMPLEMENTATION-DATA-TYPE">/AUTOSAR_Platform/ImplementationDataTypes/uint8</IMPLEMENTATION-DATA-TYPE-REF>
                    </SW-DATA-DEF-PROPS-CONDITIONAL>
                  </SW-DATA-DEF-PROPS-VARIANTS>
                </SW-DATA-DEF-PROPS>
              </SW-SERVICE-ARG>
              <SW-SERVICE-ARG>
                <SHORT-NAME>Channel</SHORT-NAME>
                <CATEGORY>TYPE_REFERENCE</CATEGORY>
                <SW-DATA-DEF-PROPS>
                  <SW-DATA-DEF-PROPS-VARIANTS>
                    <SW-DATA-DEF-PROPS-CONDITIONAL>
                      <IMPLEMENTATION-DATA-TYPE-REF DEST="IMPLEMENTATION-DATA-TYPE">/AUTOSAR_Platform/ImplementationDataTypes/uint8</IMPLEMENTATION-DATA-TYPE-REF>
                    </SW-DATA-DEF-PROPS-CONDITIONAL>
                  </SW-DATA-DEF-PROPS-VARIANTS>
                </SW-DATA-DEF-PROPS>
              </SW-SERVICE-ARG>
            </ARGUMENTS>
          </BSW-MODULE-ENTRY>
          <BSW-MODULE-ENTRY>
            <SHORT-NAME>Mcu_17_Gtm_TimChannelEnable</SHORT-NAME>
            <INTRODUCTION>
              <NOTE SI="Mcu_17_Gtm_TimChannelEnable is reentrant for other channels" NOTE-TYPE="HINT" />
            </INTRODUCTION>
            <SERVICE-ID>108</SERVICE-ID>
            <IS-REENTRANT>true</IS-REENTRANT>
            <IS-SYNCHRONOUS>true</IS-SYNCHRONOUS>
            <CALL-TYPE>REGULAR</CALL-TYPE>
            <EXECUTION-CONTEXT>TASK</EXECUTION-CONTEXT>
            <SW-SERVICE-IMPL-POLICY>STANDARD</SW-SERVICE-IMPL-POLICY>
            <ARGUMENTS>
              <SW-SERVICE-ARG>
                <SHORT-NAME>Module</SHORT-NAME>
                <CATEGORY>TYPE_REFERENCE</CATEGORY>
                <SW-DATA-DEF-PROPS>
                  <SW-DATA-DEF-PROPS-VARIANTS>
                    <SW-DATA-DEF-PROPS-CONDITIONAL>
                      <IMPLEMENTATION-DATA-TYPE-REF DEST="IMPLEMENTATION-DATA-TYPE">/AUTOSAR_Platform/ImplementationDataTypes/uint8</IMPLEMENTATION-DATA-TYPE-REF>
                    </SW-DATA-DEF-PROPS-CONDITIONAL>
                  </SW-DATA-DEF-PROPS-VARIANTS>
                </SW-DATA-DEF-PROPS>
              </SW-SERVICE-ARG>
              <SW-SERVICE-ARG>
                <SHORT-NAME>Channel</SHORT-NAME>
                <CATEGORY>TYPE_REFERENCE</CATEGORY>
                <SW-DATA-DEF-PROPS>
                  <SW-DATA-DEF-PROPS-VARIANTS>
                    <SW-DATA-DEF-PROPS-CONDITIONAL>
                      <IMPLEMENTATION-DATA-TYPE-REF DEST="IMPLEMENTATION-DATA-TYPE">/AUTOSAR_Platform/ImplementationDataTypes/uint8</IMPLEMENTATION-DATA-TYPE-REF>
                    </SW-DATA-DEF-PROPS-CONDITIONAL>
                  </SW-DATA-DEF-PROPS-VARIANTS>
                </SW-DATA-DEF-PROPS>
              </SW-SERVICE-ARG>
            </ARGUMENTS>
          </BSW-MODULE-ENTRY>
          <BSW-MODULE-ENTRY>
            <SHORT-NAME>Mcu_17_Gtm_TimChannelDisable</SHORT-NAME>
            <INTRODUCTION>
              <NOTE SI="Mcu_17_Gtm_TimChannelDisable is reentrant for other channels" NOTE-TYPE="HINT" />
            </INTRODUCTION>
            <SERVICE-ID>109</SERVICE-ID>
            <IS-REENTRANT>true</IS-REENTRANT>
            <IS-SYNCHRONOUS>true</IS-SYNCHRONOUS>
            <CALL-TYPE>REGULAR</CALL-TYPE>
            <EXECUTION-CONTEXT>TASK</EXECUTION-CONTEXT>
            <SW-SERVICE-IMPL-POLICY>STANDARD</SW-SERVICE-IMPL-POLICY>
            <ARGUMENTS>
              <SW-SERVICE-ARG>
                <SHORT-NAME>Module</SHORT-NAME>
                <CATEGORY>TYPE_REFERENCE</CATEGORY>
                <SW-DATA-DEF-PROPS>
                  <SW-DATA-DEF-PROPS-VARIANTS>
                    <SW-DATA-DEF-PROPS-CONDITIONAL>
                      <IMPLEMENTATION-DATA-TYPE-REF DEST="IMPLEMENTATION-DATA-TYPE">/AUTOSAR_Platform/ImplementationDataTypes/uint8</IMPLEMENTATION-DATA-TYPE-REF>
                    </SW-DATA-DEF-PROPS-CONDITIONAL>
                  </SW-DATA-DEF-PROPS-VARIANTS>
                </SW-DATA-DEF-PROPS>
              </SW-SERVICE-ARG>
              <SW-SERVICE-ARG>
                <SHORT-NAME>Channel</SHORT-NAME>
                <CATEGORY>TYPE_REFERENCE</CATEGORY>
                <SW-DATA-DEF-PROPS>
                  <SW-DATA-DEF-PROPS-VARIANTS>
                    <SW-DATA-DEF-PROPS-CONDITIONAL>
                      <IMPLEMENTATION-DATA-TYPE-REF DEST="IMPLEMENTATION-DATA-TYPE">/AUTOSAR_Platform/ImplementationDataTypes/uint8</IMPLEMENTATION-DATA-TYPE-REF>
                    </SW-DATA-DEF-PROPS-CONDITIONAL>
                  </SW-DATA-DEF-PROPS-VARIANTS>
                </SW-DATA-DEF-PROPS>
              </SW-SERVICE-ARG>
            </ARGUMENTS>
          </BSW-MODULE-ENTRY>
          <BSW-MODULE-ENTRY>
            <SHORT-NAME>Mcu_17_Gtm_TimChannelIsr</SHORT-NAME>
            <INTRODUCTION>
              <NOTE SI="Mcu_17_Gtm_TimChannelIsr is reentrant but for different channels." NOTE-TYPE="HINT" />
            </INTRODUCTION>
            <IS-REENTRANT>true</IS-REENTRANT>
            <IS-SYNCHRONOUS>true</IS-SYNCHRONOUS>
            <CALL-TYPE>INTERRUPT</CALL-TYPE>
            <EXECUTION-CONTEXT>INTERRUPT-CAT-1</EXECUTION-CONTEXT>
            <SW-SERVICE-IMPL-POLICY>STANDARD</SW-SERVICE-IMPL-POLICY>
            <ARGUMENTS>
              <SW-SERVICE-ARG>
                <SHORT-NAME>Module</SHORT-NAME>
                <CATEGORY>TYPE_REFERENCE</CATEGORY>
                <SW-DATA-DEF-PROPS>
                  <SW-DATA-DEF-PROPS-VARIANTS>
                    <SW-DATA-DEF-PROPS-CONDITIONAL>
                      <IMPLEMENTATION-DATA-TYPE-REF DEST="IMPLEMENTATION-DATA-TYPE">/AUTOSAR_Platform/ImplementationDataTypes/uint8</IMPLEMENTATION-DATA-TYPE-REF>
                    </SW-DATA-DEF-PROPS-CONDITIONAL>
                  </SW-DATA-DEF-PROPS-VARIANTS>
                </SW-DATA-DEF-PROPS>
              </SW-SERVICE-ARG>
              <SW-SERVICE-ARG>
                <SHORT-NAME>Channel</SHORT-NAME>
                <CATEGORY>TYPE_REFERENCE</CATEGORY>
                <SW-DATA-DEF-PROPS>
                  <SW-DATA-DEF-PROPS-VARIANTS>
                    <SW-DATA-DEF-PROPS-CONDITIONAL>
                      <IMPLEMENTATION-DATA-TYPE-REF DEST="IMPLEMENTATION-DATA-TYPE">/AUTOSAR_Platform/ImplementationDataTypes/uint8</IMPLEMENTATION-DATA-TYPE-REF>
                    </SW-DATA-DEF-PROPS-CONDITIONAL>
                  </SW-DATA-DEF-PROPS-VARIANTS>
                </SW-DATA-DEF-PROPS>
              </SW-SERVICE-ARG>
            </ARGUMENTS>
          </BSW-MODULE-ENTRY>
          <BSW-MODULE-ENTRY>
            <SHORT-NAME>Mcu_17_Gtm_TomChannelIsr</SHORT-NAME>
            <INTRODUCTION>
              <NOTE SI="Mcu_17_Gtm_TomChannelIsr is reentrant but for different channels." NOTE-TYPE="HINT" />
            </INTRODUCTION>
            <IS-REENTRANT>true</IS-REENTRANT>
            <IS-SYNCHRONOUS>true</IS-SYNCHRONOUS>
            <CALL-TYPE>INTERRUPT</CALL-TYPE>
            <EXECUTION-CONTEXT>INTERRUPT-CAT-1</EXECUTION-CONTEXT>
            <SW-SERVICE-IMPL-POLICY>STANDARD</SW-SERVICE-IMPL-POLICY>
            <ARGUMENTS>
              <SW-SERVICE-ARG>
                <SHORT-NAME>Module</SHORT-NAME>
                <CATEGORY>TYPE_REFERENCE</CATEGORY>
                <SW-DATA-DEF-PROPS>
                  <SW-DATA-DEF-PROPS-VARIANTS>
                    <SW-DATA-DEF-PROPS-CONDITIONAL>
                      <IMPLEMENTATION-DATA-TYPE-REF DEST="IMPLEMENTATION-DATA-TYPE">/AUTOSAR_Platform/ImplementationDataTypes/uint8</IMPLEMENTATION-DATA-TYPE-REF>
                    </SW-DATA-DEF-PROPS-CONDITIONAL>
                  </SW-DATA-DEF-PROPS-VARIANTS>
                </SW-DATA-DEF-PROPS>
              </SW-SERVICE-ARG>
              <SW-SERVICE-ARG>
                <SHORT-NAME>Channel</SHORT-NAME>
                <CATEGORY>TYPE_REFERENCE</CATEGORY>
                <SW-DATA-DEF-PROPS>
                  <SW-DATA-DEF-PROPS-VARIANTS>
                    <SW-DATA-DEF-PROPS-CONDITIONAL>
                      <IMPLEMENTATION-DATA-TYPE-REF DEST="IMPLEMENTATION-DATA-TYPE">/AUTOSAR_Platform/ImplementationDataTypes/uint8</IMPLEMENTATION-DATA-TYPE-REF>
                    </SW-DATA-DEF-PROPS-CONDITIONAL>
                  </SW-DATA-DEF-PROPS-VARIANTS>
                </SW-DATA-DEF-PROPS>
              </SW-SERVICE-ARG>
            </ARGUMENTS>
          </BSW-MODULE-ENTRY>
          <BSW-MODULE-ENTRY>
            <SHORT-NAME>Mcu_17_Gtm_AtomChannelIsr</SHORT-NAME>
            <INTRODUCTION>
              <NOTE SI="Mcu_17_Gtm_AtomChannelIsr is reentrant for other channels" NOTE-TYPE="HINT" />
            </INTRODUCTION>
            <IS-REENTRANT>true</IS-REENTRANT>
            <IS-SYNCHRONOUS>true</IS-SYNCHRONOUS>
            <CALL-TYPE>INTERRUPT</CALL-TYPE>
            <EXECUTION-CONTEXT>INTERRUPT-CAT-1</EXECUTION-CONTEXT>
            <SW-SERVICE-IMPL-POLICY>STANDARD</SW-SERVICE-IMPL-POLICY>
            <ARGUMENTS>
              <SW-SERVICE-ARG>
                <SHORT-NAME>Module</SHORT-NAME>
                <CATEGORY>TYPE_REFERENCE</CATEGORY>
                <SW-DATA-DEF-PROPS>
                  <SW-DATA-DEF-PROPS-VARIANTS>
                    <SW-DATA-DEF-PROPS-CONDITIONAL>
                      <IMPLEMENTATION-DATA-TYPE-REF DEST="IMPLEMENTATION-DATA-TYPE">/AUTOSAR_Platform/ImplementationDataTypes/uint8</IMPLEMENTATION-DATA-TYPE-REF>
                    </SW-DATA-DEF-PROPS-CONDITIONAL>
                  </SW-DATA-DEF-PROPS-VARIANTS>
                </SW-DATA-DEF-PROPS>
              </SW-SERVICE-ARG>
              <SW-SERVICE-ARG>
                <SHORT-NAME>Channel</SHORT-NAME>
                <CATEGORY>TYPE_REFERENCE</CATEGORY>
                <SW-DATA-DEF-PROPS>
                  <SW-DATA-DEF-PROPS-VARIANTS>
                    <SW-DATA-DEF-PROPS-CONDITIONAL>
                      <IMPLEMENTATION-DATA-TYPE-REF DEST="IMPLEMENTATION-DATA-TYPE">/AUTOSAR_Platform/ImplementationDataTypes/uint8</IMPLEMENTATION-DATA-TYPE-REF>
                    </SW-DATA-DEF-PROPS-CONDITIONAL>
                  </SW-DATA-DEF-PROPS-VARIANTS>
                </SW-DATA-DEF-PROPS>
              </SW-SERVICE-ARG>
            </ARGUMENTS>
          </BSW-MODULE-ENTRY>
          <BSW-MODULE-ENTRY>
            <SHORT-NAME>Mcu_17_Gtm_ConnectPortPinToTim</SHORT-NAME>
            <INTRODUCTION>
              <NOTE SI="Mcu_17_Gtm_TimChannelIsr is reentrant for TIM modules" NOTE-TYPE="HINT" />
            </INTRODUCTION>
            <SERVICE-ID>114</SERVICE-ID>
            <IS-REENTRANT>true</IS-REENTRANT>
            <IS-SYNCHRONOUS>true</IS-SYNCHRONOUS>
            <CALL-TYPE>REGULAR</CALL-TYPE>
            <EXECUTION-CONTEXT>TASK</EXECUTION-CONTEXT>
            <SW-SERVICE-IMPL-POLICY>STANDARD</SW-SERVICE-IMPL-POLICY>
            <ARGUMENTS>
              <SW-SERVICE-ARG>
                <SHORT-NAME>Module</SHORT-NAME>
                <CATEGORY>TYPE_REFERENCE</CATEGORY>
                <SW-DATA-DEF-PROPS>
                  <SW-DATA-DEF-PROPS-VARIANTS>
                    <SW-DATA-DEF-PROPS-CONDITIONAL>
                      <IMPLEMENTATION-DATA-TYPE-REF DEST="IMPLEMENTATION-DATA-TYPE">/AUTOSAR_Platform/ImplementationDataTypes/uint8</IMPLEMENTATION-DATA-TYPE-REF>
                    </SW-DATA-DEF-PROPS-CONDITIONAL>
                  </SW-DATA-DEF-PROPS-VARIANTS>
                </SW-DATA-DEF-PROPS>
              </SW-SERVICE-ARG>
              <SW-SERVICE-ARG>
                <SHORT-NAME>Channel</SHORT-NAME>
                <CATEGORY>TYPE_REFERENCE</CATEGORY>
                <SW-DATA-DEF-PROPS>
                  <SW-DATA-DEF-PROPS-VARIANTS>
                    <SW-DATA-DEF-PROPS-CONDITIONAL>
                      <IMPLEMENTATION-DATA-TYPE-REF DEST="IMPLEMENTATION-DATA-TYPE">/AUTOSAR_Platform/ImplementationDataTypes/uint8</IMPLEMENTATION-DATA-TYPE-REF>
                    </SW-DATA-DEF-PROPS-CONDITIONAL>
                  </SW-DATA-DEF-PROPS-VARIANTS>
                </SW-DATA-DEF-PROPS>
              </SW-SERVICE-ARG>
              <SW-SERVICE-ARG>
                <SHORT-NAME>TimerChselValue</SHORT-NAME>
                <CATEGORY>TYPE_REFERENCE</CATEGORY>
                <SW-DATA-DEF-PROPS>
                  <SW-DATA-DEF-PROPS-VARIANTS>
                    <SW-DATA-DEF-PROPS-CONDITIONAL>
                      <IMPLEMENTATION-DATA-TYPE-REF DEST="IMPLEMENTATION-DATA-TYPE">/AUTOSAR_Platform/ImplementationDataTypes/uint8</IMPLEMENTATION-DATA-TYPE-REF>
                    </SW-DATA-DEF-PROPS-CONDITIONAL>
                  </SW-DATA-DEF-PROPS-VARIANTS>
                </SW-DATA-DEF-PROPS>
              </SW-SERVICE-ARG>
            </ARGUMENTS>
          </BSW-MODULE-ENTRY>
          <BSW-MODULE-ENTRY>
            <SHORT-NAME>Mcu_17_Gtm_ConnectTimerOutToPortPin</SHORT-NAME>
            <INTRODUCTION>
              <NOTE SI="Mcu_17_Gtm_ConnectTimerOutToPortPin is reentrant for other port pins" NOTE-TYPE="HINT" />
            </INTRODUCTION>
            <SERVICE-ID>113</SERVICE-ID>
            <IS-REENTRANT>true</IS-REENTRANT>
            <IS-SYNCHRONOUS>true</IS-SYNCHRONOUS>
            <CALL-TYPE>REGULAR</CALL-TYPE>
            <EXECUTION-CONTEXT>TASK</EXECUTION-CONTEXT>
            <SW-SERVICE-IMPL-POLICY>STANDARD</SW-SERVICE-IMPL-POLICY>
            <ARGUMENTS>
              <SW-SERVICE-ARG>
                <SHORT-NAME>Tout_IndexNumber</SHORT-NAME>
                <CATEGORY>TYPE_REFERENCE</CATEGORY>
                <SW-DATA-DEF-PROPS>
                  <SW-DATA-DEF-PROPS-VARIANTS>
                    <SW-DATA-DEF-PROPS-CONDITIONAL>
                      <IMPLEMENTATION-DATA-TYPE-REF DEST="IMPLEMENTATION-DATA-TYPE">/AUTOSAR_Platform/ImplementationDataTypes/uint16</IMPLEMENTATION-DATA-TYPE-REF>
                    </SW-DATA-DEF-PROPS-CONDITIONAL>
                  </SW-DATA-DEF-PROPS-VARIANTS>
                </SW-DATA-DEF-PROPS>
              </SW-SERVICE-ARG>
              <SW-SERVICE-ARG>
                <SHORT-NAME>TimerOutColumnSelect</SHORT-NAME>
                <CATEGORY>TYPE_REFERENCE</CATEGORY>
                <SW-DATA-DEF-PROPS>
                  <SW-DATA-DEF-PROPS-VARIANTS>
                    <SW-DATA-DEF-PROPS-CONDITIONAL>
                      <IMPLEMENTATION-DATA-TYPE-REF DEST="IMPLEMENTATION-DATA-TYPE">/AUTOSAR_Mcu/ImplementationDataTypes/Mcu_17_Gtm_MappedPortTimerOutType</IMPLEMENTATION-DATA-TYPE-REF>
                    </SW-DATA-DEF-PROPS-CONDITIONAL>
                  </SW-DATA-DEF-PROPS-VARIANTS>
                </SW-DATA-DEF-PROPS>
              </SW-SERVICE-ARG>
            </ARGUMENTS>
          </BSW-MODULE-ENTRY>
          <BSW-MODULE-ENTRY>
            <SHORT-NAME>Mcu_17_Gtm_TomChInitCheck</SHORT-NAME>
            <INTRODUCTION>
              <NOTE SI="Mcu_17_Gtm_TomChInitCheck is reentrant for other channels" NOTE-TYPE="HINT" />
            </INTRODUCTION>
            <SERVICE-ID>116</SERVICE-ID>
            <IS-REENTRANT>true</IS-REENTRANT>
            <IS-SYNCHRONOUS>true</IS-SYNCHRONOUS>
            <CALL-TYPE>REGULAR</CALL-TYPE>
            <EXECUTION-CONTEXT>TASK</EXECUTION-CONTEXT>
            <SW-SERVICE-IMPL-POLICY>STANDARD</SW-SERVICE-IMPL-POLICY>
            <RETURN-TYPE>
              <SHORT-NAME>Return</SHORT-NAME>
              <CATEGORY>TYPE_REFERENCE</CATEGORY>
              <SW-DATA-DEF-PROPS>
                <SW-DATA-DEF-PROPS-VARIANTS>
                  <SW-DATA-DEF-PROPS-CONDITIONAL>
                    <IMPLEMENTATION-DATA-TYPE-REF DEST="IMPLEMENTATION-DATA-TYPE">/AUTOSAR_Std/ImplementationDataTypes/Std_ReturnType</IMPLEMENTATION-DATA-TYPE-REF>
                  </SW-DATA-DEF-PROPS-CONDITIONAL>
                </SW-DATA-DEF-PROPS-VARIANTS>
              </SW-DATA-DEF-PROPS>
            </RETURN-TYPE>
            <ARGUMENTS>
              <SW-SERVICE-ARG>
                <SHORT-NAME>ConfigPtr</SHORT-NAME>
                <CATEGORY>DATA_REFERENCE</CATEGORY>
                <SW-DATA-DEF-PROPS>
                  <SW-DATA-DEF-PROPS-VARIANTS>
                    <SW-DATA-DEF-PROPS-CONDITIONAL>
                      <SW-POINTER-TARGET-PROPS>
                        <TARGET-CATEGORY>TYPE_REFERENCE</TARGET-CATEGORY>
                        <SW-DATA-DEF-PROPS>
                          <SW-DATA-DEF-PROPS-VARIANTS>
                            <SW-DATA-DEF-PROPS-CONDITIONAL>
                              <IMPLEMENTATION-DATA-TYPE-REF DEST="IMPLEMENTATION-DATA-TYPE">/AUTOSAR_Mcu/ImplementationDataTypes/Mcu_17_Gtm_TomAtomChConfigType</IMPLEMENTATION-DATA-TYPE-REF>
                            </SW-DATA-DEF-PROPS-CONDITIONAL>
                          </SW-DATA-DEF-PROPS-VARIANTS>
                        </SW-DATA-DEF-PROPS>
                      </SW-POINTER-TARGET-PROPS>
                    </SW-DATA-DEF-PROPS-CONDITIONAL>
                  </SW-DATA-DEF-PROPS-VARIANTS>
                </SW-DATA-DEF-PROPS>
              </SW-SERVICE-ARG>
            </ARGUMENTS>
          </BSW-MODULE-ENTRY>
          <BSW-MODULE-ENTRY>
            <SHORT-NAME>Mcu_17_Gtm_AtomChInitCheck</SHORT-NAME>
            <INTRODUCTION>
              <NOTE SI="Mcu_17_Gtm_AtomChInitCheck is reentrant for other channels" NOTE-TYPE="HINT" />
            </INTRODUCTION>
            <SERVICE-ID>123</SERVICE-ID>
            <IS-REENTRANT>true</IS-REENTRANT>
            <IS-SYNCHRONOUS>true</IS-SYNCHRONOUS>
            <CALL-TYPE>REGULAR</CALL-TYPE>
            <EXECUTION-CONTEXT>TASK</EXECUTION-CONTEXT>
            <SW-SERVICE-IMPL-POLICY>STANDARD</SW-SERVICE-IMPL-POLICY>
            <RETURN-TYPE>
              <SHORT-NAME>Return</SHORT-NAME>
              <CATEGORY>TYPE_REFERENCE</CATEGORY>
              <SW-DATA-DEF-PROPS>
                <SW-DATA-DEF-PROPS-VARIANTS>
                  <SW-DATA-DEF-PROPS-CONDITIONAL>
                    <IMPLEMENTATION-DATA-TYPE-REF DEST="IMPLEMENTATION-DATA-TYPE">/AUTOSAR_Std/ImplementationDataTypes/Std_ReturnType</IMPLEMENTATION-DATA-TYPE-REF>
                  </SW-DATA-DEF-PROPS-CONDITIONAL>
                </SW-DATA-DEF-PROPS-VARIANTS>
              </SW-DATA-DEF-PROPS>
            </RETURN-TYPE>
            <ARGUMENTS>
              <SW-SERVICE-ARG>
                <SHORT-NAME>ConfigPtr</SHORT-NAME>
                <CATEGORY>DATA_REFERENCE</CATEGORY>
                <SW-DATA-DEF-PROPS>
                  <SW-DATA-DEF-PROPS-VARIANTS>
                    <SW-DATA-DEF-PROPS-CONDITIONAL>
                      <SW-POINTER-TARGET-PROPS>
                        <TARGET-CATEGORY>TYPE_REFERENCE</TARGET-CATEGORY>
                        <SW-DATA-DEF-PROPS>
                          <SW-DATA-DEF-PROPS-VARIANTS>
                            <SW-DATA-DEF-PROPS-CONDITIONAL>
                              <IMPLEMENTATION-DATA-TYPE-REF DEST="IMPLEMENTATION-DATA-TYPE">/AUTOSAR_Mcu/ImplementationDataTypes/Mcu_17_Gtm_TomAtomChConfigType</IMPLEMENTATION-DATA-TYPE-REF>
                            </SW-DATA-DEF-PROPS-CONDITIONAL>
                          </SW-DATA-DEF-PROPS-VARIANTS>
                        </SW-DATA-DEF-PROPS>
                      </SW-POINTER-TARGET-PROPS>
                    </SW-DATA-DEF-PROPS-CONDITIONAL>
                  </SW-DATA-DEF-PROPS-VARIANTS>
                </SW-DATA-DEF-PROPS>
              </SW-SERVICE-ARG>
            </ARGUMENTS>
          </BSW-MODULE-ENTRY>
          <BSW-MODULE-ENTRY>
            <SHORT-NAME>Mcu_17_Gtm_TimChInitCheck</SHORT-NAME>
            <INTRODUCTION>
              <NOTE SI="Mcu_17_Gtm_TimChInitCheck is reentrant for other channels" NOTE-TYPE="HINT" />
            </INTRODUCTION>
            <SERVICE-ID>129</SERVICE-ID>
            <IS-REENTRANT>true</IS-REENTRANT>
            <IS-SYNCHRONOUS>true</IS-SYNCHRONOUS>
            <CALL-TYPE>REGULAR</CALL-TYPE>
            <EXECUTION-CONTEXT>TASK</EXECUTION-CONTEXT>
            <SW-SERVICE-IMPL-POLICY>STANDARD</SW-SERVICE-IMPL-POLICY>
            <RETURN-TYPE>
              <SHORT-NAME>Return</SHORT-NAME>
              <CATEGORY>TYPE_REFERENCE</CATEGORY>
              <SW-DATA-DEF-PROPS>
                <SW-DATA-DEF-PROPS-VARIANTS>
                  <SW-DATA-DEF-PROPS-CONDITIONAL>
                    <IMPLEMENTATION-DATA-TYPE-REF DEST="IMPLEMENTATION-DATA-TYPE">/AUTOSAR_Std/ImplementationDataTypes/Std_ReturnType</IMPLEMENTATION-DATA-TYPE-REF>
                  </SW-DATA-DEF-PROPS-CONDITIONAL>
                </SW-DATA-DEF-PROPS-VARIANTS>
              </SW-DATA-DEF-PROPS>
            </RETURN-TYPE>
            <ARGUMENTS>
              <SW-SERVICE-ARG>
                <SHORT-NAME>ConfigPtr</SHORT-NAME>
                <CATEGORY>DATA_REFERENCE</CATEGORY>
                <SW-DATA-DEF-PROPS>
                  <SW-DATA-DEF-PROPS-VARIANTS>
                    <SW-DATA-DEF-PROPS-CONDITIONAL>
                      <SW-POINTER-TARGET-PROPS>
                        <TARGET-CATEGORY>TYPE_REFERENCE</TARGET-CATEGORY>
                        <SW-DATA-DEF-PROPS>
                          <SW-DATA-DEF-PROPS-VARIANTS>
                            <SW-DATA-DEF-PROPS-CONDITIONAL>
                              <IMPLEMENTATION-DATA-TYPE-REF DEST="IMPLEMENTATION-DATA-TYPE">/AUTOSAR_Mcu/ImplementationDataTypes/Mcu_17_Gtm_TomAtomChConfigType</IMPLEMENTATION-DATA-TYPE-REF>
                            </SW-DATA-DEF-PROPS-CONDITIONAL>
                          </SW-DATA-DEF-PROPS-VARIANTS>
                        </SW-DATA-DEF-PROPS>
                      </SW-POINTER-TARGET-PROPS>
                    </SW-DATA-DEF-PROPS-CONDITIONAL>
                  </SW-DATA-DEF-PROPS-VARIANTS>
                </SW-DATA-DEF-PROPS>
              </SW-SERVICE-ARG>
            </ARGUMENTS>
          </BSW-MODULE-ENTRY>
          <BSW-MODULE-ENTRY>
            <SHORT-NAME>Mcu_17_Gtm_AtomChEndisCtrlUpdate</SHORT-NAME>
            <INTRODUCTION>
              <NOTE SI="Mcu_17_Gtm_AtomChEndisCtrlUpdate is reentrant for other channels" NOTE-TYPE="HINT" />
            </INTRODUCTION>
            <SERVICE-ID>127</SERVICE-ID>
            <IS-REENTRANT>true</IS-REENTRANT>
            <IS-SYNCHRONOUS>true</IS-SYNCHRONOUS>
            <CALL-TYPE>REGULAR</CALL-TYPE>
            <EXECUTION-CONTEXT>TASK</EXECUTION-CONTEXT>
            <SW-SERVICE-IMPL-POLICY>STANDARD</SW-SERVICE-IMPL-POLICY>
            <ARGUMENTS>
              <SW-SERVICE-ARG>
                <SHORT-NAME>Module</SHORT-NAME>
                <CATEGORY>TYPE_REFERENCE</CATEGORY>
                <SW-DATA-DEF-PROPS>
                  <SW-DATA-DEF-PROPS-VARIANTS>
                    <SW-DATA-DEF-PROPS-CONDITIONAL>
                      <IMPLEMENTATION-DATA-TYPE-REF DEST="IMPLEMENTATION-DATA-TYPE">/AUTOSAR_Platform/ImplementationDataTypes/uint8</IMPLEMENTATION-DATA-TYPE-REF>
                    </SW-DATA-DEF-PROPS-CONDITIONAL>
                  </SW-DATA-DEF-PROPS-VARIANTS>
                </SW-DATA-DEF-PROPS>
              </SW-SERVICE-ARG>
              <SW-SERVICE-ARG>
                <SHORT-NAME>Channel</SHORT-NAME>
                <CATEGORY>TYPE_REFERENCE</CATEGORY>
                <SW-DATA-DEF-PROPS>
                  <SW-DATA-DEF-PROPS-VARIANTS>
                    <SW-DATA-DEF-PROPS-CONDITIONAL>
                      <IMPLEMENTATION-DATA-TYPE-REF DEST="IMPLEMENTATION-DATA-TYPE">/AUTOSAR_Platform/ImplementationDataTypes/uint8</IMPLEMENTATION-DATA-TYPE-REF>
                    </SW-DATA-DEF-PROPS-CONDITIONAL>
                  </SW-DATA-DEF-PROPS-VARIANTS>
                </SW-DATA-DEF-PROPS>
              </SW-SERVICE-ARG>
              <SW-SERVICE-ARG>
                <SHORT-NAME>TimerEnDis</SHORT-NAME>
                <CATEGORY>TYPE_REFERENCE</CATEGORY>
                <SW-DATA-DEF-PROPS>
                  <SW-DATA-DEF-PROPS-VARIANTS>
                    <SW-DATA-DEF-PROPS-CONDITIONAL>
                      <IMPLEMENTATION-DATA-TYPE-REF DEST="IMPLEMENTATION-DATA-TYPE">/AUTOSAR_Mcu/ImplementationDataTypes/Mcu_17_Gtm_TimerEnTriggerType</IMPLEMENTATION-DATA-TYPE-REF>
                    </SW-DATA-DEF-PROPS-CONDITIONAL>
                  </SW-DATA-DEF-PROPS-VARIANTS>
                </SW-DATA-DEF-PROPS>
              </SW-SERVICE-ARG>
            </ARGUMENTS>
          </BSW-MODULE-ENTRY>
          <BSW-MODULE-ENTRY>
            <SHORT-NAME>Mcu_17_Gtm_AtomChEndisStatUpdate</SHORT-NAME>
            <INTRODUCTION>
              <NOTE SI="Mcu_17_Gtm_AtomChEndisStatUpdate is reentrant for other channels" NOTE-TYPE="HINT" />
            </INTRODUCTION>
            <SERVICE-ID>128</SERVICE-ID>
            <IS-REENTRANT>true</IS-REENTRANT>
            <IS-SYNCHRONOUS>true</IS-SYNCHRONOUS>
            <CALL-TYPE>REGULAR</CALL-TYPE>
            <EXECUTION-CONTEXT>TASK</EXECUTION-CONTEXT>
            <SW-SERVICE-IMPL-POLICY>STANDARD</SW-SERVICE-IMPL-POLICY>
            <ARGUMENTS>
              <SW-SERVICE-ARG>
                <SHORT-NAME>Module</SHORT-NAME>
                <CATEGORY>TYPE_REFERENCE</CATEGORY>
                <SW-DATA-DEF-PROPS>
                  <SW-DATA-DEF-PROPS-VARIANTS>
                    <SW-DATA-DEF-PROPS-CONDITIONAL>
                      <IMPLEMENTATION-DATA-TYPE-REF DEST="IMPLEMENTATION-DATA-TYPE">/AUTOSAR_Platform/ImplementationDataTypes/uint8</IMPLEMENTATION-DATA-TYPE-REF>
                    </SW-DATA-DEF-PROPS-CONDITIONAL>
                  </SW-DATA-DEF-PROPS-VARIANTS>
                </SW-DATA-DEF-PROPS>
              </SW-SERVICE-ARG>
              <SW-SERVICE-ARG>
                <SHORT-NAME>Channel</SHORT-NAME>
                <CATEGORY>TYPE_REFERENCE</CATEGORY>
                <SW-DATA-DEF-PROPS>
                  <SW-DATA-DEF-PROPS-VARIANTS>
                    <SW-DATA-DEF-PROPS-CONDITIONAL>
                      <IMPLEMENTATION-DATA-TYPE-REF DEST="IMPLEMENTATION-DATA-TYPE">/AUTOSAR_Platform/ImplementationDataTypes/uint8</IMPLEMENTATION-DATA-TYPE-REF>
                    </SW-DATA-DEF-PROPS-CONDITIONAL>
                  </SW-DATA-DEF-PROPS-VARIANTS>
                </SW-DATA-DEF-PROPS>
              </SW-SERVICE-ARG>
              <SW-SERVICE-ARG>
                <SHORT-NAME>TimerEnDis</SHORT-NAME>
                <CATEGORY>TYPE_REFERENCE</CATEGORY>
                <SW-DATA-DEF-PROPS>
                  <SW-DATA-DEF-PROPS-VARIANTS>
                    <SW-DATA-DEF-PROPS-CONDITIONAL>
                      <IMPLEMENTATION-DATA-TYPE-REF DEST="IMPLEMENTATION-DATA-TYPE">/AUTOSAR_Mcu/ImplementationDataTypes/Mcu_17_Gtm_TimerEnableType</IMPLEMENTATION-DATA-TYPE-REF>
                    </SW-DATA-DEF-PROPS-CONDITIONAL>
                  </SW-DATA-DEF-PROPS-VARIANTS>
                </SW-DATA-DEF-PROPS>
              </SW-SERVICE-ARG>
            </ARGUMENTS>
          </BSW-MODULE-ENTRY>
          <BSW-MODULE-ENTRY>
            <SHORT-NAME>Mcu_17_Gtm_TomChEndisStatUpdate</SHORT-NAME>
            <INTRODUCTION>
              <NOTE SI="Mcu_17_Gtm_TomChEndisStatUpdate is reentrant for other channels" NOTE-TYPE="HINT" />
            </INTRODUCTION>
            <SERVICE-ID>121</SERVICE-ID>
            <IS-REENTRANT>true</IS-REENTRANT>
            <IS-SYNCHRONOUS>true</IS-SYNCHRONOUS>
            <CALL-TYPE>REGULAR</CALL-TYPE>
            <EXECUTION-CONTEXT>TASK</EXECUTION-CONTEXT>
            <SW-SERVICE-IMPL-POLICY>STANDARD</SW-SERVICE-IMPL-POLICY>
            <ARGUMENTS>
              <SW-SERVICE-ARG>
                <SHORT-NAME>Module</SHORT-NAME>
                <CATEGORY>TYPE_REFERENCE</CATEGORY>
                <SW-DATA-DEF-PROPS>
                  <SW-DATA-DEF-PROPS-VARIANTS>
                    <SW-DATA-DEF-PROPS-CONDITIONAL>
                      <IMPLEMENTATION-DATA-TYPE-REF DEST="IMPLEMENTATION-DATA-TYPE">/AUTOSAR_Platform/ImplementationDataTypes/uint8</IMPLEMENTATION-DATA-TYPE-REF>
                    </SW-DATA-DEF-PROPS-CONDITIONAL>
                  </SW-DATA-DEF-PROPS-VARIANTS>
                </SW-DATA-DEF-PROPS>
              </SW-SERVICE-ARG>
              <SW-SERVICE-ARG>
                <SHORT-NAME>Channel</SHORT-NAME>
                <CATEGORY>TYPE_REFERENCE</CATEGORY>
                <SW-DATA-DEF-PROPS>
                  <SW-DATA-DEF-PROPS-VARIANTS>
                    <SW-DATA-DEF-PROPS-CONDITIONAL>
                      <IMPLEMENTATION-DATA-TYPE-REF DEST="IMPLEMENTATION-DATA-TYPE">/AUTOSAR_Platform/ImplementationDataTypes/uint8</IMPLEMENTATION-DATA-TYPE-REF>
                    </SW-DATA-DEF-PROPS-CONDITIONAL>
                  </SW-DATA-DEF-PROPS-VARIANTS>
                </SW-DATA-DEF-PROPS>
              </SW-SERVICE-ARG>
              <SW-SERVICE-ARG>
                <SHORT-NAME>TimerEnDis</SHORT-NAME>
                <CATEGORY>TYPE_REFERENCE</CATEGORY>
                <SW-DATA-DEF-PROPS>
                  <SW-DATA-DEF-PROPS-VARIANTS>
                    <SW-DATA-DEF-PROPS-CONDITIONAL>
                      <IMPLEMENTATION-DATA-TYPE-REF DEST="IMPLEMENTATION-DATA-TYPE">/AUTOSAR_Mcu/ImplementationDataTypes/Mcu_17_Gtm_TimerEnTriggerType</IMPLEMENTATION-DATA-TYPE-REF>
                    </SW-DATA-DEF-PROPS-CONDITIONAL>
                  </SW-DATA-DEF-PROPS-VARIANTS>
                </SW-DATA-DEF-PROPS>
              </SW-SERVICE-ARG>
            </ARGUMENTS>
          </BSW-MODULE-ENTRY>
          <BSW-MODULE-ENTRY>
            <SHORT-NAME>Mcu_17_Gtm_TomChEndisCtrlUpdate</SHORT-NAME>
            <INTRODUCTION>
              <NOTE SI="Mcu_17_Gtm_TomChEndisCtrlUpdate is reentrant for other channels" NOTE-TYPE="HINT" />
            </INTRODUCTION>
            <SERVICE-ID>120</SERVICE-ID>
            <IS-REENTRANT>true</IS-REENTRANT>
            <IS-SYNCHRONOUS>true</IS-SYNCHRONOUS>
            <CALL-TYPE>REGULAR</CALL-TYPE>
            <EXECUTION-CONTEXT>TASK</EXECUTION-CONTEXT>
            <SW-SERVICE-IMPL-POLICY>STANDARD</SW-SERVICE-IMPL-POLICY>
            <ARGUMENTS>
              <SW-SERVICE-ARG>
                <SHORT-NAME>Module</SHORT-NAME>
                <CATEGORY>TYPE_REFERENCE</CATEGORY>
                <SW-DATA-DEF-PROPS>
                  <SW-DATA-DEF-PROPS-VARIANTS>
                    <SW-DATA-DEF-PROPS-CONDITIONAL>
                      <IMPLEMENTATION-DATA-TYPE-REF DEST="IMPLEMENTATION-DATA-TYPE">/AUTOSAR_Platform/ImplementationDataTypes/uint8</IMPLEMENTATION-DATA-TYPE-REF>
                    </SW-DATA-DEF-PROPS-CONDITIONAL>
                  </SW-DATA-DEF-PROPS-VARIANTS>
                </SW-DATA-DEF-PROPS>
              </SW-SERVICE-ARG>
              <SW-SERVICE-ARG>
                <SHORT-NAME>Channel</SHORT-NAME>
                <CATEGORY>TYPE_REFERENCE</CATEGORY>
                <SW-DATA-DEF-PROPS>
                  <SW-DATA-DEF-PROPS-VARIANTS>
                    <SW-DATA-DEF-PROPS-CONDITIONAL>
                      <IMPLEMENTATION-DATA-TYPE-REF DEST="IMPLEMENTATION-DATA-TYPE">/AUTOSAR_Platform/ImplementationDataTypes/uint8</IMPLEMENTATION-DATA-TYPE-REF>
                    </SW-DATA-DEF-PROPS-CONDITIONAL>
                  </SW-DATA-DEF-PROPS-VARIANTS>
                </SW-DATA-DEF-PROPS>
              </SW-SERVICE-ARG>
              <SW-SERVICE-ARG>
                <SHORT-NAME>TimerEnDis</SHORT-NAME>
                <CATEGORY>TYPE_REFERENCE</CATEGORY>
                <SW-DATA-DEF-PROPS>
                  <SW-DATA-DEF-PROPS-VARIANTS>
                    <SW-DATA-DEF-PROPS-CONDITIONAL>
                      <IMPLEMENTATION-DATA-TYPE-REF DEST="IMPLEMENTATION-DATA-TYPE">/AUTOSAR_Mcu/ImplementationDataTypes/Mcu_17_Gtm_TimerEnTriggerType</IMPLEMENTATION-DATA-TYPE-REF>
                    </SW-DATA-DEF-PROPS-CONDITIONAL>
                  </SW-DATA-DEF-PROPS-VARIANTS>
                </SW-DATA-DEF-PROPS>
              </SW-SERVICE-ARG>
            </ARGUMENTS>
          </BSW-MODULE-ENTRY>
          <BSW-MODULE-ENTRY>
            <SHORT-NAME>Mcu_17_Gtm_AtomChOutEnStatUpdate</SHORT-NAME>
            <INTRODUCTION>
              <NOTE SI="Mcu_17_Gtm_AtomChOutEnStatUpdate is reentrant for other channels" NOTE-TYPE="HINT" />
            </INTRODUCTION>
            <SERVICE-ID>126</SERVICE-ID>
            <IS-REENTRANT>true</IS-REENTRANT>
            <IS-SYNCHRONOUS>true</IS-SYNCHRONOUS>
            <CALL-TYPE>REGULAR</CALL-TYPE>
            <EXECUTION-CONTEXT>TASK</EXECUTION-CONTEXT>
            <SW-SERVICE-IMPL-POLICY>STANDARD</SW-SERVICE-IMPL-POLICY>
            <ARGUMENTS>
              <SW-SERVICE-ARG>
                <SHORT-NAME>Module</SHORT-NAME>
                <CATEGORY>TYPE_REFERENCE</CATEGORY>
                <SW-DATA-DEF-PROPS>
                  <SW-DATA-DEF-PROPS-VARIANTS>
                    <SW-DATA-DEF-PROPS-CONDITIONAL>
                      <IMPLEMENTATION-DATA-TYPE-REF DEST="IMPLEMENTATION-DATA-TYPE">/AUTOSAR_Platform/ImplementationDataTypes/uint8</IMPLEMENTATION-DATA-TYPE-REF>
                    </SW-DATA-DEF-PROPS-CONDITIONAL>
                  </SW-DATA-DEF-PROPS-VARIANTS>
                </SW-DATA-DEF-PROPS>
              </SW-SERVICE-ARG>
              <SW-SERVICE-ARG>
                <SHORT-NAME>Channel</SHORT-NAME>
                <CATEGORY>TYPE_REFERENCE</CATEGORY>
                <SW-DATA-DEF-PROPS>
                  <SW-DATA-DEF-PROPS-VARIANTS>
                    <SW-DATA-DEF-PROPS-CONDITIONAL>
                      <IMPLEMENTATION-DATA-TYPE-REF DEST="IMPLEMENTATION-DATA-TYPE">/AUTOSAR_Platform/ImplementationDataTypes/uint8</IMPLEMENTATION-DATA-TYPE-REF>
                    </SW-DATA-DEF-PROPS-CONDITIONAL>
                  </SW-DATA-DEF-PROPS-VARIANTS>
                </SW-DATA-DEF-PROPS>
              </SW-SERVICE-ARG>
              <SW-SERVICE-ARG>
                <SHORT-NAME>TimerOutputEnDis</SHORT-NAME>
                <CATEGORY>TYPE_REFERENCE</CATEGORY>
                <SW-DATA-DEF-PROPS>
                  <SW-DATA-DEF-PROPS-VARIANTS>
                    <SW-DATA-DEF-PROPS-CONDITIONAL>
                      <IMPLEMENTATION-DATA-TYPE-REF DEST="IMPLEMENTATION-DATA-TYPE">/AUTOSAR_Mcu/ImplementationDataTypes/Mcu_17_Gtm_TimerOutputEnableType</IMPLEMENTATION-DATA-TYPE-REF>
                    </SW-DATA-DEF-PROPS-CONDITIONAL>
                  </SW-DATA-DEF-PROPS-VARIANTS>
                </SW-DATA-DEF-PROPS>
              </SW-SERVICE-ARG>
            </ARGUMENTS>
          </BSW-MODULE-ENTRY>
          <BSW-MODULE-ENTRY>
            <SHORT-NAME>Mcu_17_Gtm_TomChOutEnStatUpdate</SHORT-NAME>
            <INTRODUCTION>
              <NOTE SI="Mcu_17_Gtm_TomChOutEnStatUpdate is reentrant for other channels" NOTE-TYPE="HINT" />
            </INTRODUCTION>
            <SERVICE-ID>119</SERVICE-ID>
            <IS-REENTRANT>true</IS-REENTRANT>
            <IS-SYNCHRONOUS>true</IS-SYNCHRONOUS>
            <CALL-TYPE>REGULAR</CALL-TYPE>
            <EXECUTION-CONTEXT>TASK</EXECUTION-CONTEXT>
            <SW-SERVICE-IMPL-POLICY>STANDARD</SW-SERVICE-IMPL-POLICY>
            <ARGUMENTS>
              <SW-SERVICE-ARG>
                <SHORT-NAME>Module</SHORT-NAME>
                <CATEGORY>TYPE_REFERENCE</CATEGORY>
                <SW-DATA-DEF-PROPS>
                  <SW-DATA-DEF-PROPS-VARIANTS>
                    <SW-DATA-DEF-PROPS-CONDITIONAL>
                      <IMPLEMENTATION-DATA-TYPE-REF DEST="IMPLEMENTATION-DATA-TYPE">/AUTOSAR_Platform/ImplementationDataTypes/uint8</IMPLEMENTATION-DATA-TYPE-REF>
                    </SW-DATA-DEF-PROPS-CONDITIONAL>
                  </SW-DATA-DEF-PROPS-VARIANTS>
                </SW-DATA-DEF-PROPS>
              </SW-SERVICE-ARG>
              <SW-SERVICE-ARG>
                <SHORT-NAME>Channel</SHORT-NAME>
                <CATEGORY>TYPE_REFERENCE</CATEGORY>
                <SW-DATA-DEF-PROPS>
                  <SW-DATA-DEF-PROPS-VARIANTS>
                    <SW-DATA-DEF-PROPS-CONDITIONAL>
                      <IMPLEMENTATION-DATA-TYPE-REF DEST="IMPLEMENTATION-DATA-TYPE">/AUTOSAR_Platform/ImplementationDataTypes/uint8</IMPLEMENTATION-DATA-TYPE-REF>
                    </SW-DATA-DEF-PROPS-CONDITIONAL>
                  </SW-DATA-DEF-PROPS-VARIANTS>
                </SW-DATA-DEF-PROPS>
              </SW-SERVICE-ARG>
              <SW-SERVICE-ARG>
                <SHORT-NAME>TimerOutputEnDis</SHORT-NAME>
                <CATEGORY>TYPE_REFERENCE</CATEGORY>
                <SW-DATA-DEF-PROPS>
                  <SW-DATA-DEF-PROPS-VARIANTS>
                    <SW-DATA-DEF-PROPS-CONDITIONAL>
                      <IMPLEMENTATION-DATA-TYPE-REF DEST="IMPLEMENTATION-DATA-TYPE">/AUTOSAR_Mcu/ImplementationDataTypes/Mcu_17_Gtm_TimerOutputEnableType</IMPLEMENTATION-DATA-TYPE-REF>
                    </SW-DATA-DEF-PROPS-CONDITIONAL>
                  </SW-DATA-DEF-PROPS-VARIANTS>
                </SW-DATA-DEF-PROPS>
              </SW-SERVICE-ARG>
            </ARGUMENTS>
          </BSW-MODULE-ENTRY>
          <BSW-MODULE-ENTRY>
            <SHORT-NAME>Mcu_17_Gtm_TomChOutEnCtrlUpdate</SHORT-NAME>
            <INTRODUCTION>
              <NOTE SI="Mcu_17_Gtm_TomChOutEnCtrlUpdate is reentrant for other channels" NOTE-TYPE="HINT" />
            </INTRODUCTION>
            <SERVICE-ID>118</SERVICE-ID>
            <IS-REENTRANT>true</IS-REENTRANT>
            <IS-SYNCHRONOUS>true</IS-SYNCHRONOUS>
            <CALL-TYPE>REGULAR</CALL-TYPE>
            <EXECUTION-CONTEXT>TASK</EXECUTION-CONTEXT>
            <SW-SERVICE-IMPL-POLICY>STANDARD</SW-SERVICE-IMPL-POLICY>
            <ARGUMENTS>
              <SW-SERVICE-ARG>
                <SHORT-NAME>Module</SHORT-NAME>
                <CATEGORY>TYPE_REFERENCE</CATEGORY>
                <SW-DATA-DEF-PROPS>
                  <SW-DATA-DEF-PROPS-VARIANTS>
                    <SW-DATA-DEF-PROPS-CONDITIONAL>
                      <IMPLEMENTATION-DATA-TYPE-REF DEST="IMPLEMENTATION-DATA-TYPE">/AUTOSAR_Platform/ImplementationDataTypes/uint8</IMPLEMENTATION-DATA-TYPE-REF>
                    </SW-DATA-DEF-PROPS-CONDITIONAL>
                  </SW-DATA-DEF-PROPS-VARIANTS>
                </SW-DATA-DEF-PROPS>
              </SW-SERVICE-ARG>
              <SW-SERVICE-ARG>
                <SHORT-NAME>Channel</SHORT-NAME>
                <CATEGORY>TYPE_REFERENCE</CATEGORY>
                <SW-DATA-DEF-PROPS>
                  <SW-DATA-DEF-PROPS-VARIANTS>
                    <SW-DATA-DEF-PROPS-CONDITIONAL>
                      <IMPLEMENTATION-DATA-TYPE-REF DEST="IMPLEMENTATION-DATA-TYPE">/AUTOSAR_Platform/ImplementationDataTypes/uint8</IMPLEMENTATION-DATA-TYPE-REF>
                    </SW-DATA-DEF-PROPS-CONDITIONAL>
                  </SW-DATA-DEF-PROPS-VARIANTS>
                </SW-DATA-DEF-PROPS>
              </SW-SERVICE-ARG>
              <SW-SERVICE-ARG>
                <SHORT-NAME>TimerOutputEnDis</SHORT-NAME>
                <CATEGORY>TYPE_REFERENCE</CATEGORY>
                <SW-DATA-DEF-PROPS>
                  <SW-DATA-DEF-PROPS-VARIANTS>
                    <SW-DATA-DEF-PROPS-CONDITIONAL>
                      <IMPLEMENTATION-DATA-TYPE-REF DEST="IMPLEMENTATION-DATA-TYPE">/AUTOSAR_Mcu/ImplementationDataTypes/Mcu_17_Gtm_TimerOutputEnTriggerType</IMPLEMENTATION-DATA-TYPE-REF>
                    </SW-DATA-DEF-PROPS-CONDITIONAL>
                  </SW-DATA-DEF-PROPS-VARIANTS>
                </SW-DATA-DEF-PROPS>
              </SW-SERVICE-ARG>
            </ARGUMENTS>
          </BSW-MODULE-ENTRY>
          <BSW-MODULE-ENTRY>
            <SHORT-NAME>Mcu_17_Gtm_TomChUpdateEnDis</SHORT-NAME>
            <INTRODUCTION>
              <NOTE SI="Mcu_17_Gtm_TomChUpdateEnDis is reentrant for other channels" NOTE-TYPE="HINT" />
            </INTRODUCTION>
            <SERVICE-ID>117</SERVICE-ID>
            <IS-REENTRANT>true</IS-REENTRANT>
            <IS-SYNCHRONOUS>true</IS-SYNCHRONOUS>
            <CALL-TYPE>REGULAR</CALL-TYPE>
            <EXECUTION-CONTEXT>TASK</EXECUTION-CONTEXT>
            <SW-SERVICE-IMPL-POLICY>STANDARD</SW-SERVICE-IMPL-POLICY>
            <ARGUMENTS>
              <SW-SERVICE-ARG>
                <SHORT-NAME>Module</SHORT-NAME>
                <CATEGORY>TYPE_REFERENCE</CATEGORY>
                <SW-DATA-DEF-PROPS>
                  <SW-DATA-DEF-PROPS-VARIANTS>
                    <SW-DATA-DEF-PROPS-CONDITIONAL>
                      <IMPLEMENTATION-DATA-TYPE-REF DEST="IMPLEMENTATION-DATA-TYPE">/AUTOSAR_Platform/ImplementationDataTypes/uint8</IMPLEMENTATION-DATA-TYPE-REF>
                    </SW-DATA-DEF-PROPS-CONDITIONAL>
                  </SW-DATA-DEF-PROPS-VARIANTS>
                </SW-DATA-DEF-PROPS>
              </SW-SERVICE-ARG>
              <SW-SERVICE-ARG>
                <SHORT-NAME>Channel</SHORT-NAME>
                <CATEGORY>TYPE_REFERENCE</CATEGORY>
                <SW-DATA-DEF-PROPS>
                  <SW-DATA-DEF-PROPS-VARIANTS>
                    <SW-DATA-DEF-PROPS-CONDITIONAL>
                      <IMPLEMENTATION-DATA-TYPE-REF DEST="IMPLEMENTATION-DATA-TYPE">/AUTOSAR_Platform/ImplementationDataTypes/uint8</IMPLEMENTATION-DATA-TYPE-REF>
                    </SW-DATA-DEF-PROPS-CONDITIONAL>
                  </SW-DATA-DEF-PROPS-VARIANTS>
                </SW-DATA-DEF-PROPS>
              </SW-SERVICE-ARG>
              <SW-SERVICE-ARG>
                <SHORT-NAME>UpEnVal</SHORT-NAME>
                <CATEGORY>TYPE_REFERENCE</CATEGORY>
                <SW-DATA-DEF-PROPS>
                  <SW-DATA-DEF-PROPS-VARIANTS>
                    <SW-DATA-DEF-PROPS-CONDITIONAL>
                      <IMPLEMENTATION-DATA-TYPE-REF DEST="IMPLEMENTATION-DATA-TYPE">/AUTOSAR_Mcu/ImplementationDataTypes/Mcu_17_Gtm_TimerUpdateEnableType</IMPLEMENTATION-DATA-TYPE-REF>
                    </SW-DATA-DEF-PROPS-CONDITIONAL>
                  </SW-DATA-DEF-PROPS-VARIANTS>
                </SW-DATA-DEF-PROPS>
              </SW-SERVICE-ARG>
            </ARGUMENTS>
          </BSW-MODULE-ENTRY>
          <BSW-MODULE-ENTRY>
            <SHORT-NAME>Mcu_17_Gtm_AtomChUpdateEnDis</SHORT-NAME>
            <INTRODUCTION>
              <NOTE SI="Mcu_17_Gtm_AtomChUpdateEnDis is reentrant for other channels" NOTE-TYPE="HINT" />
            </INTRODUCTION>
            <SERVICE-ID>124</SERVICE-ID>
            <IS-REENTRANT>true</IS-REENTRANT>
            <IS-SYNCHRONOUS>true</IS-SYNCHRONOUS>
            <CALL-TYPE>REGULAR</CALL-TYPE>
            <EXECUTION-CONTEXT>TASK</EXECUTION-CONTEXT>
            <SW-SERVICE-IMPL-POLICY>STANDARD</SW-SERVICE-IMPL-POLICY>
            <ARGUMENTS>
              <SW-SERVICE-ARG>
                <SHORT-NAME>Module</SHORT-NAME>
                <CATEGORY>TYPE_REFERENCE</CATEGORY>
                <SW-DATA-DEF-PROPS>
                  <SW-DATA-DEF-PROPS-VARIANTS>
                    <SW-DATA-DEF-PROPS-CONDITIONAL>
                      <IMPLEMENTATION-DATA-TYPE-REF DEST="IMPLEMENTATION-DATA-TYPE">/AUTOSAR_Platform/ImplementationDataTypes/uint8</IMPLEMENTATION-DATA-TYPE-REF>
                    </SW-DATA-DEF-PROPS-CONDITIONAL>
                  </SW-DATA-DEF-PROPS-VARIANTS>
                </SW-DATA-DEF-PROPS>
              </SW-SERVICE-ARG>
              <SW-SERVICE-ARG>
                <SHORT-NAME>Channel</SHORT-NAME>
                <CATEGORY>TYPE_REFERENCE</CATEGORY>
                <SW-DATA-DEF-PROPS>
                  <SW-DATA-DEF-PROPS-VARIANTS>
                    <SW-DATA-DEF-PROPS-CONDITIONAL>
                      <IMPLEMENTATION-DATA-TYPE-REF DEST="IMPLEMENTATION-DATA-TYPE">/AUTOSAR_Platform/ImplementationDataTypes/uint8</IMPLEMENTATION-DATA-TYPE-REF>
                    </SW-DATA-DEF-PROPS-CONDITIONAL>
                  </SW-DATA-DEF-PROPS-VARIANTS>
                </SW-DATA-DEF-PROPS>
              </SW-SERVICE-ARG>
              <SW-SERVICE-ARG>
                <SHORT-NAME>UpEnVal</SHORT-NAME>
                <CATEGORY>TYPE_REFERENCE</CATEGORY>
                <SW-DATA-DEF-PROPS>
                  <SW-DATA-DEF-PROPS-VARIANTS>
                    <SW-DATA-DEF-PROPS-CONDITIONAL>
                      <IMPLEMENTATION-DATA-TYPE-REF DEST="IMPLEMENTATION-DATA-TYPE">/AUTOSAR_Mcu/ImplementationDataTypes/Mcu_17_Gtm_TimerUpdateEnableType</IMPLEMENTATION-DATA-TYPE-REF>
                    </SW-DATA-DEF-PROPS-CONDITIONAL>
                  </SW-DATA-DEF-PROPS-VARIANTS>
                </SW-DATA-DEF-PROPS>
              </SW-SERVICE-ARG>
            </ARGUMENTS>
          </BSW-MODULE-ENTRY>
          <BSW-MODULE-ENTRY>
            <SHORT-NAME>Mcu_17_Gtm_AtomChOutEnCtrlUpdate</SHORT-NAME>
            <INTRODUCTION>
              <NOTE SI="Mcu_17_Gtm_AtomChOutEnCtrlUpdate is reentrant for other channels" NOTE-TYPE="HINT" />
            </INTRODUCTION>
            <SERVICE-ID>125</SERVICE-ID>
            <IS-REENTRANT>true</IS-REENTRANT>
            <IS-SYNCHRONOUS>true</IS-SYNCHRONOUS>
            <CALL-TYPE>REGULAR</CALL-TYPE>
            <EXECUTION-CONTEXT>TASK</EXECUTION-CONTEXT>
            <SW-SERVICE-IMPL-POLICY>STANDARD</SW-SERVICE-IMPL-POLICY>
            <ARGUMENTS>
              <SW-SERVICE-ARG>
                <SHORT-NAME>Module</SHORT-NAME>
                <CATEGORY>TYPE_REFERENCE</CATEGORY>
                <SW-DATA-DEF-PROPS>
                  <SW-DATA-DEF-PROPS-VARIANTS>
                    <SW-DATA-DEF-PROPS-CONDITIONAL>
                      <IMPLEMENTATION-DATA-TYPE-REF DEST="IMPLEMENTATION-DATA-TYPE">/AUTOSAR_Platform/ImplementationDataTypes/uint8</IMPLEMENTATION-DATA-TYPE-REF>
                    </SW-DATA-DEF-PROPS-CONDITIONAL>
                  </SW-DATA-DEF-PROPS-VARIANTS>
                </SW-DATA-DEF-PROPS>
              </SW-SERVICE-ARG>
              <SW-SERVICE-ARG>
                <SHORT-NAME>Channel</SHORT-NAME>
                <CATEGORY>TYPE_REFERENCE</CATEGORY>
                <SW-DATA-DEF-PROPS>
                  <SW-DATA-DEF-PROPS-VARIANTS>
                    <SW-DATA-DEF-PROPS-CONDITIONAL>
                      <IMPLEMENTATION-DATA-TYPE-REF DEST="IMPLEMENTATION-DATA-TYPE">/AUTOSAR_Platform/ImplementationDataTypes/uint8</IMPLEMENTATION-DATA-TYPE-REF>
                    </SW-DATA-DEF-PROPS-CONDITIONAL>
                  </SW-DATA-DEF-PROPS-VARIANTS>
                </SW-DATA-DEF-PROPS>
              </SW-SERVICE-ARG>
              <SW-SERVICE-ARG>
                <SHORT-NAME>TimerOutputEnDis</SHORT-NAME>
                <CATEGORY>TYPE_REFERENCE</CATEGORY>
                <SW-DATA-DEF-PROPS>
                  <SW-DATA-DEF-PROPS-VARIANTS>
                    <SW-DATA-DEF-PROPS-CONDITIONAL>
                      <IMPLEMENTATION-DATA-TYPE-REF DEST="IMPLEMENTATION-DATA-TYPE">/AUTOSAR_Mcu/ImplementationDataTypes/Mcu_17_Gtm_TimerOutputEnTriggerType</IMPLEMENTATION-DATA-TYPE-REF>
                    </SW-DATA-DEF-PROPS-CONDITIONAL>
                  </SW-DATA-DEF-PROPS-VARIANTS>
                </SW-DATA-DEF-PROPS>
              </SW-SERVICE-ARG>
            </ARGUMENTS>
          </BSW-MODULE-ENTRY>
          <BSW-MODULE-ENTRY>
            <SHORT-NAME>Mcu_17_Gtm_AtomTriggerRequest</SHORT-NAME>
            <INTRODUCTION>
              <NOTE SI="Mcu_17_Gtm_AtomTriggerRequest is reentrant for other AGC" NOTE-TYPE="HINT" />
            </INTRODUCTION>
            <SERVICE-ID>122</SERVICE-ID>
            <IS-REENTRANT>true</IS-REENTRANT>
            <IS-SYNCHRONOUS>true</IS-SYNCHRONOUS>
            <CALL-TYPE>REGULAR</CALL-TYPE>
            <EXECUTION-CONTEXT>TASK</EXECUTION-CONTEXT>
            <SW-SERVICE-IMPL-POLICY>STANDARD</SW-SERVICE-IMPL-POLICY>
            <ARGUMENTS>
              <SW-SERVICE-ARG>
                <SHORT-NAME>Module</SHORT-NAME>
                <CATEGORY>TYPE_REFERENCE</CATEGORY>
                <SW-DATA-DEF-PROPS>
                  <SW-DATA-DEF-PROPS-VARIANTS>
                    <SW-DATA-DEF-PROPS-CONDITIONAL>
                      <IMPLEMENTATION-DATA-TYPE-REF DEST="IMPLEMENTATION-DATA-TYPE">/AUTOSAR_Platform/ImplementationDataTypes/uint8</IMPLEMENTATION-DATA-TYPE-REF>
                    </SW-DATA-DEF-PROPS-CONDITIONAL>
                  </SW-DATA-DEF-PROPS-VARIANTS>
                </SW-DATA-DEF-PROPS>
              </SW-SERVICE-ARG>
              <SW-SERVICE-ARG>
                <SHORT-NAME>TriggerChannels</SHORT-NAME>
                <CATEGORY>TYPE_REFERENCE</CATEGORY>
                <SW-DATA-DEF-PROPS>
                  <SW-DATA-DEF-PROPS-VARIANTS>
                    <SW-DATA-DEF-PROPS-CONDITIONAL>
                      <IMPLEMENTATION-DATA-TYPE-REF DEST="IMPLEMENTATION-DATA-TYPE">/AUTOSAR_Platform/ImplementationDataTypes/uint16</IMPLEMENTATION-DATA-TYPE-REF>
                    </SW-DATA-DEF-PROPS-CONDITIONAL>
                  </SW-DATA-DEF-PROPS-VARIANTS>
                </SW-DATA-DEF-PROPS>
              </SW-SERVICE-ARG>
            </ARGUMENTS>
          </BSW-MODULE-ENTRY>
          <BSW-MODULE-ENTRY>
            <SHORT-NAME>Mcu_17_Gtm_TomTriggerRequest</SHORT-NAME>
            <INTRODUCTION>
              <NOTE SI="Mcu_17_Gtm_TomTriggerRequest is reentrant for other TGC" NOTE-TYPE="HINT" />
            </INTRODUCTION>
            <SERVICE-ID>115</SERVICE-ID>
            <IS-REENTRANT>true</IS-REENTRANT>
            <IS-SYNCHRONOUS>true</IS-SYNCHRONOUS>
            <CALL-TYPE>REGULAR</CALL-TYPE>
            <EXECUTION-CONTEXT>TASK</EXECUTION-CONTEXT>
            <SW-SERVICE-IMPL-POLICY>STANDARD</SW-SERVICE-IMPL-POLICY>
            <ARGUMENTS>
              <SW-SERVICE-ARG>
                <SHORT-NAME>Module</SHORT-NAME>
                <CATEGORY>TYPE_REFERENCE</CATEGORY>
                <SW-DATA-DEF-PROPS>
                  <SW-DATA-DEF-PROPS-VARIANTS>
                    <SW-DATA-DEF-PROPS-CONDITIONAL>
                      <IMPLEMENTATION-DATA-TYPE-REF DEST="IMPLEMENTATION-DATA-TYPE">/AUTOSAR_Platform/ImplementationDataTypes/uint8</IMPLEMENTATION-DATA-TYPE-REF>
                    </SW-DATA-DEF-PROPS-CONDITIONAL>
                  </SW-DATA-DEF-PROPS-VARIANTS>
                </SW-DATA-DEF-PROPS>
              </SW-SERVICE-ARG>
              <SW-SERVICE-ARG>
                <SHORT-NAME>TomTgcIndex</SHORT-NAME>
                <CATEGORY>TYPE_REFERENCE</CATEGORY>
                <SW-DATA-DEF-PROPS>
                  <SW-DATA-DEF-PROPS-VARIANTS>
                    <SW-DATA-DEF-PROPS-CONDITIONAL>
                      <IMPLEMENTATION-DATA-TYPE-REF DEST="IMPLEMENTATION-DATA-TYPE">/AUTOSAR_Platform/ImplementationDataTypes/uint8</IMPLEMENTATION-DATA-TYPE-REF>
                    </SW-DATA-DEF-PROPS-CONDITIONAL>
                  </SW-DATA-DEF-PROPS-VARIANTS>
                </SW-DATA-DEF-PROPS>
              </SW-SERVICE-ARG>
              <SW-SERVICE-ARG>
                <SHORT-NAME>TriggerChannels</SHORT-NAME>
                <CATEGORY>TYPE_REFERENCE</CATEGORY>
                <SW-DATA-DEF-PROPS>
                  <SW-DATA-DEF-PROPS-VARIANTS>
                    <SW-DATA-DEF-PROPS-CONDITIONAL>
                      <IMPLEMENTATION-DATA-TYPE-REF DEST="IMPLEMENTATION-DATA-TYPE">/AUTOSAR_Platform/ImplementationDataTypes/uint16</IMPLEMENTATION-DATA-TYPE-REF>
                    </SW-DATA-DEF-PROPS-CONDITIONAL>
                  </SW-DATA-DEF-PROPS-VARIANTS>
                </SW-DATA-DEF-PROPS>
              </SW-SERVICE-ARG>
            </ARGUMENTS>
          </BSW-MODULE-ENTRY>
