<?xml version="1.0" encoding="ISO-8859-1"?>
[!AUTOSPACING!][!//
[!VAR "Spi_MainFunction_Handling_Enable"="num:i(node:value(SpiGeneral/SpiLevelDelivered)) > 1 "!][!//
<AUTOSAR xmlns="http://autosar.org/schema/r4.0"
  xmlns:xsi="http://www.w3.org/2001/XMLSchema-instance"
  xsi:schemaLocation="http://autosar.org/schema/r4.0 AUTOSAR_4-0-3_STRICT_COMPACT.xsd">
  <AR-PACKAGES>
    <AR-PACKAGE>
      <SHORT-NAME>AUTOSAR_Spi</SHORT-NAME>
          <AR-PACKAGES>
            <AR-PACKAGE>
              <SHORT-NAME>BswModuleDescriptions</SHORT-NAME>
              <ELEMENTS>
                <BSW-MODULE-DESCRIPTION>
                  <SHORT-NAME>Spi</SHORT-NAME>
                  <MODULE-ID>83</MODULE-ID>
                  <PROVIDED-ENTRYS>
                    <BSW-MODULE-ENTRY-REF-CONDITIONAL>
                      <BSW-MODULE-ENTRY-REF DEST="BSW-MODULE-ENTRY">/AUTOSAR_Spi/BswModuleEntrys/Spi_Init</BSW-MODULE-ENTRY-REF>
                    </BSW-MODULE-ENTRY-REF-CONDITIONAL>
[!IF "$Spi_MainFunction_Handling_Enable = 'true'"!]
                    <BSW-MODULE-ENTRY-REF-CONDITIONAL>
                      <BSW-MODULE-ENTRY-REF DEST="BSW-MODULE-ENTRY">/AUTOSAR_Spi/BswModuleEntrys/Spi_MainFunction_Handling</BSW-MODULE-ENTRY-REF>
                    </BSW-MODULE-ENTRY-REF-CONDITIONAL>
[!ENDIF!]
            </PROVIDED-ENTRYS>
                  <INTERNAL-BEHAVIORS>
                    <BSW-INTERNAL-BEHAVIOR>
                      <SHORT-NAME>InternalBehavior_0</SHORT-NAME>
                      <EXCLUSIVE-AREAS>
                        <EXCLUSIVE-AREA>
                          <SHORT-NAME>ChannelLock</SHORT-NAME>
                        </EXCLUSIVE-AREA>
                        <EXCLUSIVE-AREA>
                          <SHORT-NAME>Queue_Update</SHORT-NAME>
                        </EXCLUSIVE-AREA>
                        <EXCLUSIVE-AREA>
                          <SHORT-NAME>SyncLock</SHORT-NAME>
                        </EXCLUSIVE-AREA>
                      </EXCLUSIVE-AREAS>
                      <ENTITYS>
                        <BSW-CALLED-ENTITY>
                          <SHORT-NAME>Spi_Init</SHORT-NAME>
                          <CAN-ENTER-EXCLUSIVE-AREA-REFS>
                            <CAN-ENTER-EXCLUSIVE-AREA-REF DEST="EXCLUSIVE-AREA">/AUTOSAR_Spi/BswModuleDescriptions/Spi/InternalBehavior_0/ChannelLock</CAN-ENTER-EXCLUSIVE-AREA-REF>
                            <CAN-ENTER-EXCLUSIVE-AREA-REF DEST="EXCLUSIVE-AREA">/AUTOSAR_Spi/BswModuleDescriptions/Spi/InternalBehavior_0/Queue_Update</CAN-ENTER-EXCLUSIVE-AREA-REF>
                            <CAN-ENTER-EXCLUSIVE-AREA-REF DEST="EXCLUSIVE-AREA">/AUTOSAR_Spi/BswModuleDescriptions/Spi/InternalBehavior_0/SyncLock</CAN-ENTER-EXCLUSIVE-AREA-REF>
                          </CAN-ENTER-EXCLUSIVE-AREA-REFS>
                          <MINIMUM-START-INTERVAL>0.0</MINIMUM-START-INTERVAL>
                          <IMPLEMENTED-ENTRY-REF DEST="BSW-MODULE-ENTRY">/AUTOSAR_Spi/BswModuleEntrys/Spi_Init</IMPLEMENTED-ENTRY-REF>
                        </BSW-CALLED-ENTITY>
[!IF "$Spi_MainFunction_Handling_Enable = 'true'"!]
                        <BSW-SCHEDULABLE-ENTITY>
                          <SHORT-NAME>Spi_MainFunction_Handling</SHORT-NAME>
                          <MINIMUM-START-INTERVAL>0.0</MINIMUM-START-INTERVAL>
                          <IMPLEMENTED-ENTRY-REF DEST="BSW-MODULE-ENTRY">/AUTOSAR_Spi/BswModuleEntrys/Spi_MainFunction_Handling</IMPLEMENTED-ENTRY-REF>
                        </BSW-SCHEDULABLE-ENTITY>
[!ENDIF!]
                      </ENTITYS>
                      <EVENTS>
[!IF "$Spi_MainFunction_Handling_Enable = 'true'"!]
                        <BSW-TIMING-EVENT>
                          <SHORT-NAME>TimingEvent_MainFunction</SHORT-NAME>
                          <STARTS-ON-EVENT-REF DEST="BSW-SCHEDULABLE-ENTITY">/AUTOSAR_Spi/BswModuleDescriptions/Spi/InternalBehavior_0/Spi_MainFunction_Handling</STARTS-ON-EVENT-REF>
                          <PERIOD>[!"num:f(SpiGeneral/SpiMainFunctionPeriod/*[1])"!]</PERIOD>
                        </BSW-TIMING-EVENT>
[!ENDIF!]
                          </EVENTS>
                    </BSW-INTERNAL-BEHAVIOR>
                  </INTERNAL-BEHAVIORS>
                </BSW-MODULE-DESCRIPTION>
              </ELEMENTS>
            </AR-PACKAGE>
            <AR-PACKAGE>
              <SHORT-NAME>BswModuleEntrys</SHORT-NAME>
              <ELEMENTS>
                <BSW-MODULE-ENTRY>
                  <SHORT-NAME>Spi_Init</SHORT-NAME>
                  <SERVICE-ID>83</SERVICE-ID>
                  <IS-REENTRANT>false</IS-REENTRANT>
                  <IS-SYNCHRONOUS>true</IS-SYNCHRONOUS>
                  <CALL-TYPE>REGULAR</CALL-TYPE>
                  <EXECUTION-CONTEXT>UNSPECIFIED</EXECUTION-CONTEXT>
                  <SW-SERVICE-IMPL-POLICY>STANDARD</SW-SERVICE-IMPL-POLICY>
                </BSW-MODULE-ENTRY>
                 <BSW-MODULE-ENTRY>
                  <SHORT-NAME>Spi_MainFunction_Handling</SHORT-NAME>
                  <SERVICE-ID>16</SERVICE-ID>
                  <IS-REENTRANT>false</IS-REENTRANT>
                  <IS-SYNCHRONOUS>true</IS-SYNCHRONOUS>
                  <CALL-TYPE>SCHEDULED</CALL-TYPE>
                  <EXECUTION-CONTEXT>TASK</EXECUTION-CONTEXT>
                  <SW-SERVICE-IMPL-POLICY>STANDARD</SW-SERVICE-IMPL-POLICY>
                </BSW-MODULE-ENTRY>
              </ELEMENTS>
        </AR-PACKAGE>
      </AR-PACKAGES>
    </AR-PACKAGE>

    <AR-PACKAGE>
      <SHORT-NAME>Spi_TS_T16D27M10I30R0</SHORT-NAME>
      <AR-PACKAGES>
        <AR-PACKAGE>
          <SHORT-NAME>Implementations</SHORT-NAME>
          <ELEMENTS>
            <BSW-IMPLEMENTATION>
              <SHORT-NAME>BswImplementation_0</SHORT-NAME>
              <CODE-DESCRIPTORS>
                <CODE>
                  <SHORT-NAME>Files</SHORT-NAME>
                  <ARTIFACT-DESCRIPTORS>
                    <AUTOSAR-ENGINEERING-OBJECT>
                      <SHORT-LABEL>make::Spi_defs.mak</SHORT-LABEL>
                      <CATEGORY>SWMAKE</CATEGORY>
                    </AUTOSAR-ENGINEERING-OBJECT>
                    <AUTOSAR-ENGINEERING-OBJECT>
                      <SHORT-LABEL>make::Spi_rules.mak</SHORT-LABEL>
                      <CATEGORY>SWMAKE</CATEGORY>
                    </AUTOSAR-ENGINEERING-OBJECT>
                  </ARTIFACT-DESCRIPTORS>
                </CODE>
              </CODE-DESCRIPTORS>
              <PROGRAMMING-LANGUAGE>C</PROGRAMMING-LANGUAGE>
              <RESOURCE-CONSUMPTION>
                <SHORT-NAME>ResourceConsumption</SHORT-NAME>
                <MEMORY-SECTIONS>
                  <MEMORY-SECTION>
                    <SHORT-NAME>SPI_CODE</SHORT-NAME>
                    <SW-ADDRMETHOD-REF DEST="SW-ADDR-METHOD">/AUTOSAR_MemMap/SwAddrMethods/CODE</SW-ADDRMETHOD-REF>
                    <SYMBOL>CODE</SYMBOL>
                  </MEMORY-SECTION>				
                  <MEMORY-SECTION>
                    <SHORT-NAME>SPI_CODE_ASIL_B_GLOBAL</SHORT-NAME>
                    <OPTIONS> 
                    <OPTION>safetyAsilB</OPTION>					
                    </OPTIONS>						
                    <SW-ADDRMETHOD-REF DEST="SW-ADDR-METHOD">/AUTOSAR_MemMap/SwAddrMethods/CODE_ASIL_B</SW-ADDRMETHOD-REF>
                    <SYMBOL>CODE_ASIL_B_GLOBAL</SYMBOL>
                  </MEMORY-SECTION>
                  <MEMORY-SECTION>
                    <SHORT-NAME>SPI_CONFIG_DATA_ASIL_B_CORE0_32</SHORT-NAME>
                    <ALIGNMENT>32</ALIGNMENT>
                    <OPTIONS> 
                    <OPTION>safetyAsilB</OPTION>					
                    </OPTIONS>						
                    <SW-ADDRMETHOD-REF DEST="SW-ADDR-METHOD">/AUTOSAR_MemMap/SwAddrMethods/CONFIG_DATA_ASIL_B</SW-ADDRMETHOD-REF>
                    <SYMBOL>CONFIG_DATA_ASIL_B_CORE0_32</SYMBOL>
                  </MEMORY-SECTION>
                  <MEMORY-SECTION>
                    <SHORT-NAME>SPI_CONFIG_DATA_ASIL_B_CORE1_32</SHORT-NAME>
                    <ALIGNMENT>32</ALIGNMENT>
                    <OPTIONS> 
                    <OPTION>safetyAsilB</OPTION>					
                    </OPTIONS>						
                    <SW-ADDRMETHOD-REF DEST="SW-ADDR-METHOD">/AUTOSAR_MemMap/SwAddrMethods/CONFIG_DATA_ASIL_B</SW-ADDRMETHOD-REF>
                    <SYMBOL>CONFIG_DATA_ASIL_B_CORE1_32</SYMBOL>
                  </MEMORY-SECTION>
                  <MEMORY-SECTION>
                    <SHORT-NAME>SPI_CONFIG_DATA_ASIL_B_CORE2_32</SHORT-NAME>
                    <ALIGNMENT>32</ALIGNMENT>
                    <OPTIONS> 
                    <OPTION>safetyAsilB</OPTION>					
                    </OPTIONS>						
                    <SW-ADDRMETHOD-REF DEST="SW-ADDR-METHOD">/AUTOSAR_MemMap/SwAddrMethods/CONFIG_DATA_ASIL_B</SW-ADDRMETHOD-REF>
                    <SYMBOL>CONFIG_DATA_ASIL_B_CORE2_32</SYMBOL>
                  </MEMORY-SECTION>
                  <MEMORY-SECTION>
                    <SHORT-NAME>SPI_CONFIG_DATA_ASIL_B_CORE3_32</SHORT-NAME>
                    <ALIGNMENT>32</ALIGNMENT>
                    <OPTIONS> 
                    <OPTION>safetyAsilB</OPTION>					
                    </OPTIONS>						
                    <SW-ADDRMETHOD-REF DEST="SW-ADDR-METHOD">/AUTOSAR_MemMap/SwAddrMethods/CONFIG_DATA_ASIL_B</SW-ADDRMETHOD-REF>
                    <SYMBOL>CONFIG_DATA_ASIL_B_CORE3_32</SYMBOL>
                  </MEMORY-SECTION>
                  <MEMORY-SECTION>
                    <SHORT-NAME>SPI_CONFIG_DATA_ASIL_B_CORE4_32</SHORT-NAME>
                    <ALIGNMENT>32</ALIGNMENT>
                    <OPTIONS> 
                    <OPTION>safetyAsilB</OPTION>					
                    </OPTIONS>						
                    <SW-ADDRMETHOD-REF DEST="SW-ADDR-METHOD">/AUTOSAR_MemMap/SwAddrMethods/CONFIG_DATA_ASIL_B</SW-ADDRMETHOD-REF>
                    <SYMBOL>CONFIG_DATA_ASIL_B_CORE4_32</SYMBOL>
                  </MEMORY-SECTION>
                  <MEMORY-SECTION>
                    <SHORT-NAME>SPI_CONFIG_DATA_ASIL_B_CORE5_32</SHORT-NAME>
                    <ALIGNMENT>32</ALIGNMENT>
                    <OPTIONS> 
                    <OPTION>safetyAsilB</OPTION>					
                    </OPTIONS>						
                    <SW-ADDRMETHOD-REF DEST="SW-ADDR-METHOD">/AUTOSAR_MemMap/SwAddrMethods/CONFIG_DATA_ASIL_B</SW-ADDRMETHOD-REF>
                    <SYMBOL>CONFIG_DATA_ASIL_B_CORE5_32</SYMBOL>
                  </MEMORY-SECTION>                  
                  <MEMORY-SECTION>
                    <SHORT-NAME>SPI_CONFIG_DATA_ASIL_B_GLOBAL_32</SHORT-NAME>
                    <ALIGNMENT>32</ALIGNMENT>
                    <OPTIONS> 
                    <OPTION>safetyAsilB</OPTION>					
                    </OPTIONS>						
                    <SW-ADDRMETHOD-REF DEST="SW-ADDR-METHOD">/AUTOSAR_MemMap/SwAddrMethods/CONFIG_DATA_ASIL_B</SW-ADDRMETHOD-REF>
                    <SYMBOL>CONFIG_DATA_ASIL_B_GLOBAL_32</SYMBOL>
                  </MEMORY-SECTION>
                  <MEMORY-SECTION>
                    <SHORT-NAME>SPI_VAR_CLEARED_ASIL_B_CORE0_256</SHORT-NAME>
                    <OPTIONS> 
                    <OPTION>safetyAsilB</OPTION>					
                    </OPTIONS>						
                    <SW-ADDRMETHOD-REF DEST="SW-ADDR-METHOD">/AUTOSAR_MemMap/SwAddrMethods/VAR_CLEARED_ASIL_B</SW-ADDRMETHOD-REF>
                    <SYMBOL>VAR_CLEARED_ASIL_B_CORE0_256</SYMBOL>
                  </MEMORY-SECTION>
                  <MEMORY-SECTION>
                    <SHORT-NAME>SPI_VAR_CLEARED_ASIL_B_CORE0_32</SHORT-NAME>
                    <ALIGNMENT>32</ALIGNMENT>
                    <OPTIONS> 
                    <OPTION>safetyAsilB</OPTION>					
                    </OPTIONS>						
                    <SW-ADDRMETHOD-REF DEST="SW-ADDR-METHOD">/AUTOSAR_MemMap/SwAddrMethods/VAR_CLEARED_ASIL_B</SW-ADDRMETHOD-REF>
                    <SYMBOL>VAR_CLEARED_ASIL_B_CORE0_32</SYMBOL>
                  </MEMORY-SECTION>
                  <MEMORY-SECTION>
                    <SHORT-NAME>SPI_VAR_CLEARED_ASIL_B_CORE1_256</SHORT-NAME>
                    <OPTIONS> 
                    <OPTION>safetyAsilB</OPTION>					
                    </OPTIONS>						
                    <SW-ADDRMETHOD-REF DEST="SW-ADDR-METHOD">/AUTOSAR_MemMap/SwAddrMethods/VAR_CLEARED_ASIL_B</SW-ADDRMETHOD-REF>
                    <SYMBOL>VAR_CLEARED_ASIL_B_CORE1_256</SYMBOL>
                  </MEMORY-SECTION>
                  <MEMORY-SECTION>
                    <SHORT-NAME>SPI_VAR_CLEARED_ASIL_B_CORE1_32</SHORT-NAME>
                    <ALIGNMENT>32</ALIGNMENT>
                    <OPTIONS> 
                    <OPTION>safetyAsilB</OPTION>					
                    </OPTIONS>						
                    <SW-ADDRMETHOD-REF DEST="SW-ADDR-METHOD">/AUTOSAR_MemMap/SwAddrMethods/VAR_CLEARED_ASIL_B</SW-ADDRMETHOD-REF>
                    <SYMBOL>VAR_CLEARED_ASIL_B_CORE1_32</SYMBOL>
                  </MEMORY-SECTION>
                  <MEMORY-SECTION>
                    <SHORT-NAME>SPI_VAR_CLEARED_ASIL_B_CORE2_256</SHORT-NAME>
                    <OPTIONS> 
                    <OPTION>safetyAsilB</OPTION>					
                    </OPTIONS>						
                    <SW-ADDRMETHOD-REF DEST="SW-ADDR-METHOD">/AUTOSAR_MemMap/SwAddrMethods/VAR_CLEARED_ASIL_B</SW-ADDRMETHOD-REF>
                    <SYMBOL>VAR_CLEARED_ASIL_B_CORE2_256</SYMBOL>
                  </MEMORY-SECTION>
                  <MEMORY-SECTION>
                    <SHORT-NAME>SPI_VAR_CLEARED_ASIL_B_CORE2_32</SHORT-NAME>
                    <ALIGNMENT>32</ALIGNMENT>
                    <OPTIONS> 
                    <OPTION>safetyAsilB</OPTION>					
                    </OPTIONS>						
                    <SW-ADDRMETHOD-REF DEST="SW-ADDR-METHOD">/AUTOSAR_MemMap/SwAddrMethods/VAR_CLEARED_ASIL_B</SW-ADDRMETHOD-REF>
                    <SYMBOL>VAR_CLEARED_ASIL_B_CORE2_32</SYMBOL>
                  </MEMORY-SECTION>
                  <MEMORY-SECTION>
                    <SHORT-NAME>SPI_VAR_CLEARED_ASIL_B_CORE3_256</SHORT-NAME>
                    <OPTIONS> 
                    <OPTION>safetyAsilB</OPTION>					
                    </OPTIONS>						
                    <SW-ADDRMETHOD-REF DEST="SW-ADDR-METHOD">/AUTOSAR_MemMap/SwAddrMethods/VAR_CLEARED_ASIL_B</SW-ADDRMETHOD-REF>
                    <SYMBOL>VAR_CLEARED_ASIL_B_CORE3_256</SYMBOL>
                  </MEMORY-SECTION>
                  <MEMORY-SECTION>
                    <SHORT-NAME>SPI_VAR_CLEARED_ASIL_B_CORE3_32</SHORT-NAME>
                    <ALIGNMENT>32</ALIGNMENT>
                    <OPTIONS> 
                    <OPTION>safetyAsilB</OPTION>					
                    </OPTIONS>						
                    <SW-ADDRMETHOD-REF DEST="SW-ADDR-METHOD">/AUTOSAR_MemMap/SwAddrMethods/VAR_CLEARED_ASIL_B</SW-ADDRMETHOD-REF>
                    <SYMBOL>VAR_CLEARED_ASIL_B_CORE3_32</SYMBOL>
                  </MEMORY-SECTION>
                  <MEMORY-SECTION>
                    <SHORT-NAME>SPI_VAR_CLEARED_ASIL_B_CORE4_256</SHORT-NAME>
                    <OPTIONS> 
                    <OPTION>safetyAsilB</OPTION>					
                    </OPTIONS>						
                    <SW-ADDRMETHOD-REF DEST="SW-ADDR-METHOD">/AUTOSAR_MemMap/SwAddrMethods/VAR_CLEARED_ASIL_B</SW-ADDRMETHOD-REF>
                    <SYMBOL>VAR_CLEARED_ASIL_B_CORE4_256</SYMBOL>
                  </MEMORY-SECTION>
                  <MEMORY-SECTION>
                    <SHORT-NAME>SPI_VAR_CLEARED_ASIL_B_CORE4_32</SHORT-NAME>
                    <ALIGNMENT>32</ALIGNMENT>
                    <OPTIONS> 
                    <OPTION>safetyAsilB</OPTION>					
                    </OPTIONS>						
                    <SW-ADDRMETHOD-REF DEST="SW-ADDR-METHOD">/AUTOSAR_MemMap/SwAddrMethods/VAR_CLEARED_ASIL_B</SW-ADDRMETHOD-REF>
                    <SYMBOL>VAR_CLEARED_ASIL_B_CORE4_32</SYMBOL>
                  </MEMORY-SECTION>
                  <MEMORY-SECTION>
                    <SHORT-NAME>SPI_VAR_CLEARED_ASIL_B_CORE5_256</SHORT-NAME>
                    <OPTIONS> 
                    <OPTION>safetyAsilB</OPTION>					
                    </OPTIONS>						
                    <SW-ADDRMETHOD-REF DEST="SW-ADDR-METHOD">/AUTOSAR_MemMap/SwAddrMethods/VAR_CLEARED_ASIL_B</SW-ADDRMETHOD-REF>
                    <SYMBOL>VAR_CLEARED_ASIL_B_CORE5_256</SYMBOL>
                  </MEMORY-SECTION>
                  <MEMORY-SECTION>
                    <SHORT-NAME>SPI_VAR_CLEARED_ASIL_B_CORE5_32</SHORT-NAME>
                    <ALIGNMENT>32</ALIGNMENT>
                    <OPTIONS> 
                    <OPTION>safetyAsilB</OPTION>					
                    </OPTIONS>						
                    <SW-ADDRMETHOD-REF DEST="SW-ADDR-METHOD">/AUTOSAR_MemMap/SwAddrMethods/VAR_CLEARED_ASIL_B</SW-ADDRMETHOD-REF>
                    <SYMBOL>VAR_CLEARED_ASIL_B_CORE5_32</SYMBOL>
                  </MEMORY-SECTION>
                  <MEMORY-SECTION>
                    <SHORT-NAME>SPI_VAR_CLEARED_ASIL_B_GLOBAL_32</SHORT-NAME>
                    <ALIGNMENT>32</ALIGNMENT>
                    <OPTIONS> 
                    <OPTION>safetyAsilB</OPTION>					
                    </OPTIONS>						
                    <SW-ADDRMETHOD-REF DEST="SW-ADDR-METHOD">/AUTOSAR_MemMap/SwAddrMethods/VAR_CLEARED_ASIL_B</SW-ADDRMETHOD-REF>
                    <SYMBOL>VAR_CLEARED_ASIL_B_GLOBAL_32</SYMBOL>
                  </MEMORY-SECTION>
                </MEMORY-SECTIONS>
              </RESOURCE-CONSUMPTION>
              <!-- MODULE_VERSION 10.30.0 != SW-VERSION -->
              <SW-VERSION>10.30.0</SW-VERSION>
              <VENDOR-ID>17</VENDOR-ID>
              <AR-RELEASE-VERSION>4.2.2</AR-RELEASE-VERSION>
              <BEHAVIOR-REF DEST="BSW-INTERNAL-BEHAVIOR">/AUTOSAR_Spi/BswModuleDescriptions/Spi/InternalBehavior_0</BEHAVIOR-REF>
              <VENDOR-SPECIFIC-MODULE-DEF-REFS>
                <VENDOR-SPECIFIC-MODULE-DEF-REF DEST="ECUC-MODULE-DEF">/TS_T16D27M10I30R0/Spi</VENDOR-SPECIFIC-MODULE-DEF-REF>
              </VENDOR-SPECIFIC-MODULE-DEF-REFS>
            </BSW-IMPLEMENTATION>
          </ELEMENTS>
        </AR-PACKAGE>
      </AR-PACKAGES>
    </AR-PACKAGE>
  </AR-PACKAGES>
</AUTOSAR>
